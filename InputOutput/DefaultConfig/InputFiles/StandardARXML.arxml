[part 1 of 2: packages /Icu to /Port]
AUTOSAR XML (schema 4-2-1)
package /Icu
  module config Icu: implementation-config-variant=VARIANT-PRE-COMPILE, module-description=Icu_Impl
    IcuConfigSet: IcuMaxChannel=7
      7 x IcuChannel:
        IcuChannel_CCANRX_NETWRK_MCU_IN: IcuChannelId=3, IcuDefaultStartEdge=ICU_FALLING_EDGE, IcuMeasurementMode=ICU_MODE_SIGNAL_EDGE_DETECT, IcuNoiseFilterEnable=1, IcuResource=EXTINT_3, IcuWakeupCapability=1
          IcuSignalEdgeDetection: IcuSignalNotification=EcuMExt_CCANRxIntDetected
          IcuWakeup: IcuChannelWakeupInfo=CAN_f26020e5
        IcuChannel_IGNSENSE_DIGAL_MCU_IN: IcuChannelId=6, IcuDefaultStartEdge=ICU_LOW_LEVEL, IcuMeasurementMode=ICU_MODE_SIGNAL_EDGE_DETECT, IcuNoiseFilterEnable=1, IcuResource=EXTINT_6, IcuWakeupCapability=1
          IcuSignalEdgeDetection: IcuSignalNotification=EcuMExt_RunStartIntDetected
          IcuWakeup: IcuChannelWakeupInfo=
        IcuChannel_MCANERR_DIG_MCU_IN: IcuChannelId=0, IcuDefaultStartEdge=ICU_FALLING_EDGE, IcuMeasurementMode=ICU_MODE_SIGNAL_EDGE_DETECT, IcuNoiseFilterEnable=1, IcuResource=EXTINT_7, IcuWakeupCapability=0
          IcuSignalEdgeDetection: IcuSignalNotification=EcuMExt_CANErrIntDetected
        IcuChannel_MCANRX_NETWRK_MCU_IN: IcuChannelId=2, IcuDefaultStartEdge=ICU_FALLING_EDGE, IcuMeasurementMode=ICU_MODE_SIGNAL_EDGE_DETECT, IcuNoiseFilterEnable=1, IcuResource=EXTINT_0, IcuWakeupCapability=1
          IcuSignalEdgeDetection: IcuSignalNotification=EcuMExt_MCANRxIntDetected
          IcuWakeup: IcuChannelWakeupInfo=CAN_f26020e5
        IcuChannel_POWER_FAULT: IcuChannelId=5, IcuDefaultStartEdge=ICU_FALLING_EDGE, IcuMeasurementMode=ICU_MODE_SIGNAL_EDGE_DETECT, IcuNoiseFilterEnable=1, IcuResource=EXTINT_4, IcuWakeupCapability=0
          IcuSignalEdgeDetection: IcuSignalNotification=EcuMExt_PowerFaultIntDetected
        IcuChannel_SPEEDIN_DIGAL_MCU_IN: IcuChannelId=1, IcuDefaultStartEdge=ICU_BOTH_EDGES, IcuMeasurementMode=ICU_MODE_TIMESTAMP, IcuNoiseFilterEnable=0, IcuResource=ICU_14, IcuWakeupCapability=0
          IcuTimestampMeasurement:
            IcuChannelBufferName = PIC_Timer_DataBuffer
            IcuChannelBufferSize = 10
            IcuTimestampMeasurementProperty = ICU_CIRCULAR_BUFFER
            IcuTimestampNotification = IoHwAb_PulseInput_Notify_EdgeDetected
        IcuChannel_TFT_BKLT_FLT: IcuChannelId=4, IcuDefaultStartEdge=ICU_FALLING_EDGE, IcuMeasurementMode=ICU_MODE_SIGNAL_EDGE_DETECT, IcuNoiseFilterEnable=1, IcuResource=EXTINT_5, IcuWakeupCapability=0
          IcuSignalEdgeDetection: IcuSignalNotification=EcuMExt_TFTBkltFltIntDetected
    IcuGeneral:
      IcuDevErrorDetect = 1
      IcuErrorCalloutFunction = Det_ReportError
      IcuIncludeFile = Det.h
      IcuIncludeFile = EcuMExt.h
      IcuIncludeFile = IoHwAb_PulseInputCbk.h
      IcuIndex = 0
      IcuReportWakeupSource = 1
    IcuOptionalApis:
      IcuDeInitApi = 1
      IcuDisableWakeupApi = 1
      IcuEdgeCountApi = 1
      IcuEdgeDetectApi = 1
      IcuEnableWakeupApi = 1
      IcuGetDutyCycleValuesApi = 1
      IcuGetInputStateApi = 1
      IcuGetTimeElapsedApi = 1
      IcuGetVersionInfoApi = 1
      IcuSafetyFunctionApi = 1
      IcuSetModeApi = 1
      IcuSignalMeasurementApi = 1
      IcuTimestampApi = 1
      IcuWakeupFunctionalityApi = 1
package /Adc
  module config Adc: implementation-config-variant=VARIANT-PRE-COMPILE, module-description=Adc_Impl
    AdcConfigSet_0 (AdcConfigSet)
      AdcHwUnit_0 (AdcHwUnit): AdcClockSource=PCLK2, AdcHwUnitId=HwUnit0, AdcPrescale=1
        20 x AdcChannel, all with AdcChannelConvTime=4, AdcChannelResolution=12:
          AIRBAGDIAG_ANG_MCU_IN: AdcChannelId=4, AdcChannelRefVoltsrcHigh=ADC_NOT_USED, AdcChannelRefVoltsrcLow=ADC_NOT_USED, AdcChannelSampTime=44
          FUELSENDER_ANG_MCU_IN: AdcChannelId=16, AdcChannelRefVoltsrcHigh=ADC_NOT_USED, AdcChannelRefVoltsrcLow=ADC_NOT_USED, AdcChannelSampTime=44
          FUEL_1M_AN47_MCU_IN: AdcChannelId=47, AdcChannelSampTime=200
          FUEL_1P_AN46_MCU_IN: AdcChannelId=46, AdcChannelSampTime=200
          FUEL_2M_AN49_MCU_IN: AdcChannelId=49, AdcChannelSampTime=200
          FUEL_2P_AN48_MCU_IN: AdcChannelId=48, AdcChannelSampTime=200
          SBATTMON_ANG_MCU_IN: AdcChannelId=18, AdcChannelRefVoltsrcHigh=ADC_NOT_USED, AdcChannelRefVoltsrcLow=ADC_NOT_USED, AdcChannelSampTime=44
          SFUELBATTMON_ANG_MCU_IN: AdcChannelId=21, AdcChannelRefVoltsrcHigh=ADC_NOT_USED, AdcChannelRefVoltsrcLow=ADC_NOT_USED, AdcChannelSampTime=44
          TACHO_1M_AN35_MCU_IN: AdcChannelId=35, AdcChannelSampTime=200
          TACHO_1P_AN34_MCU_IN: AdcChannelId=34, AdcChannelSampTime=200
          TACHO_2M_AN37_MCU_IN: AdcChannelId=37, AdcChannelSampTime=200
          TACHO_2P_AN36_MCU_IN: AdcChannelId=36, AdcChannelSampTime=200
          TEMP_1M_AN39_MCU_IN: AdcChannelId=39, AdcChannelSampTime=200
          TEMP_1P_AN38_MCU_IN: AdcChannelId=38, AdcChannelSampTime=200
          TEMP_2M_AN41_MCU_IN: AdcChannelId=41, AdcChannelSampTime=200
          TEMP_2P_AN40_MCU_IN: AdcChannelId=40, AdcChannelSampTime=200
          THERM1_ANG_MCU_IN: AdcChannelId=5, AdcChannelSampTime=44
          THERM2_ANG_MCU_IN: AdcChannelId=42, AdcChannelRefVoltsrcHigh=ADC_NOT_USED, AdcChannelRefVoltsrcLow=ADC_NOT_USED, AdcChannelSampTime=44
          TRIPSW1_ANG_MCU_IN: AdcChannelId=22, AdcChannelSampTime=44
          TRIPSW2_ANG_MCU_IN: AdcChannelId=15, AdcChannelRefVoltsrcHigh=ADC_NOT_USED, AdcChannelRefVoltsrcLow=ADC_NOT_USED, AdcChannelSampTime=44
        22 x AdcGroup, all with AdcGroupAccessMode=ADC_ACCESS_MODE_SINGLE, AdcGroupConversionMode=ADC_CONV_MODE_ONESHOT, AdcGroupTriggSrc=ADC_TRIGG_SRC_SW, AdcHwTrigSignal=ADC_HW_TRIG_FALLING_EDGE, AdcStreamingBufferMode=ADC_STREAM_BUFFER_LINEAR, AdcStreamingNumSamples=1:
          AdcGroup_AIRBAGDIAG_ANG_MCU_IN: AdcFirstLogicalChannel=26, AdcGroupId=65806, AdcGroupPriority=9, AdcGroupReplacement=ADC_GROUP_REPL_SUSPEND_RESUME, AdcGroupDefinition=AdcHwUnit_0/AIRBAGDIAG_ANG_MCU_IN
          AdcGroup_FUELSENDER_ANG_MCU_IN: AdcFirstLogicalChannel=34, AdcGroupId=65807, AdcGroupPriority=11, AdcGroupReplacement=ADC_GROUP_REPL_SUSPEND_RESUME, AdcGroupDefinition=AdcHwUnit_0/FUELSENDER_ANG_MCU_IN
          AdcGroup_Fuel_1M: AdcFirstLogicalChannel=14, AdcGroupId=65802, AdcGroupPriority=2, AdcGroupReplacement=ADC_GROUP_REPL_ABORT_RESTART, AdcGroupDefinition=AdcHwUnit_0/FUEL_1M_AN47_MCU_IN
          AdcGroup_Fuel_1P: AdcFirstLogicalChannel=13, AdcGroupId=65801, AdcGroupPriority=249, AdcGroupReplacement=ADC_GROUP_REPL_ABORT_RESTART, AdcGroupDefinition=AdcHwUnit_0/FUEL_1P_AN46_MCU_IN
          AdcGroup_Fuel_2M: AdcFirstLogicalChannel=16, AdcGroupId=65804, AdcGroupPriority=1, AdcGroupReplacement=ADC_GROUP_REPL_ABORT_RESTART, AdcGroupDefinition=AdcHwUnit_0/FUEL_2M_AN49_MCU_IN
          AdcGroup_Fuel_2P: AdcFirstLogicalChannel=15, AdcGroupId=65803, AdcGroupPriority=248, AdcGroupReplacement=ADC_GROUP_REPL_ABORT_RESTART, AdcGroupDefinition=AdcHwUnit_0/FUEL_2P_AN48_MCU_IN
          AdcGroup_IoHwAb: AdcFirstLogicalChannel=27, AdcGroupId=67328, AdcGroupPriority=0, AdcGroupReplacement=ADC_GROUP_REPL_SUSPEND_RESUME, AdcGroupDefinition=AdcHwUnit_0/FUELSENDER_ANG_MCU_IN, AdcGroupDefinition=AdcHwUnit_0/TRIPSW2_ANG_MCU_IN, AdcGroupDefinition=AdcHwUnit_0/SBATTMON_ANG_MCU_IN, AdcGroupDefinition=AdcHwUnit_0/THERM2_ANG_MCU_IN, AdcGroupDefinition=AdcHwUnit_0/SFUELBATTMON_ANG_MCU_IN, AdcGroupDefinition=AdcHwUnit_0/TRIPSW1_ANG_MCU_IN, AdcGroupDefinition=AdcHwUnit_0/THERM1_ANG_MCU_IN
          AdcGroup_IoHwAbSafe: AdcFirstLogicalChannel=17, AdcGroupId=67597, AdcGroupPriority=10, AdcGroupReplacement=ADC_GROUP_REPL_SUSPEND_RESUME, AdcGroupDefinition=AdcHwUnit_0/AIRBAGDIAG_ANG_MCU_IN, AdcGroupDefinition=AdcHwUnit_0/FUELSENDER_ANG_MCU_IN, AdcGroupDefinition=AdcHwUnit_0/SBATTMON_ANG_MCU_IN, AdcGroupDefinition=AdcHwUnit_0/SFUELBATTMON_ANG_MCU_IN, AdcGroupDefinition=AdcHwUnit_0/THERM1_ANG_MCU_IN, AdcGroupDefinition=AdcHwUnit_0/THERM2_ANG_MCU_IN, AdcGroupDefinition=AdcHwUnit_0/TRIPSW1_ANG_MCU_IN, AdcGroupDefinition=AdcHwUnit_0/TRIPSW2_ANG_MCU_IN
          AdcGroup_SBATTMON_ANG_MCU_IN: AdcFirstLogicalChannel=36, AdcGroupId=65809, AdcGroupPriority=13, AdcGroupReplacement=ADC_GROUP_REPL_SUSPEND_RESUME, AdcGroupDefinition=AdcHwUnit_0/SBATTMON_ANG_MCU_IN
          AdcGroup_SFUELBATTMON_ANG_MCU_IN: AdcFirstLogicalChannel=38, AdcGroupId=65811, AdcGroupPriority=15, AdcGroupReplacement=ADC_GROUP_REPL_SUSPEND_RESUME, AdcGroupDefinition=AdcHwUnit_0/SFUELBATTMON_ANG_MCU_IN
          AdcGroup_THERM1_ANG_MCU_IN: AdcFirstLogicalChannel=40, AdcGroupId=65813, AdcGroupPriority=17, AdcGroupReplacement=ADC_GROUP_REPL_SUSPEND_RESUME, AdcGroupDefinition=AdcHwUnit_0/THERM1_ANG_MCU_IN
          AdcGroup_THERM2_ANG_MCU_IN: AdcFirstLogicalChannel=37, AdcGroupId=65810, AdcGroupPriority=14, AdcGroupReplacement=ADC_GROUP_REPL_SUSPEND_RESUME, AdcGroupDefinition=AdcHwUnit_0/THERM2_ANG_MCU_IN
          AdcGroup_TRIPSW1_ANG_MCU_IN: AdcFirstLogicalChannel=39, AdcGroupId=65812, AdcGroupPriority=16, AdcGroupReplacement=ADC_GROUP_REPL_SUSPEND_RESUME, AdcGroupDefinition=AdcHwUnit_0/TRIPSW1_ANG_MCU_IN
          AdcGroup_TRIPSW2_ANG_MCU_IN: AdcFirstLogicalChannel=35, AdcGroupId=65808, AdcGroupPriority=12, AdcGroupReplacement=ADC_GROUP_REPL_SUSPEND_RESUME, AdcGroupDefinition=AdcHwUnit_0/TRIPSW2_ANG_MCU_IN
          AdcGroup_Tacho_1M: AdcFirstLogicalChannel=2, AdcGroupId=65794, AdcGroupPriority=8, AdcGroupReplacement=ADC_GROUP_REPL_ABORT_RESTART, AdcGroupDefinition=AdcHwUnit_0/TACHO_1M_AN35_MCU_IN
          AdcGroup_Tacho_1P: AdcFirstLogicalChannel=1, AdcGroupId=65793, AdcGroupPriority=255, AdcGroupReplacement=ADC_GROUP_REPL_ABORT_RESTART, AdcGroupDefinition=AdcHwUnit_0/TACHO_1P_AN34_MCU_IN
          AdcGroup_Tacho_2M: AdcFirstLogicalChannel=4, AdcGroupId=65796, AdcGroupPriority=7, AdcGroupReplacement=ADC_GROUP_REPL_ABORT_RESTART, AdcGroupDefinition=AdcHwUnit_0/TACHO_2M_AN37_MCU_IN
          AdcGroup_Tacho_2P: AdcFirstLogicalChannel=3, AdcGroupId=65795, AdcGroupPriority=254, AdcGroupReplacement=ADC_GROUP_REPL_ABORT_RESTART, AdcGroupDefinition=AdcHwUnit_0/TACHO_2P_AN36_MCU_IN
          AdcGroup_Temp_1M: AdcFirstLogicalChannel=6, AdcGroupId=65798, AdcGroupPriority=6, AdcGroupReplacement=ADC_GROUP_REPL_ABORT_RESTART, AdcGroupDefinition=AdcHwUnit_0/TEMP_1M_AN39_MCU_IN
          AdcGroup_Temp_1P: AdcFirstLogicalChannel=5, AdcGroupId=65797, AdcGroupPriority=253, AdcGroupReplacement=ADC_GROUP_REPL_ABORT_RESTART, AdcGroupDefinition=AdcHwUnit_0/TEMP_1P_AN38_MCU_IN
          AdcGroup_Temp_2M: AdcFirstLogicalChannel=8, AdcGroupId=65800, AdcGroupPriority=5, AdcGroupReplacement=ADC_GROUP_REPL_ABORT_RESTART, AdcGroupDefinition=AdcHwUnit_0/TEMP_2M_AN41_MCU_IN
          AdcGroup_Temp_2P: AdcFirstLogicalChannel=7, AdcGroupId=65799, AdcGroupPriority=252, AdcGroupReplacement=ADC_GROUP_REPL_ABORT_RESTART, AdcGroupDefinition=AdcHwUnit_0/TEMP_2P_AN40_MCU_IN
    AdcGeneral:
      AdcDeInitApi = 1
      AdcDevErrorDetect = 1
      AdcEnableLimitCheck = 0
      AdcEnableQueuing = 1
      AdcEnableStartStopGroupApi = 1
      AdcErrorCalloutFunction = ErrorCalloutHandler
      AdcGrpNotifCapability = 1
      AdcHwTriggerApi = 1
      AdcIncludeFile = ErrorCalloutHandler.h
      AdcIncludeFile = CIoHwAb_AdcCbk.h
      AdcPriorityImplementation = ADC_PRIORITY_HW
      AdcReadGroupApi = 1
      AdcResultAlignment = ADC_ALIGN_RIGHT
      AdcVersionInfoApi = 1
    AdcPublishedInformation: AdcChannelValueSigned=0, AdcGroupFirstChannelFixed=0, AdcMaxChannelResolution=12
package /Port
  module config Port: implementation-config-variant=VARIANT-POST-BUILD-SELECTABLE, module-description=Port_Impl
    PortConfigSet_PSS (PortConfigSet)
      PortContainer_PSS (PortContainer): PortNumberOfPortPins=126, PortResourceInputReference=PortResourceInputConfigSet_PSS
        126 x PortPin, all with PortPinDirectionChangeable=0, PortPinInitialMode=GPIO, PortPinMode=GPIO, PortPinModeChangeable=0:
          PSS_AIRBAGDIAG_ANG_MCU_IN: PortPinDigitalInputEnable=0, PortPinDirection=PORT_PIN_IN, PortPinId=92, PortPinInputLevel=PortPinInputLevelCmosHysteresis, PortPinLevelValue=PORT_PIN_LEVEL_LOW, PortPinName=P228, PortPinNoiseFilterEnable=0, PortPinOutputDrive=PortPinOutputDrive2mA, PortPinPullUpDown=PortPinPullUpDownDisabled
          PSS_AIRBAGMON_ANG_MCU_IN: PortPinDigitalInputEnable=0, PortPinDirection=PORT_PIN_IN, PortPinId=108, PortPinInputLevel=PortPinInputLevelCmosHysteresis, PortPinLevelValue=PORT_PIN_LEVEL_LOW, PortPinName=P312, PortPinNoiseFilterEnable=0, PortPinOutputDrive=PortPinOutputDrive5mA, PortPinPullUpDown=PortPinPullUpDownDisabled
          PSS_ALTL_AL_MCU_IN: PortPinDigitalInputEnable=0, PortPinDirection=PORT_PIN_IN, PortPinId=83, PortPinInputLevel=PortPinInputLevelCmosHysteresis, PortPinLevelValue=PORT_PIN_LEVEL_LOW, PortPinName=P219, PortPinNoiseFilterEnable=0, PortPinOutputDrive=PortPinOutputDriveNoOutput, PortPinPullUpDown=PortPinPullUpDownDisabled
          PSS_CCANRX_NETWRK_MCU_IN: PortPinDigitalInputEnable=1, PortPinDirection=PORT_PIN_IN, PortPinId=99, PortPinInputLevel=PortPinInputLevelCmosHysteresis, PortPinLevelValue=PORT_PIN_LEVEL_LOW, PortPinName=P303, PortPinNoiseFilterEnable=0, PortPinOutputDrive=PortPinOutputDrive1mA, PortPinPullUpDown=PortPinPullUpDownDisabled
          PSS_CCANSTANDBY_DIG_MCU_OUT: PortPinDigitalInputEnable=0, PortPinDirection=PORT_PIN_OUT, PortPinId=98, PortPinInputLevel=PortPinInputLevelCmosHysteresis, PortPinLevelValue=PORT_PIN_LEVEL_HIGH, PortPinName=P302, PortPinNoiseFilterEnable=0, PortPinOutputDrive=PortPinOutputDrive1mA, PortPinPullUpDown=PortPinPullUpDownDisabled
          PSS_CCANTX_NETWRK_MCU_OUT: PortPinDigitalInputEnable=0, PortPinDirection=PORT_PIN_OUT, PortPinId=100, PortPinInputLevel=PortPinInputLevelCmosHysteresis, PortPinLevelValue=PORT_PIN_LEVEL_HIGH, PortPinName=P304, PortPinNoiseFilterEnable=0, PortPinOutputDrive=PortPinOutputDrive5mA, PortPinPullUpDown=PortPinPullUpDownDisabled
          PSS_DRIVE_MODE_SW_AL_MCU_IN: PortPinDigitalInputEnable=0, PortPinDirection=PORT_PIN_IN, PortPinId=107, PortPinInputLevel=PortPinInputLevelCmosHysteresis, PortPinLevelValue=PORT_PIN_LEVEL_LOW, PortPinName=P311, PortPinNoiseFilterEnable=0, PortPinOutputDrive=PortPinOutputDrive1mA, PortPinPullUpDown=PortPinPullUpDownDisabled
          PSS_EEPRM_PWR_SPLY_MCU_OUT: PortPinDigitalInputEnable=0, PortPinDirection=PORT_PIN_IN, PortPinId=187, PortPinInputLevel=PortPinInputLevelCmosHysteresis, PortPinLevelValue=PORT_PIN_LEVEL_LOW, PortPinName=P527, PortPinNoiseFilterEnable=0, PortPinOutputDrive=PortPinOutputDrive2mA, PortPinPullUpDown=PortPinPullDown
          PSS_EE_SCL: PortPinDigitalInputEnable=1, PortPinDirection=PORT_PIN_OUT, PortPinId=97, PortPinInputLevel=PortPinInputLevelCmosHysteresis, PortPinLevelValue=PORT_PIN_LEVEL_HIGH, PortPinName=P301, PortPinNoiseFilterEnable=1, PortPinOutputDrive=PortPinOutputDrive1mA, PortPinPullUpDown=PortPinPullUpDownDisabled
          PSS_EE_SDA: PortPinDigitalInputEnable=1, PortPinDirection=PORT_PIN_OUT, PortPinId=96, PortPinInputLevel=PortPinInputLevelCmosHysteresis, PortPinLevelValue=PORT_PIN_LEVEL_HIGH, PortPinName=P300, PortPinNoiseFilterEnable=1, PortPinOutputDrive=PortPinOutputDrive5mA, PortPinPullUpDown=PortPinPullUpDownDisabled
          PSS_FUELSENDER_ANG_MCU_IN: PortPinDigitalInputEnable=0, PortPinDirection=PORT_PIN_IN, PortPinId=104, PortPinInputLevel=PortPinInputLevelCmosHysteresis, PortPinLevelValue=PORT_PIN_LEVEL_LOW, PortPinName=P308, PortPinNoiseFilterEnable=0, PortPinOutputDrive=PortPinOutputDrive1mA, PortPinPullUpDown=PortPinPullUpDownDisabled
          PSS_FUEL_1_M_PWM_MCU_OUT: PortPinDigitalInputEnable=0, PortPinDirection=PORT_PIN_OUT, PortPinId=138, PortPinInputLevel=PortPinInputLevelCmosHysteresis, PortPinLevelValue=PORT_PIN_LEVEL_LOW, PortPinName=P410, PortPinNoiseFilterEnable=0, PortPinOutputDrive=PortPinOutputDrive1mA, PortPinPullUpDown=PortPinPullUpDownDisabled
          PSS_FUEL_1_P_PWM_MCU_OUT: PortPinDigitalInputEnable=0, PortPinDirection=PORT_PIN_OUT, PortPinId=137, PortPinInputLevel=PortPinInputLevelCmosHysteresis, PortPinLevelValue=PORT_PIN_LEVEL_LOW, PortPinName=P409, PortPinNoiseFilterEnable=0, PortPinOutputDrive=PortPinOutputDrive1mA, PortPinPullUpDown=PortPinPullUpDownDisabled
          PSS_FUEL_2_M_PWM_MCU_OUT: PortPinDigitalInputEnable=0, PortPinDirection=PORT_PIN_OUT, PortPinId=140, PortPinInputLevel=PortPinInputLevelCmosHysteresis, PortPinLevelValue=PORT_PIN_LEVEL_LOW, PortPinName=P412, PortPinNoiseFilterEnable=0, PortPinOutputDrive=PortPinOutputDrive1mA, PortPinPullUpDown=PortPinPullUpDownDisabled
          PSS_FUEL_2_P_PWM_MCU_OUT: PortPinDigitalInputEnable=0, PortPinDirection=PORT_PIN_OUT, PortPinId=139, PortPinInputLevel=PortPinInputLevelCmosHysteresis, PortPinLevelValue=PORT_PIN_LEVEL_LOW, PortPinName=P411, PortPinNoiseFilterEnable=0, PortPinOutputDrive=PortPinOutputDrive1mA, PortPinPullUpDown=PortPinPullUpDownDisabled
          PSS_GAUGEDIAL_PWM_MCU_OUT: PortPinDigitalInputEnable=0, PortPinDirection=PORT_PIN_OUT, PortPinId=117, PortPinInputLevel=PortPinInputLevelCmosHysteresis, PortPinLevelValue=PORT_PIN_LEVEL_LOW, PortPinName=P321, PortPinNoiseFilterEnable=0, PortPinOutputDrive=PortPinOutputDrive5mA, PortPinPullUpDown=PortPinPullUpDownDisabled
          PSS_GAUGEPNTR_PWM_MCU_OUT: PortPinDigitalInputEnable=0, PortPinDirection=PORT_PIN_OUT, PortPinId=119, PortPinInputLevel=PortPinInputLevelCmosHysteresis, PortPinLevelValue=PORT_PIN_LEVEL_LOW, PortPinName=P323, PortPinNoiseFilterEnable=0, PortPinOutputDrive=PortPinOutputDrive2mA, PortPinPullUpDown=PortPinPullUpDownDisabled
          PSS_Hyper_FLASH_CK: PortPinDigitalInputEnable=0, PortPinDirection=PORT_PIN_IN, PortPinId=4, PortPinInputLevel=PortPinInputLevelCmosHysteresis, PortPinLevelValue=PORT_PIN_LEVEL_LOW, PortPinName=P004, PortPinNoiseFilterEnable=0, PortPinOutputDrive=PortPinOutputDrive2mA, PortPinPullUpDown=PortPinPullUpDownDisabled
          PSS_Hyper_FLASH_CS1: PortPinDigitalInputEnable=0, PortPinDirection=PORT_PIN_OUT, PortPinId=9, PortPinInputLevel=PortPinInputLevelCmosHysteresis, PortPinLevelValue=PORT_PIN_LEVEL_HIGH, PortPinName=P009, PortPinNoiseFilterEnable=0, PortPinOutputDrive=PortPinOutputDrive2mA, PortPinPullUpDown=PortPinPullUpDownDisabled
          PSS_Hyper_FLASH_CS2: PortPinDigitalInputEnable=0, PortPinDirection=PORT_PIN_OUT, PortPinId=11, PortPinInputLevel=PortPinInputLevelCmosHysteresis, PortPinLevelValue=PORT_PIN_LEVEL_HIGH, PortPinName=P011, PortPinNoiseFilterEnable=0, PortPinOutputDrive=PortPinOutputDrive2mA, PortPinPullUpDown=PortPinPullUpDownDisabled
          PSS_Hyper_FLASH_DQ0: PortPinDigitalInputEnable=0, PortPinDirection=PORT_PIN_IN, PortPinId=8, PortPinInputLevel=PortPinInputLevelCmosHysteresis, PortPinLevelValue=PORT_PIN_LEVEL_LOW, PortPinName=P008, PortPinNoiseFilterEnable=0, PortPinOutputDrive=PortPinOutputDrive2mA, PortPinPullUpDown=PortPinPullUpDownDisabled
          PSS_Hyper_FLASH_DQ1: PortPinDigitalInputEnable=0, PortPinDirection=PORT_PIN_IN, PortPinId=7, PortPinInputLevel=PortPinInputLevelCmosHysteresis, PortPinLevelValue=PORT_PIN_LEVEL_LOW, PortPinName=P007, PortPinNoiseFilterEnable=0, PortPinOutputDrive=PortPinOutputDrive2mA, PortPinPullUpDown=PortPinPullUpDownDisabled
          PSS_Hyper_FLASH_DQ2: PortPinDigitalInputEnable=0, PortPinDirection=PORT_PIN_IN, PortPinId=6, PortPinInputLevel=PortPinInputLevelCmosHysteresis, PortPinLevelValue=PORT_PIN_LEVEL_LOW, PortPinName=P006, PortPinNoiseFilterEnable=0, PortPinOutputDrive=PortPinOutputDrive2mA, PortPinPullUpDown=PortPinPullUpDownDisabled
          PSS_Hyper_FLASH_DQ3: PortPinDigitalInputEnable=0, PortPinDirection=PORT_PIN_IN, PortPinId=5, PortPinInputLevel=PortPinInputLevelCmosHysteresis, PortPinLevelValue=PORT_PIN_LEVEL_LOW, PortPinName=P005, PortPinNoiseFilterEnable=0, PortPinOutputDrive=PortPinOutputDrive2mA, PortPinPullUpDown=PortPinPullUpDownDisabled
          PSS_Hyper_FLASH_DQ4: PortPinDigitalInputEnable=0, PortPinDirection=PORT_PIN_IN, PortPinId=12, PortPinInputLevel=PortPinInputLevelCmosHysteresis, PortPinLevelValue=PORT_PIN_LEVEL_LOW, PortPinName=P012, PortPinNoiseFilterEnable=0, PortPinOutputDrive=PortPinOutputDrive2mA, PortPinPullUpDown=PortPinPullUpDownDisabled
          PSS_Hyper_FLASH_DQ5: PortPinDigitalInputEnable=0, PortPinDirection=PORT_PIN_IN, PortPinId=13, PortPinInputLevel=PortPinInputLevelCmosHysteresis, PortPinLevelValue=PORT_PIN_LEVEL_LOW, PortPinName=P013, PortPinNoiseFilterEnable=0, PortPinOutputDrive=PortPinOutputDrive2mA, PortPinPullUpDown=PortPinPullUpDownDisabled
          PSS_Hyper_FLASH_DQ6: PortPinDigitalInputEnable=0, PortPinDirection=PORT_PIN_IN, PortPinId=14, PortPinInputLevel=PortPinInputLevelCmosHysteresis, PortPinLevelValue=PORT_PIN_LEVEL_LOW, PortPinName=P014, PortPinNoiseFilterEnable=0, PortPinOutputDrive=PortPinOutputDrive2mA, PortPinPullUpDown=PortPinPullUpDownDisabled
          PSS_Hyper_FLASH_DQ7: PortPinDigitalInputEnable=0, PortPinDirection=PORT_PIN_IN, PortPinId=15, PortPinInputLevel=PortPinInputLevelCmosHysteresis, PortPinLevelValue=PORT_PIN_LEVEL_LOW, PortPinName=P015, PortPinNoiseFilterEnable=0, PortPinOutputDrive=PortPinOutputDrive2mA, PortPinPullUpDown=PortPinPullUpDownDisabled
          PSS_Hyper_FLASH_RWDS: PortPinDigitalInputEnable=0, PortPinDirection=PORT_PIN_IN, PortPinId=10, PortPinInputLevel=PortPinInputLevelCmosHysteresis, PortPinLevelValue=PORT_PIN_LEVEL_LOW, PortPinName=P010, PortPinNoiseFilterEnable=0, PortPinOutputDrive=PortPinOutputDrive5mA, PortPinPullUpDown=PortPinPullUpDownDisabled
          PSS_IGNSENSE_DIGAL_MCU_IN: PortPinDigitalInputEnable=1, PortPinDirection=PORT_PIN_IN, PortPinId=102, PortPinInputLevel=PortPinInputLevelCmosHysteresis, PortPinLevelValue=PORT_PIN_LEVEL_LOW, PortPinName=P306, PortPinNoiseFilterEnable=0, PortPinOutputDrive=PortPinOutputDrive1mA, PortPinPullUpDown=PortPinPullUpDownDisabled
          PSS_ILLUMOUT_PWM_MCU_OUT: PortPinDigitalInputEnable=0, PortPinDirection=PORT_PIN_OUT, PortPinId=123, PortPinInputLevel=PortPinInputLevelCmosHysteresis, PortPinLevelValue=PORT_PIN_LEVEL_LOW, PortPinName=P327, PortPinNoiseFilterEnable=0, PortPinOutputDrive=PortPinOutputDrive5mA, PortPinPullUpDown=PortPinPullUpDownDisabled
          PSS_IMMOBILIZER_IN_DIG_MCU_IN_PROTECTED: PortPinDigitalInputEnable=0, PortPinDirection=PORT_PIN_OUT, PortPinId=35, PortPinInputLevel=PortPinInputLevelCmosHysteresis, PortPinLevelValue=PORT_PIN_LEVEL_LOW, PortPinName=P103, PortPinNoiseFilterEnable=0, PortPinOutputDrive=PortPinOutputDrive5mA, PortPinPullUpDown=PortPinPullUpDownDisabled
          PSS_MCANENB_DIG_MCU_OUT: PortPinDigitalInputEnable=0, PortPinDirection=PORT_PIN_OUT, PortPinId=101, PortPinInputLevel=PortPinInputLevelCmosHysteresis, PortPinLevelValue=PORT_PIN_LEVEL_LOW, PortPinName=P305, PortPinNoiseFilterEnable=0, PortPinOutputDrive=PortPinOutputDrive2mA, PortPinPullUpDown=PortPinPullUpDownDisabled
          PSS_MCANERR_DIG_MCU_IN: PortPinDigitalInputEnable=0, PortPinDirection=PORT_PIN_IN, PortPinId=114, PortPinInputLevel=PortPinInputLevelCmosHysteresis, PortPinLevelValue=PORT_PIN_LEVEL_LOW, PortPinName=P318, PortPinNoiseFilterEnable=0, PortPinOutputDrive=PortPinOutputDrive2mA, PortPinPullUpDown=PortPinPullUpDownDisabled
          PSS_MCANRX_NETWRK_MCU_IN: PortPinDigitalInputEnable=1, PortPinDirection=PORT_PIN_IN, PortPinId=112, PortPinInputLevel=PortPinInputLevelCmosHysteresis, PortPinLevelValue=PORT_PIN_LEVEL_LOW, PortPinName=P316, PortPinNoiseFilterEnable=0, PortPinOutputDrive=PortPinOutputDrive1mA, PortPinPullUpDown=PortPinPullUpDownDisabled
          PSS_MCANSTBY_DIG_MCU_OUT: PortPinDigitalInputEnable=0, PortPinDirection=PORT_PIN_OUT, PortPinId=111, PortPinInputLevel=PortPinInputLevelCmosHysteresis, PortPinLevelValue=PORT_PIN_LEVEL_LOW, PortPinName=P315, PortPinNoiseFilterEnable=0, PortPinOutputDrive=PortPinOutputDrive1mA, PortPinPullUpDown=PortPinPullUpDownDisabled
          PSS_MCANTXNETWRK_MCU_OUT: PortPinDigitalInputEnable=0, PortPinDirection=PORT_PIN_OUT, PortPinId=113, PortPinInputLevel=PortPinInputLevelCmosHysteresis, PortPinLevelValue=PORT_PIN_LEVEL_HIGH, PortPinName=P317, PortPinNoiseFilterEnable=0, PortPinOutputDrive=PortPinOutputDrive5mA, PortPinPullUpDown=PortPinPullUpDownDisabled
          PSS_OILPRESSSW_AL_MCU_IN: PortPinDigitalInputEnable=0, PortPinDirection=PORT_PIN_IN, PortPinId=136, PortPinInputLevel=PortPinInputLevelCmosHysteresis, PortPinLevelValue=PORT_PIN_LEVEL_LOW, PortPinName=P408, PortPinNoiseFilterEnable=0, PortPinOutputDrive=PortPinOutputDrive1mA, PortPinPullUpDown=PortPinPullUpDownDisabled
          PSS_POWER_FAULT: PortPinDigitalInputEnable=0, PortPinDirection=PORT_PIN_IN, PortPinId=16, PortPinInputLevel=PortPinInputLevelCmosHysteresis, PortPinLevelValue=PORT_PIN_LEVEL_LOW, PortPinName=P016, PortPinNoiseFilterEnable=0, PortPinOutputDrive=PortPinOutputDrive5mA, PortPinPullUpDown=PortPinPullUpDownDisabled
          PSS_RESET_CON: PortPinDigitalInputEnable=0, PortPinDirection=PORT_PIN_OUT, PortPinId=31, PortPinInputLevel=PortPinInputLevelCmosHysteresis, PortPinLevelValue=PORT_PIN_LEVEL_LOW, PortPinName=P031, PortPinNoiseFilterEnable=0, PortPinOutputDrive=PortPinOutputDrive5mA, PortPinPullUpDown=PortPinPullUpDownDisabled
          PSS_RHEDOWNSW_AL_MCU_IN: PortPinDigitalInputEnable=0, PortPinDirection=PORT_PIN_OUT, PortPinId=157, PortPinInputLevel=PortPinInputLevelCmosHysteresis, PortPinLevelValue=PORT_PIN_LEVEL_LOW, PortPinName=P429, PortPinNoiseFilterEnable=0, PortPinOutputDrive=PortPinOutputDrive2mA, PortPinPullUpDown=PortPinPullUpDownDisabled
          PSS_RHEUPSW_AL_MCU_IN: PortPinDigitalInputEnable=0, PortPinDirection=PORT_PIN_OUT, PortPinId=158, PortPinInputLevel=PortPinInputLevelCmosHysteresis, PortPinLevelValue=PORT_PIN_LEVEL_LOW, PortPinName=P430, PortPinNoiseFilterEnable=0, PortPinOutputDrive=PortPinOutputDrive2mA, PortPinPullUpDown=PortPinPullUpDownDisabled
          PSS_RT_CLK: PortPinDigitalInputEnable=0, PortPinDirection=PORT_PIN_OUT, PortPinId=120, PortPinInputLevel=PortPinInputLevelCmosHysteresis, PortPinLevelValue=PORT_PIN_LEVEL_LOW, PortPinName=P324, PortPinNoiseFilterEnable=0, PortPinOutputDrive=PortPinOutputDrive5mA, PortPinPullUpDown=PortPinPullUpDownDisabled
          PSS_RT_CLK_1V2SW: PortPinDigitalInputEnable=0, PortPinDirection=PORT_PIN_OUT, PortPinId=190, PortPinInputLevel=PortPinInputLevelCmosHysteresis, PortPinLevelValue=PORT_PIN_LEVEL_LOW, PortPinName=P530, PortPinNoiseFilterEnable=0, PortPinOutputDrive=PortPinOutputDrive2mA, PortPinPullUpDown=PortPinPullDown
          PSS_SBATT2ILLUMSPLY_MCU_OUT: PortPinDigitalInputEnable=0, PortPinDirection=PORT_PIN_OUT, PortPinId=28, PortPinInputLevel=PortPinInputLevelCmosHysteresis, PortPinLevelValue=PORT_PIN_LEVEL_LOW, PortPinName=P028, PortPinNoiseFilterEnable=0, PortPinOutputDrive=PortPinOutputDrive5mA, PortPinPullUpDown=PortPinPullUpDownDisabled
          PSS_SBATTFUEL_MCU_OUT: PortPinDigitalInputEnable=0, PortPinDirection=PORT_PIN_OUT, PortPinId=0, PortPinInputLevel=PortPinInputLevelCmosHysteresis, PortPinLevelValue=PORT_PIN_LEVEL_LOW, PortPinName=P000, PortPinNoiseFilterEnable=0, PortPinOutputDrive=PortPinOutputDrive5mA, PortPinPullUpDown=PortPinPullDown
          PSS_SBATTMON_ANG_MCU_IN: PortPinDigitalInputEnable=0, PortPinDirection=PORT_PIN_IN, PortPinId=106, PortPinInputLevel=PortPinInputLevelCmosHysteresis, PortPinLevelValue=PORT_PIN_LEVEL_LOW, PortPinName=P310, PortPinNoiseFilterEnable=0, PortPinOutputDrive=PortPinOutputDrive1mA, PortPinPullUpDown=PortPinPullUpDownDisabled
          PSS_SBATT_CHIME_MCU_OUT: PortPinDigitalInputEnable=0, PortPinDirection=PORT_PIN_OUT, PortPinId=38, PortPinInputLevel=PortPinInputLevelCmosHysteresis, PortPinLevelValue=PORT_PIN_LEVEL_LOW, PortPinName=P106, PortPinNoiseFilterEnable=0, PortPinOutputDrive=PortPinOutputDrive5mA, PortPinPullUpDown=PortPinPullUpDownDisabled
          PSS_SBATT_DIG_MCU_OUT: PortPinDigitalInputEnable=0, PortPinDirection=PORT_PIN_OUT, PortPinId=18, PortPinInputLevel=PortPinInputLevelTtl, PortPinLevelValue=PORT_PIN_LEVEL_LOW, PortPinName=P018, PortPinNoiseFilterEnable=0, PortPinOutputDrive=PortPinOutputDrive5mA, PortPinPullUpDown=PortPinPullUpDownDisabled
          PSS_SFUELBATTMON_ANG_MCU_IN: PortPinDigitalInputEnable=0, PortPinDirection=PORT_PIN_IN, PortPinId=109, PortPinInputLevel=PortPinInputLevelCmosHysteresis, PortPinLevelValue=PORT_PIN_LEVEL_LOW, PortPinName=P313, PortPinNoiseFilterEnable=0, PortPinOutputDrive=PortPinOutputDrive1mA, PortPinPullUpDown=PortPinPullUpDownDisabled
          PSS_SPDSRGSEROUT_DIG_MCU_IN: PortPinDigitalInputEnable=0, PortPinDirection=PORT_PIN_IN, PortPinId=19, PortPinInputLevel=PortPinInputLevelCmosHysteresis, PortPinLevelValue=PORT_PIN_LEVEL_LOW, PortPinName=P019, PortPinNoiseFilterEnable=0, PortPinOutputDrive=PortPinOutputDrive2mA, PortPinPullUpDown=PortPinPullDown
          PSS_SPEEDIN_DIGAL_MCU_IN_PROTECTED: PortPinDigitalInputEnable=0, PortPinDirection=PORT_PIN_OUT, PortPinId=134, PortPinInputLevel=PortPinInputLevelCmosHysteresis, PortPinLevelValue=PORT_PIN_LEVEL_LOW, PortPinName=P406, PortPinNoiseFilterEnable=0, PortPinOutputDrive=PortPinOutputDrive1mA, PortPinPullUpDown=PortPinPullUpDownDisabled
          PSS_SPEEDOLED_PWM_MCU_OUT: PortPinDigitalInputEnable=0, PortPinDirection=PORT_PIN_OUT, PortPinId=122, PortPinInputLevel=PortPinInputLevelCmosHysteresis, PortPinLevelValue=PORT_PIN_LEVEL_LOW, PortPinName=P326, PortPinNoiseFilterEnable=0, PortPinOutputDrive=PortPinOutputDrive5mA, PortPinPullUpDown=PortPinPullUpDownDisabled
          PSS_SPEEDOUT_PULSE_MCU_OUT: PortPinDigitalInputEnable=0, PortPinDirection=PORT_PIN_OUT, PortPinId=121, PortPinInputLevel=PortPinInputLevelCmosHysteresis, PortPinLevelValue=PORT_PIN_LEVEL_LOW, PortPinName=P325, PortPinNoiseFilterEnable=0, PortPinOutputDrive=PortPinOutputDrive5mA, PortPinPullUpDown=PortPinPullUpDownDisabled
          PSS_SPKRCOMPSGN_PWM_MCU_OUT: PortPinDigitalInputEnable=0, PortPinDirection=PORT_PIN_OUT, PortPinId=91, PortPinInputLevel=PortPinInputLevelCmosHysteresis, PortPinLevelValue=PORT_PIN_LEVEL_LOW, PortPinName=P227, PortPinNoiseFilterEnable=0, PortPinOutputDrive=PortPinOutputDrive1mA, PortPinPullUpDown=PortPinPullUpDownDisabled
          PSS_SPKRTICTOC_PWM_MCU_OUT: PortPinDigitalInputEnable=0, PortPinDirection=PORT_PIN_OUT, PortPinId=88, PortPinInputLevel=PortPinInputLevelCmosHysteresis, PortPinLevelValue=PORT_PIN_LEVEL_LOW, PortPinName=P224, PortPinNoiseFilterEnable=0, PortPinOutputDrive=PortPinOutputDrive1mA, PortPinPullUpDown=PortPinPullUpDownDisabled
          PSS_SW5VEPRM_DIG_MCU_OUT_PROTECTED: PortPinDigitalInputEnable=0, PortPinDirection=PORT_PIN_OUT, PortPinId=17, PortPinInputLevel=PortPinInputLevelCmosHysteresis, PortPinLevelValue=PORT_PIN_LEVEL_LOW, PortPinName=P017, PortPinNoiseFilterEnable=0, PortPinOutputDrive=PortPinOutputDrive2mA, PortPinPullUpDown=PortPinPullDown
          PSS_SW5VEXT_DIG_MCU_OUT: PortPinDigitalInputEnable=0, PortPinDirection=PORT_PIN_OUT, PortPinId=116, PortPinInputLevel=PortPinInputLevelCmosHysteresis, PortPinLevelValue=PORT_PIN_LEVEL_HIGH, PortPinName=P320, PortPinNoiseFilterEnable=0, PortPinOutputDrive=PortPinOutputDrive1mA, PortPinPullUpDown=PortPinPullUpDownDisabled
          PSS_SW_3V3_EN_DIG_MCU_OUT: PortPinDigitalInputEnable=0, PortPinDirection=PORT_PIN_OUT, PortPinId=86, PortPinInputLevel=PortPinInputLevelCmosHysteresis, PortPinLevelValue=PORT_PIN_LEVEL_LOW, PortPinName=P222, PortPinNoiseFilterEnable=0, PortPinOutputDrive=PortPinOutputDrive5mA, PortPinPullUpDown=PortPinPullUpDownDisabled
          PSS_SW_5V_EN_DIG_MCU_OUT: PortPinDigitalInputEnable=0, PortPinDirection=PORT_PIN_OUT, PortPinId=115, PortPinInputLevel=PortPinInputLevelCmosHysteresis, PortPinLevelValue=PORT_PIN_LEVEL_LOW, PortPinName=P319, PortPinNoiseFilterEnable=0, PortPinOutputDrive=PortPinOutputDrive5mA, PortPinPullUpDown=PortPinPullUpDownDisabled
          PSS_TACHO_1_M_PWM_MCU_OUT: PortPinDigitalInputEnable=0, PortPinDirection=PORT_PIN_OUT, PortPinId=126, PortPinInputLevel=PortPinInputLevelCmosHysteresis, PortPinLevelValue=PORT_PIN_LEVEL_LOW, PortPinName=P330, PortPinNoiseFilterEnable=0, PortPinOutputDrive=PortPinOutputDrive1mA, PortPinPullUpDown=PortPinPullUpDownDisabled
          PSS_TACHO_1_P_PWM_MCU_OUT: PortPinDigitalInputEnable=0, PortPinDirection=PORT_PIN_OUT, PortPinId=125, PortPinInputLevel=PortPinInputLevelCmosHysteresis, PortPinLevelValue=PORT_PIN_LEVEL_LOW, PortPinName=P329, PortPinNoiseFilterEnable=0, PortPinOutputDrive=PortPinOutputDrive1mA, PortPinPullUpDown=PortPinPullUpDownDisabled
          PSS_TACHO_2_M_PWM_MCU_OUT: PortPinDigitalInputEnable=0, PortPinDirection=PORT_PIN_OUT, PortPinId=128, PortPinInputLevel=PortPinInputLevelCmosHysteresis, PortPinLevelValue=PORT_PIN_LEVEL_LOW, PortPinName=P400, PortPinNoiseFilterEnable=0, PortPinOutputDrive=PortPinOutputDrive1mA, PortPinPullUpDown=PortPinPullUpDownDisabled
          PSS_TACHO_2_P_PWM_MCU_OUT: PortPinDigitalInputEnable=0, PortPinDirection=PORT_PIN_OUT, PortPinId=127, PortPinInputLevel=PortPinInputLevelCmosHysteresis, PortPinLevelValue=PORT_PIN_LEVEL_LOW, PortPinName=P331, PortPinNoiseFilterEnable=0, PortPinOutputDrive=PortPinOutputDrive1mA, PortPinPullUpDown=PortPinPullUpDownDisabled
          PSS_TEMP_1_M_PWM_MCU_OUT: PortPinDigitalInputEnable=0, PortPinDirection=PORT_PIN_OUT, PortPinId=130, PortPinInputLevel=PortPinInputLevelCmosHysteresis, PortPinLevelValue=PORT_PIN_LEVEL_LOW, PortPinName=P402, PortPinNoiseFilterEnable=0, PortPinOutputDrive=PortPinOutputDrive1mA, PortPinPullUpDown=PortPinPullUpDownDisabled
          PSS_TEMP_1_P_PWM_MCU_OUT: PortPinDigitalInputEnable=0, PortPinDirection=PORT_PIN_OUT, PortPinId=129, PortPinInputLevel=PortPinInputLevelCmosHysteresis, PortPinLevelValue=PORT_PIN_LEVEL_LOW, PortPinName=P401, PortPinNoiseFilterEnable=0, PortPinOutputDrive=PortPinOutputDrive1mA, PortPinPullUpDown=PortPinPullUpDownDisabled
          PSS_TEMP_2_M_PWM_MCU_OUT: PortPinDigitalInputEnable=0, PortPinDirection=PORT_PIN_OUT, PortPinId=132, PortPinInputLevel=PortPinInputLevelCmosHysteresis, PortPinLevelValue=PORT_PIN_LEVEL_LOW, PortPinName=P404, PortPinNoiseFilterEnable=0, PortPinOutputDrive=PortPinOutputDrive1mA, PortPinPullUpDown=PortPinPullUpDownDisabled
          PSS_TEMP_2_P_PWM_MCU_OUT: PortPinDigitalInputEnable=0, PortPinDirection=PORT_PIN_OUT, PortPinId=131, PortPinInputLevel=PortPinInputLevelCmosHysteresis, PortPinLevelValue=PORT_PIN_LEVEL_LOW, PortPinName=P403, PortPinNoiseFilterEnable=0, PortPinOutputDrive=PortPinOutputDrive1mA, PortPinPullUpDown=PortPinPullUpDownDisabled
          PSS_TFT_BLUE2: PortPinDigitalInputEnable=0, PortPinDirection=PORT_PIN_OUT, PortPinId=159, PortPinInputLevel=PortPinInputLevelCmosHysteresis, PortPinLevelValue=PORT_PIN_LEVEL_LOW, PortPinName=P431, PortPinNoiseFilterEnable=0, PortPinOutputDrive=PortPinOutputDrive1mA, PortPinPullUpDown=PortPinPullUpDownDisabled
          PSS_TFT_BLUE3: PortPinDigitalInputEnable=0, PortPinDirection=PORT_PIN_OUT, PortPinId=160, PortPinInputLevel=PortPinInputLevelCmosHysteresis, PortPinLevelValue=PORT_PIN_LEVEL_LOW, PortPinName=P500, PortPinNoiseFilterEnable=0, PortPinOutputDrive=PortPinOutputDrive1mA, PortPinPullUpDown=PortPinPullUpDownDisabled
          PSS_TFT_BLUE4: PortPinDigitalInputEnable=0, PortPinDirection=PORT_PIN_OUT, PortPinId=161, PortPinInputLevel=PortPinInputLevelCmosHysteresis, PortPinLevelValue=PORT_PIN_LEVEL_LOW, PortPinName=P501, PortPinNoiseFilterEnable=0, PortPinOutputDrive=PortPinOutputDrive1mA, PortPinPullUpDown=PortPinPullUpDownDisabled
          PSS_TFT_BLUE5: PortPinDigitalInputEnable=0, PortPinDirection=PORT_PIN_OUT, PortPinId=162, PortPinInputLevel=PortPinInputLevelCmosHysteresis, PortPinLevelValue=PORT_PIN_LEVEL_LOW, PortPinName=P502, PortPinNoiseFilterEnable=0, PortPinOutputDrive=PortPinOutputDrive1mA, PortPinPullUpDown=PortPinPullUpDownDisabled
          PSS_TFT_BLUE6: PortPinDigitalInputEnable=0, PortPinDirection=PORT_PIN_OUT, PortPinId=163, PortPinInputLevel=PortPinInputLevelCmosHysteresis, PortPinLevelValue=PORT_PIN_LEVEL_LOW, PortPinName=P503, PortPinNoiseFilterEnable=0, PortPinOutputDrive=PortPinOutputDrive1mA, PortPinPullUpDown=PortPinPullUpDownDisabled
          PSS_TFT_BLUE7: PortPinDigitalInputEnable=0, PortPinDirection=PORT_PIN_OUT, PortPinId=164, PortPinInputLevel=PortPinInputLevelCmosHysteresis, PortPinLevelValue=PORT_PIN_LEVEL_LOW, PortPinName=P504, PortPinNoiseFilterEnable=0, PortPinOutputDrive=PortPinOutputDrive1mA, PortPinPullUpDown=PortPinPullUpDownDisabled
          PSS_TFT_BL_PWM_OUT: PortPinDigitalInputEnable=0, PortPinDirection=PORT_PIN_OUT, PortPinId=135, PortPinInputLevel=PortPinInputLevelCmosHysteresis, PortPinLevelValue=PORT_PIN_LEVEL_LOW, PortPinName=P407, PortPinNoiseFilterEnable=0, PortPinOutputDrive=PortPinOutputDrive1mA, PortPinPullUpDown=PortPinPullUpDownDisabled
          PSS_TFT_CLK: PortPinDigitalInputEnable=0, PortPinDirection=PORT_PIN_OUT, PortPinId=153, PortPinInputLevel=PortPinInputLevelCmosHysteresis, PortPinLevelValue=PORT_PIN_LEVEL_LOW, PortPinName=P425, PortPinNoiseFilterEnable=0, PortPinOutputDrive=PortPinOutputDrive1mA, PortPinPullUpDown=PortPinPullUpDownDisabled
          PSS_TFT_CSB: PortPinDigitalInputEnable=0, PortPinDirection=PORT_PIN_OUT, PortPinId=30, PortPinInputLevel=PortPinInputLevelCmosHysteresis, PortPinLevelValue=PORT_PIN_LEVEL_HIGH, PortPinName=P030, PortPinNoiseFilterEnable=0, PortPinOutputDrive=PortPinOutputDrive2mA, PortPinPullUpDown=PortPinPullUpDownDisabled
          PSS_TFT_DE: PortPinDigitalInputEnable=0, PortPinDirection=PORT_PIN_OUT, PortPinId=154, PortPinInputLevel=PortPinInputLevelCmosHysteresis, PortPinLevelValue=PORT_PIN_LEVEL_LOW, PortPinName=P426, PortPinNoiseFilterEnable=0, PortPinOutputDrive=PortPinOutputDrive1mA, PortPinPullUpDown=PortPinPullUpDownDisabled
          PSS_TFT_ERR: PortPinDigitalInputEnable=1, PortPinDirection=PORT_PIN_IN, PortPinId=166, PortPinInputLevel=PortPinInputLevelCmosHysteresis, PortPinLevelValue=PORT_PIN_LEVEL_LOW, PortPinName=P506, PortPinNoiseFilterEnable=0, PortPinOutputDrive=PortPinOutputDrive2mA, PortPinPullUpDown=PortPinPullUpDownDisabled
          PSS_TFT_GREEN2: PortPinDigitalInputEnable=0, PortPinDirection=PORT_PIN_OUT, PortPinId=167, PortPinInputLevel=PortPinInputLevelCmosHysteresis, PortPinLevelValue=PORT_PIN_LEVEL_LOW, PortPinName=P507, PortPinNoiseFilterEnable=0, PortPinOutputDrive=PortPinOutputDrive1mA, PortPinPullUpDown=PortPinPullUpDownDisabled
          PSS_TFT_GREEN3: PortPinDigitalInputEnable=0, PortPinDirection=PORT_PIN_OUT, PortPinId=168, PortPinInputLevel=PortPinInputLevelCmosHysteresis, PortPinLevelValue=PORT_PIN_LEVEL_LOW, PortPinName=P508, PortPinNoiseFilterEnable=0, PortPinOutputDrive=PortPinOutputDrive1mA, PortPinPullUpDown=PortPinPullUpDownDisabled
          PSS_TFT_GREEN4: PortPinDigitalInputEnable=0, PortPinDirection=PORT_PIN_OUT, PortPinId=169, PortPinInputLevel=PortPinInputLevelCmosHysteresis, PortPinLevelValue=PORT_PIN_LEVEL_LOW, PortPinName=P509, PortPinNoiseFilterEnable=0, PortPinOutputDrive=PortPinOutputDrive1mA, PortPinPullUpDown=PortPinPullUpDownDisabled
          PSS_TFT_GREEN5: PortPinDigitalInputEnable=0, PortPinDirection=PORT_PIN_OUT, PortPinId=170, PortPinInputLevel=PortPinInputLevelCmosHysteresis, PortPinLevelValue=PORT_PIN_LEVEL_LOW, PortPinName=P510, PortPinNoiseFilterEnable=0, PortPinOutputDrive=PortPinOutputDrive1mA, PortPinPullUpDown=PortPinPullUpDownDisabled
          PSS_TFT_GREEN6: PortPinDigitalInputEnable=0, PortPinDirection=PORT_PIN_OUT, PortPinId=171, PortPinInputLevel=PortPinInputLevelCmosHysteresis, PortPinLevelValue=PORT_PIN_LEVEL_LOW, PortPinName=P511, PortPinNoiseFilterEnable=0, PortPinOutputDrive=PortPinOutputDrive1mA, PortPinPullUpDown=PortPinPullDown
          PSS_TFT_GREEN7: PortPinDigitalInputEnable=0, PortPinDirection=PORT_PIN_OUT, PortPinId=172, PortPinInputLevel=PortPinInputLevelCmosHysteresis, PortPinLevelValue=PORT_PIN_LEVEL_LOW, PortPinName=P512, PortPinNoiseFilterEnable=0, PortPinOutputDrive=PortPinOutputDrive1mA, PortPinPullUpDown=PortPinPullUpDownDisabled
          PSS_TFT_HSYNC: PortPinDigitalInputEnable=0, PortPinDirection=PORT_PIN_OUT, PortPinId=156, PortPinInputLevel=PortPinInputLevelCmosHysteresis, PortPinLevelValue=PORT_PIN_LEVEL_LOW, PortPinName=P428, PortPinNoiseFilterEnable=0, PortPinOutputDrive=PortPinOutputDrive1mA, PortPinPullUpDown=PortPinPullUpDownDisabled
          PSS_TFT_RED2: PortPinDigitalInputEnable=0, PortPinDirection=PORT_PIN_OUT, PortPinId=175, PortPinInputLevel=PortPinInputLevelCmosHysteresis, PortPinLevelValue=PORT_PIN_LEVEL_LOW, PortPinName=P515, PortPinNoiseFilterEnable=0, PortPinOutputDrive=PortPinOutputDrive1mA, PortPinPullUpDown=PortPinPullUpDownDisabled
          PSS_TFT_RED3: PortPinDigitalInputEnable=0, PortPinDirection=PORT_PIN_OUT, PortPinId=176, PortPinInputLevel=PortPinInputLevelCmosHysteresis, PortPinLevelValue=PORT_PIN_LEVEL_LOW, PortPinName=P516, PortPinNoiseFilterEnable=0, PortPinOutputDrive=PortPinOutputDrive1mA, PortPinPullUpDown=PortPinPullUpDownDisabled
          PSS_TFT_RED4: PortPinDigitalInputEnable=0, PortPinDirection=PORT_PIN_OUT, PortPinId=177, PortPinInputLevel=PortPinInputLevelCmosHysteresis, PortPinLevelValue=PORT_PIN_LEVEL_LOW, PortPinName=P517, PortPinNoiseFilterEnable=0, PortPinOutputDrive=PortPinOutputDrive1mA, PortPinPullUpDown=PortPinPullUpDownDisabled
          PSS_TFT_RED5: PortPinDigitalInputEnable=0, PortPinDirection=PORT_PIN_OUT, PortPinId=178, PortPinInputLevel=PortPinInputLevelCmosHysteresis, PortPinLevelValue=PORT_PIN_LEVEL_LOW, PortPinName=P518, PortPinNoiseFilterEnable=0, PortPinOutputDrive=PortPinOutputDrive2mA, PortPinPullUpDown=PortPinPullUpDownDisabled
          PSS_TFT_RED6: PortPinDigitalInputEnable=0, PortPinDirection=PORT_PIN_OUT, PortPinId=179, PortPinInputLevel=PortPinInputLevelCmosHysteresis, PortPinLevelValue=PORT_PIN_LEVEL_LOW, PortPinName=P519, PortPinNoiseFilterEnable=0, PortPinOutputDrive=PortPinOutputDrive1mA, PortPinPullUpDown=PortPinPullUpDownDisabled
          PSS_TFT_RED7: PortPinDigitalInputEnable=0, PortPinDirection=PORT_PIN_OUT, PortPinId=180, PortPinInputLevel=PortPinInputLevelCmosHysteresis, PortPinLevelValue=PORT_PIN_LEVEL_LOW, PortPinName=P520, PortPinNoiseFilterEnable=0, PortPinOutputDrive=PortPinOutputDrive1mA, PortPinPullUpDown=PortPinPullUpDownDisabled
          PSS_TFT_RESET: PortPinDigitalInputEnable=0, PortPinDirection=PORT_PIN_OUT, PortPinId=174, PortPinInputLevel=PortPinInputLevelCmosHysteresis, PortPinLevelValue=PORT_PIN_LEVEL_LOW, PortPinName=P514, PortPinNoiseFilterEnable=0, PortPinOutputDrive=PortPinOutputDrive5mA, PortPinPullUpDown=PortPinPullUpDownDisabled
          PSS_TFT_SCK: PortPinDigitalInputEnable=0, PortPinDirection=PORT_PIN_OUT, PortPinId=27, PortPinInputLevel=PortPinInputLevelCmosHysteresis, PortPinLevelValue=PORT_PIN_LEVEL_LOW, PortPinName=P027, PortPinNoiseFilterEnable=0, PortPinOutputDrive=PortPinOutputDrive2mA, PortPinPullUpDown=PortPinPullUpDownDisabled
          PSS_TFT_SOUT: PortPinDigitalInputEnable=0, PortPinDirection=PORT_PIN_OUT, PortPinId=26, PortPinInputLevel=PortPinInputLevelCmosHysteresis, PortPinLevelValue=PORT_PIN_LEVEL_LOW, PortPinName=P026, PortPinNoiseFilterEnable=0, PortPinOutputDrive=PortPinOutputDrive5mA, PortPinPullUpDown=PortPinPullUpDownDisabled
          PSS_TFT_VSYNC: PortPinDigitalInputEnable=0, PortPinDirection=PORT_PIN_OUT, PortPinId=155, PortPinInputLevel=PortPinInputLevelCmosHysteresis, PortPinLevelValue=PORT_PIN_LEVEL_LOW, PortPinName=P427, PortPinNoiseFilterEnable=0, PortPinOutputDrive=PortPinOutputDrive5mA, PortPinPullUpDown=PortPinPullUpDownDisabled
          PSS_THERM1_ANG_MCU_IN: PortPinDigitalInputEnable=0, PortPinDirection=PORT_PIN_IN, PortPinId=93, PortPinInputLevel=PortPinInputLevelCmosHysteresis, PortPinLevelValue=PORT_PIN_LEVEL_LOW, PortPinName=P229, PortPinNoiseFilterEnable=0, PortPinOutputDrive=PortPinOutputDrive5mA, PortPinPullUpDown=PortPinPullUpDownDisabled
          PSS_THERM2_ANG_MCU_IN: PortPinDigitalInputEnable=0, PortPinDirection=PORT_PIN_IN, PortPinId=133, PortPinInputLevel=PortPinInputLevelCmosHysteresis, PortPinLevelValue=PORT_PIN_LEVEL_LOW, PortPinName=P405, PortPinNoiseFilterEnable=0, PortPinOutputDrive=PortPinOutputDrive1mA, PortPinPullUpDown=PortPinPullUpDownDisabled
          PSS_TRIPSW1_ANG_MCU_IN: PortPinDigitalInputEnable=0, PortPinDirection=PORT_PIN_IN, PortPinId=110, PortPinInputLevel=PortPinInputLevelCmosHysteresis, PortPinLevelValue=PORT_PIN_LEVEL_LOW, PortPinName=P314, PortPinNoiseFilterEnable=0, PortPinOutputDrive=PortPinOutputDrive1mA, PortPinPullUpDown=PortPinPullUpDownDisabled
          PSS_TRIPSW2_ANG_MCU_IN: PortPinDigitalInputEnable=0, PortPinDirection=PORT_PIN_IN, PortPinId=103, PortPinInputLevel=PortPinInputLevelCmosHysteresis, PortPinLevelValue=PORT_PIN_LEVEL_LOW, PortPinName=P307, PortPinNoiseFilterEnable=0, PortPinOutputDrive=PortPinOutputDrive1mA, PortPinPullUpDown=PortPinPullUpDownDisabled
          PSS_TTABS_DIG_MCU_OUT: PortPinDigitalInputEnable=0, PortPinDirection=PORT_PIN_OUT, PortPinId=191, PortPinInputLevel=PortPinInputLevelCmosHysteresis, PortPinLevelValue=PORT_PIN_LEVEL_LOW, PortPinName=P531, PortPinNoiseFilterEnable=0, PortPinOutputDrive=PortPinOutputDrive2mA, PortPinPullUpDown=PortPinPullDown
          PSS_TTAIRBAG_DIG_MCU_OUT: PortPinDigitalInputEnable=0, PortPinDirection=PORT_PIN_OUT, PortPinId=39, PortPinInputLevel=PortPinInputLevelCmosHysteresis, PortPinLevelValue=PORT_PIN_LEVEL_LOW, PortPinName=P107, PortPinNoiseFilterEnable=0, PortPinOutputDrive=PortPinOutputDrive5mA, PortPinPullUpDown=PortPinPullUpDownDisabled
          PSS_TTBATTCHRG_DIG_MCU_OUT: PortPinDigitalInputEnable=0, PortPinDirection=PORT_PIN_OUT, PortPinId=181, PortPinInputLevel=PortPinInputLevelCmosHysteresis, PortPinLevelValue=PORT_PIN_LEVEL_LOW, PortPinName=P521, PortPinNoiseFilterEnable=0, PortPinOutputDrive=PortPinOutputDrive5mA, PortPinPullUpDown=PortPinPullUpDownDisabled
          PSS_TTESCOFF_DIG_MCU_OUT: PortPinDigitalInputEnable=0, PortPinDirection=PORT_PIN_OUT, PortPinId=188, PortPinInputLevel=PortPinInputLevelCmosHysteresis, PortPinLevelValue=PORT_PIN_LEVEL_LOW, PortPinName=P528, PortPinNoiseFilterEnable=0, PortPinOutputDrive=PortPinOutputDrive2mA, PortPinPullUpDown=PortPinPullDown
          PSS_TTESC_DIG_MCU_OUT: PortPinDigitalInputEnable=0, PortPinDirection=PORT_PIN_OUT, PortPinId=1, PortPinInputLevel=PortPinInputLevelCmosHysteresis, PortPinLevelValue=PORT_PIN_LEVEL_LOW, PortPinName=P001, PortPinNoiseFilterEnable=0, PortPinOutputDrive=PortPinOutputDrive5mA, PortPinPullUpDown=PortPinPullDown
          PSS_TTLEDLAMPFAIL_DIG_MCU_OUT: PortPinDigitalInputEnable=0, PortPinDirection=PORT_PIN_OUT, PortPinId=41, PortPinInputLevel=PortPinInputLevelCmosHysteresis, PortPinLevelValue=PORT_PIN_LEVEL_LOW, PortPinName=P109, PortPinNoiseFilterEnable=0, PortPinOutputDrive=PortPinOutputDrive5mA, PortPinPullUpDown=PortPinPullUpDownDisabled
          PSS_TTMDPS_DIG_MCU_OUT: PortPinDigitalInputEnable=0, PortPinDirection=PORT_PIN_OUT, PortPinId=40, PortPinInputLevel=PortPinInputLevelCmosHysteresis, PortPinLevelValue=PORT_PIN_LEVEL_LOW, PortPinName=P108, PortPinNoiseFilterEnable=0, PortPinOutputDrive=PortPinOutputDrive5mA, PortPinPullUpDown=PortPinPullUpDownDisabled
          PSS_TTMSTWRNG_DIG_MCU_OUT: PortPinDigitalInputEnable=0, PortPinDirection=PORT_PIN_OUT, PortPinId=34, PortPinInputLevel=PortPinInputLevelCmosHysteresis, PortPinLevelValue=PORT_PIN_LEVEL_LOW, PortPinName=P102, PortPinNoiseFilterEnable=0, PortPinOutputDrive=PortPinOutputDrive5mA, PortPinPullUpDown=PortPinPullUpDownDisabled
          PSS_TTPARKINGBRAKE_DIG_MCU_OUT: PortPinDigitalInputEnable=0, PortPinDirection=PORT_PIN_OUT, PortPinId=33, PortPinInputLevel=PortPinInputLevelCmosHysteresis, PortPinLevelValue=PORT_PIN_LEVEL_LOW, PortPinName=P101, PortPinNoiseFilterEnable=0, PortPinOutputDrive=PortPinOutputDrive5mA, PortPinPullUpDown=PortPinPullUpDownDisabled
          PSS_TTPWM_PWM_MCU_OUT: PortPinDigitalInputEnable=0, PortPinDirection=PORT_PIN_OUT, PortPinId=124, PortPinInputLevel=PortPinInputLevelCmosHysteresis, PortPinLevelValue=PORT_PIN_LEVEL_LOW, PortPinName=P328, PortPinNoiseFilterEnable=0, PortPinOutputDrive=PortPinOutputDrive5mA, PortPinPullUpDown=PortPinPullUpDownDisabled
          PSS_TTSPARE1_DIG_MCU_OUT: PortPinDigitalInputEnable=0, PortPinDirection=PORT_PIN_OUT, PortPinId=37, PortPinInputLevel=PortPinInputLevelCmosHysteresis, PortPinLevelValue=PORT_PIN_LEVEL_LOW, PortPinName=P105, PortPinNoiseFilterEnable=0, PortPinOutputDrive=PortPinOutputDrive2mA, PortPinPullUpDown=PortPinPullUpDownDisabled
          PSS_TTSPARE2_DIG_MCU_OUT: PortPinDigitalInputEnable=0, PortPinDirection=PORT_PIN_OUT, PortPinId=2, PortPinInputLevel=PortPinInputLevelCmosHysteresis, PortPinLevelValue=PORT_PIN_LEVEL_LOW, PortPinName=P002, PortPinNoiseFilterEnable=0, PortPinOutputDrive=PortPinOutputDrive2mA, PortPinPullUpDown=PortPinPullUpDownDisabled
          PSS_TTSPARE3_DIG_MCU_OUT: PortPinDigitalInputEnable=0, PortPinDirection=PORT_PIN_OUT, PortPinId=36, PortPinInputLevel=PortPinInputLevelCmosHysteresis, PortPinLevelValue=PORT_PIN_LEVEL_LOW, PortPinName=P104, PortPinNoiseFilterEnable=0, PortPinOutputDrive=PortPinOutputDrive2mA, PortPinPullUpDown=PortPinPullUpDownDisabled
          PSS_TTSPARE4_DIG_MCU_OUT: PortPinDigitalInputEnable=0, PortPinDirection=PORT_PIN_OUT, PortPinId=189, PortPinInputLevel=PortPinInputLevelCmosHysteresis, PortPinLevelValue=PORT_PIN_LEVEL_LOW, PortPinName=P529, PortPinNoiseFilterEnable=0, PortPinOutputDrive=PortPinOutputDrive2mA, PortPinPullUpDown=PortPinPullDown
          PSS_TTSPDSRGCLR_DIGAL_MCU_OUT: PortPinDigitalInputEnable=0, PortPinDirection=PORT_PIN_OUT, PortPinId=105, PortPinInputLevel=PortPinInputLevelCmosHysteresis, PortPinLevelValue=PORT_PIN_LEVEL_HIGH, PortPinName=P309, PortPinNoiseFilterEnable=0, PortPinOutputDrive=PortPinOutputDrive1mA, PortPinPullUpDown=PortPinPullUpDownDisabled
          PSS_TTSPDSRGOE_DIGAL_MCU_OUT: PortPinDigitalInputEnable=0, PortPinDirection=PORT_PIN_OUT, PortPinId=95, PortPinInputLevel=PortPinInputLevelCmosHysteresis, PortPinLevelValue=PORT_PIN_LEVEL_HIGH, PortPinName=P231, PortPinNoiseFilterEnable=0, PortPinOutputDrive=PortPinOutputDrive5mA, PortPinPullUpDown=PortPinPullUpDownDisabled
          PSS_TTSRGRCK_DIG_MCU_OUT: PortPinDigitalInputEnable=0, PortPinDirection=PORT_PIN_OUT, PortPinId=118, PortPinInputLevel=PortPinInputLevelCmosHysteresis, PortPinLevelValue=PORT_PIN_LEVEL_LOW, PortPinName=P322, PortPinNoiseFilterEnable=0, PortPinOutputDrive=PortPinOutputDrive2mA, PortPinPullUpDown=PortPinPullUpDownDisabled
          PSS_TTSRGSERIN_DIG_MCU_OUT: PortPinDigitalInputEnable=0, PortPinDirection=PORT_PIN_OUT, PortPinId=89, PortPinInputLevel=PortPinInputLevelCmosHysteresis, PortPinLevelValue=PORT_PIN_LEVEL_LOW, PortPinName=P225, PortPinNoiseFilterEnable=0, PortPinOutputDrive=PortPinOutputDrive5mA, PortPinPullUpDown=PortPinPullUpDownDisabled
          PSS_TTSRGSEROUT_DIG_MCU_IN: PortPinDigitalInputEnable=0, PortPinDirection=PORT_PIN_IN, PortPinId=192, PortPinInputLevel=PortPinInputLevelCmosHysteresis, PortPinLevelValue=PORT_PIN_LEVEL_LOW, PortPinName=P600, PortPinNoiseFilterEnable=0, PortPinOutputDrive=PortPinOutputDrive2mA, PortPinPullUpDown=PortPinPullDown
          PSS_TTSRGSRCK_DIG_MCU_OUT: PortPinDigitalInputEnable=0, PortPinDirection=PORT_PIN_OUT, PortPinId=90, PortPinInputLevel=PortPinInputLevelCmosHysteresis, PortPinLevelValue=PORT_PIN_LEVEL_LOW, PortPinName=P226, PortPinNoiseFilterEnable=0, PortPinOutputDrive=PortPinOutputDrive5mA, PortPinPullUpDown=PortPinPullUpDownDisabled
          PSS_UNUSED_PORTPIN0_03: PortPinDigitalInputEnable=0, PortPinDirection=PORT_PIN_OUT, PortPinId=3, PortPinInputLevel=PortPinInputLevelCmosHysteresis, PortPinLevelValue=PORT_PIN_LEVEL_LOW, PortPinName=P003, PortPinNoiseFilterEnable=0, PortPinOutputDrive=PortPinOutputDrive5mA, PortPinPullUpDown=PortPinPullUpDownDisabled
          PSS_UNUSED_PORTPIN1_00: PortPinDigitalInputEnable=0, PortPinDirection=PORT_PIN_OUT, PortPinId=32, PortPinInputLevel=PortPinInputLevelCmosHysteresis, PortPinLevelValue=PORT_PIN_LEVEL_LOW, PortPinName=P100, PortPinNoiseFilterEnable=0, PortPinOutputDrive=PortPinOutputDrive5mA, PortPinPullUpDown=PortPinPullUpDownDisabled
          PSS_UNUSED_PORTPIN5_05: PortPinDigitalInputEnable=0, PortPinDirection=PORT_PIN_OUT, PortPinId=165, PortPinInputLevel=PortPinInputLevelCmosHysteresis, PortPinLevelValue=PORT_PIN_LEVEL_LOW, PortPinName=P505, PortPinNoiseFilterEnable=0, PortPinOutputDrive=PortPinOutputDrive1mA, PortPinPullUpDown=PortPinPullUpDownDisabled
          PSS_UNUSED_PORTPIN5_13: PortPinDigitalInputEnable=0, PortPinDirection=PORT_PIN_OUT, PortPinId=173, PortPinInputLevel=PortPinInputLevelCmosHysteresis, PortPinLevelValue=PORT_PIN_LEVEL_LOW, PortPinName=P513, PortPinNoiseFilterEnable=0, PortPinOutputDrive=PortPinOutputDrive2mA, PortPinPullUpDown=PortPinPullUpDownDisabled
          PSS_UNUSED_PORTPIN5_22: PortPinDigitalInputEnable=0, PortPinDirection=PORT_PIN_OUT, PortPinId=182, PortPinInputLevel=PortPinInputLevelCmosHysteresis, PortPinLevelValue=PORT_PIN_LEVEL_LOW, PortPinName=P522, PortPinNoiseFilterEnable=0, PortPinOutputDrive=PortPinOutputDrive2mA, PortPinPullUpDown=PortPinPullUpDownDisabled
          PSS_WATER_SEP_AH_MCU_IN: PortPinDigitalInputEnable=0, PortPinDirection=PORT_PIN_IN, PortPinId=94, PortPinInputLevel=PortPinInputLevelCmosHysteresis, PortPinLevelValue=PORT_PIN_LEVEL_LOW, PortPinName=P230, PortPinNoiseFilterEnable=0, PortPinOutputDrive=PortPinOutputDrive1mA, PortPinPullUpDown=PortPinPullUpDownDisabled
    PortConfigSet_RUN (PortConfigSet)
      PortContainer_RUN (PortContainer): PortNumberOfPortPins=126, PortResourceInputReference=PortResourceInputConfigSet_RUN
        126 x PortPin, all with PortPinModeChangeable=0:
          AIRBAGDIAG_ANG_MCU_IN: PortPinDigitalInputEnable=0, PortPinDirection=PORT_PIN_IN, PortPinDirectionChangeable=0, PortPinId=92, PortPinInitialMode=GPIO, PortPinInputLevel=PortPinInputLevelCmosHysteresis, PortPinLevelValue=PORT_PIN_LEVEL_LOW, PortPinMode=GPIO, PortPinName=P228, PortPinNoiseFilterEnable=1, PortPinOutputDrive=PortPinOutputDrive2mA, PortPinPullUpDown=PortPinPullUpDownDisabled
          AIRBAGMON_ANG_MCU_IN: PortPinDigitalInputEnable=0, PortPinDirection=PORT_PIN_IN, PortPinDirectionChangeable=0, PortPinId=108, PortPinInitialMode=GPIO, PortPinInputLevel=PortPinInputLevelCmosHysteresis, PortPinLevelValue=PORT_PIN_LEVEL_LOW, PortPinMode=GPIO, PortPinName=P312, PortPinNoiseFilterEnable=0, PortPinOutputDrive=PortPinOutputDrive5mA, PortPinPullUpDown=PortPinPullUpDownDisabled
          ALTL_AL_MCU_IN: PortPinDigitalInputEnable=1, PortPinDirection=PORT_PIN_IN, PortPinDirectionChangeable=0, PortPinId=83, PortPinInitialMode=GPIO, PortPinInputLevel=PortPinInputLevelCmosHysteresis, PortPinLevelValue=PORT_PIN_LEVEL_LOW, PortPinMode=GPIO, PortPinName=P219, PortPinNoiseFilterEnable=0, PortPinOutputDrive=PortPinOutputDriveNoOutput, PortPinPullUpDown=PortPinPullUpDownDisabled
          CCANRX_NETWRK_MCU_IN: PortPinDigitalInputEnable=1, PortPinDirection=PORT_PIN_IN, PortPinDirectionChangeable=0, PortPinId=99, PortPinInitialMode=GPIO, PortPinInputLevel=PortPinInputLevelCmosHysteresis, PortPinLevelValue=PORT_PIN_LEVEL_LOW, PortPinMode=GPIO, PortPinName=P303, PortPinNoiseFilterEnable=0, PortPinOutputDrive=PortPinOutputDrive2mA, PortPinPullUpDown=PortPinPullUpDownDisabled
          CCANSTANDBY_DIG_MCU_OUT: PortPinDigitalInputEnable=1, PortPinDirection=PORT_PIN_OUT, PortPinDirectionChangeable=0, PortPinId=98, PortPinInitialMode=GPIO, PortPinInputLevel=PortPinInputLevelCmosHysteresis, PortPinLevelValue=PORT_PIN_LEVEL_HIGH, PortPinMode=GPIO, PortPinName=P302, PortPinNoiseFilterEnable=0, PortPinOutputDrive=PortPinOutputDrive5mA, PortPinPullUpDown=PortPinPullUpDownDisabled
          CCANTX_NETWRK_MCU_OUT: PortPinDigitalInputEnable=0, PortPinDirection=PORT_PIN_OUT, PortPinDirectionChangeable=0, PortPinId=100, PortPinInitialMode=TX0, PortPinInputLevel=PortPinInputLevelCmosHysteresis, PortPinLevelValue=PORT_PIN_LEVEL_HIGH, PortPinMode=TX0, PortPinName=P304, PortPinNoiseFilterEnable=0, PortPinOutputDrive=PortPinOutputDrive5mA, PortPinPullUpDown=PortPinPullUpDownDisabled
          DRIVE_MODE_SW_AL_MCU_IN: PortPinDigitalInputEnable=1, PortPinDirection=PORT_PIN_IN, PortPinDirectionChangeable=0, PortPinId=107, PortPinInitialMode=GPIO, PortPinInputLevel=PortPinInputLevelCmosHysteresis, PortPinLevelValue=PORT_PIN_LEVEL_LOW, PortPinMode=GPIO, PortPinName=P311, PortPinNoiseFilterEnable=0, PortPinOutputDrive=PortPinOutputDrive5mA, PortPinPullUpDown=PortPinPullUpDownDisabled
          EE_SCL: PortPinDigitalInputEnable=1, PortPinDirection=PORT_PIN_OUT, PortPinDirectionChangeable=0, PortPinId=97, PortPinInitialMode=SCL16, PortPinInputLevel=PortPinInputLevelCmosHysteresis, PortPinLevelValue=PORT_PIN_LEVEL_HIGH, PortPinMode=SCL16, PortPinName=P301, PortPinNoiseFilterEnable=1, PortPinOutputDrive=PortPinOutputDrive5mA, PortPinPullUpDown=PortPinPullUpDownDisabled
          EE_SDA: PortPinDigitalInputEnable=1, PortPinDirection=PORT_PIN_OUT, PortPinDirectionChangeable=0, PortPinId=96, PortPinInitialMode=SDA16, PortPinInputLevel=PortPinInputLevelCmosHysteresis, PortPinLevelValue=PORT_PIN_LEVEL_HIGH, PortPinMode=SDA16, PortPinName=P300, PortPinNoiseFilterEnable=1, PortPinOutputDrive=PortPinOutputDrive5mA, PortPinPullUpDown=PortPinPullUpDownDisabled
          FUELSENDER_ANG_MCU_IN: PortPinDigitalInputEnable=0, PortPinDirection=PORT_PIN_IN, PortPinDirectionChangeable=0, PortPinId=104, PortPinInitialMode=GPIO, PortPinInputLevel=PortPinInputLevelCmosHysteresis, PortPinLevelValue=PORT_PIN_LEVEL_LOW, PortPinMode=GPIO, PortPinName=P308, PortPinNoiseFilterEnable=1, PortPinOutputDrive=PortPinOutputDrive1mA, PortPinPullUpDown=PortPinPullUpDownDisabled
          FUEL_1_M_PWM_MCU_OUT: PortPinDigitalInputEnable=1, PortPinDirection=PORT_PIN_OUT, PortPinDirectionChangeable=0, PortPinId=138, PortPinInitialMode=PWM1M5, PortPinInputLevel=PortPinInputLevelCmosHysteresis, PortPinLevelValue=PORT_PIN_LEVEL_LOW, PortPinMode=PWM1M5, PortPinName=P410, PortPinNoiseFilterEnable=0, PortPinOutputDrive=PortPinOutputDrive30mA, PortPinPullUpDown=PortPinPullUpDownDisabled
          FUEL_1_P_PWM_MCU_OUT: PortPinDigitalInputEnable=1, PortPinDirection=PORT_PIN_OUT, PortPinDirectionChangeable=0, PortPinId=137, PortPinInitialMode=PWM1P5, PortPinInputLevel=PortPinInputLevelCmosHysteresis, PortPinLevelValue=PORT_PIN_LEVEL_LOW, PortPinMode=PWM1P5, PortPinName=P409, PortPinNoiseFilterEnable=0, PortPinOutputDrive=PortPinOutputDrive30mA, PortPinPullUpDown=PortPinPullUpDownDisabled
          FUEL_2_M_PWM_MCU_OUT: PortPinDigitalInputEnable=1, PortPinDirection=PORT_PIN_OUT, PortPinDirectionChangeable=0, PortPinId=140, PortPinInitialMode=PWM2M5, PortPinInputLevel=PortPinInputLevelCmosHysteresis, PortPinLevelValue=PORT_PIN_LEVEL_LOW, PortPinMode=PWM2M5, PortPinName=P412, PortPinNoiseFilterEnable=0, PortPinOutputDrive=PortPinOutputDrive30mA, PortPinPullUpDown=PortPinPullUpDownDisabled
          FUEL_2_P_PWM_MCU_OUT: PortPinDigitalInputEnable=1, PortPinDirection=PORT_PIN_OUT, PortPinDirectionChangeable=0, PortPinId=139, PortPinInitialMode=PWM2P5, PortPinInputLevel=PortPinInputLevelCmosHysteresis, PortPinLevelValue=PORT_PIN_LEVEL_LOW, PortPinMode=PWM2P5, PortPinName=P411, PortPinNoiseFilterEnable=0, PortPinOutputDrive=PortPinOutputDrive30mA, PortPinPullUpDown=PortPinPullUpDownDisabled
          GAUGEDIAL_PWM_MCU_OUT: PortPinDigitalInputEnable=0, PortPinDirection=PORT_PIN_OUT, PortPinDirectionChangeable=0, PortPinId=117, PortPinInitialMode=PPG6_TOUT2, PortPinInputLevel=PortPinInputLevelCmosHysteresis, PortPinLevelValue=PORT_PIN_LEVEL_LOW, PortPinMode=PPG6_TOUT2, PortPinName=P321, PortPinNoiseFilterEnable=0, PortPinOutputDrive=PortPinOutputDrive5mA, PortPinPullUpDown=PortPinPullUpDownDisabled
          GAUGEPNTR_PWM_MCU_OUT: PortPinDigitalInputEnable=0, PortPinDirection=PORT_PIN_OUT, PortPinDirectionChangeable=0, PortPinId=119, PortPinInitialMode=PPG7_TOUT2, PortPinInputLevel=PortPinInputLevelCmosHysteresis, PortPinLevelValue=PORT_PIN_LEVEL_LOW, PortPinMode=PPG7_TOUT2, PortPinName=P323, PortPinNoiseFilterEnable=0, PortPinOutputDrive=PortPinOutputDrive5mA, PortPinPullUpDown=PortPinPullUpDownDisabled
          Hyper_FLASH_CK: PortPinDigitalInputEnable=0, PortPinDirection=PORT_PIN_OUT, PortPinDirectionChangeable=0, PortPinId=4, PortPinInitialMode=G_CK_2, PortPinInputLevel=PortPinInputLevelCmosHysteresis, PortPinLevelValue=PORT_PIN_LEVEL_LOW, PortPinMode=G_CK_2, PortPinName=P004, PortPinNoiseFilterEnable=0, PortPinOutputDrive=PortPinOutputDrive10mA, PortPinPullUpDown=PortPinPullUpDownDisabled
          Hyper_FLASH_CS1: PortPinDigitalInputEnable=0, PortPinDirection=PORT_PIN_OUT, PortPinDirectionChangeable=0, PortPinId=9, PortPinInitialMode=G_CS1_2, PortPinInputLevel=PortPinInputLevelCmosHysteresis, PortPinLevelValue=PORT_PIN_LEVEL_LOW, PortPinMode=G_CS1_2, PortPinName=P009, PortPinNoiseFilterEnable=0, PortPinOutputDrive=PortPinOutputDrive10mA, PortPinPullUpDown=PortPinPullUpDownDisabled
          Hyper_FLASH_CS2: PortPinDigitalInputEnable=0, PortPinDirection=PORT_PIN_OUT, PortPinDirectionChangeable=0, PortPinId=11, PortPinInitialMode=G_CS2_2, PortPinInputLevel=PortPinInputLevelCmosHysteresis, PortPinLevelValue=PORT_PIN_LEVEL_LOW, PortPinMode=G_CS2_2, PortPinName=P011, PortPinNoiseFilterEnable=0, PortPinOutputDrive=PortPinOutputDrive10mA, PortPinPullUpDown=PortPinPullUpDownDisabled
          Hyper_FLASH_DQ0: PortPinDigitalInputEnable=1, PortPinDirection=PORT_PIN_IN, PortPinDirectionChangeable=1, PortPinId=8, PortPinInitialMode=G_DQ0_2, PortPinInputLevel=PortPinInputLevelCmosHysteresis, PortPinLevelValue=PORT_PIN_LEVEL_LOW, PortPinMode=G_DQ0_2, PortPinName=P008, PortPinNoiseFilterEnable=0, PortPinOutputDrive=PortPinOutputDrive10mA, PortPinPullUpDown=PortPinPullUpDownDisabled
          Hyper_FLASH_DQ1: PortPinDigitalInputEnable=1, PortPinDirection=PORT_PIN_IN, PortPinDirectionChangeable=1, PortPinId=7, PortPinInitialMode=G_DQ1_2, PortPinInputLevel=PortPinInputLevelCmosHysteresis, PortPinLevelValue=PORT_PIN_LEVEL_LOW, PortPinMode=G_DQ1_2, PortPinName=P007, PortPinNoiseFilterEnable=0, PortPinOutputDrive=PortPinOutputDrive10mA, PortPinPullUpDown=PortPinPullUpDownDisabled
          Hyper_FLASH_DQ2: PortPinDigitalInputEnable=1, PortPinDirection=PORT_PIN_IN, PortPinDirectionChangeable=1, PortPinId=6, PortPinInitialMode=G_DQ2_2, PortPinInputLevel=PortPinInputLevelCmosHysteresis, PortPinLevelValue=PORT_PIN_LEVEL_LOW, PortPinMode=G_DQ2_2, PortPinName=P006, PortPinNoiseFilterEnable=0, PortPinOutputDrive=PortPinOutputDrive10mA, PortPinPullUpDown=PortPinPullUpDownDisabled
          Hyper_FLASH_DQ3: PortPinDigitalInputEnable=1, PortPinDirection=PORT_PIN_IN, PortPinDirectionChangeable=1, PortPinId=5, PortPinInitialMode=G_DQ3_2, PortPinInputLevel=PortPinInputLevelCmosHysteresis, PortPinLevelValue=PORT_PIN_LEVEL_LOW, PortPinMode=G_DQ3_2, PortPinName=P005, PortPinNoiseFilterEnable=0, PortPinOutputDrive=PortPinOutputDrive10mA, PortPinPullUpDown=PortPinPullUpDownDisabled
          Hyper_FLASH_DQ4: PortPinDigitalInputEnable=1, PortPinDirection=PORT_PIN_IN, PortPinDirectionChangeable=1, PortPinId=12, PortPinInitialMode=G_DQ4_2, PortPinInputLevel=PortPinInputLevelCmosHysteresis, PortPinLevelValue=PORT_PIN_LEVEL_LOW, PortPinMode=G_DQ4_2, PortPinName=P012, PortPinNoiseFilterEnable=0, PortPinOutputDrive=PortPinOutputDrive10mA, PortPinPullUpDown=PortPinPullUpDownDisabled
          Hyper_FLASH_DQ5: PortPinDigitalInputEnable=1, PortPinDirection=PORT_PIN_IN, PortPinDirectionChangeable=1, PortPinId=13, PortPinInitialMode=G_DQ5_2, PortPinInputLevel=PortPinInputLevelCmosHysteresis, PortPinLevelValue=PORT_PIN_LEVEL_LOW, PortPinMode=G_DQ5_2, PortPinName=P013, PortPinNoiseFilterEnable=0, PortPinOutputDrive=PortPinOutputDrive10mA, PortPinPullUpDown=PortPinPullUpDownDisabled
          Hyper_FLASH_DQ6: PortPinDigitalInputEnable=1, PortPinDirection=PORT_PIN_IN, PortPinDirectionChangeable=1, PortPinId=14, PortPinInitialMode=G_DQ6_2, PortPinInputLevel=PortPinInputLevelCmosHysteresis, PortPinLevelValue=PORT_PIN_LEVEL_LOW, PortPinMode=G_DQ6_2, PortPinName=P014, PortPinNoiseFilterEnable=0, PortPinOutputDrive=PortPinOutputDrive10mA, PortPinPullUpDown=PortPinPullUpDownDisabled
          Hyper_FLASH_DQ7: PortPinDigitalInputEnable=1, PortPinDirection=PORT_PIN_IN, PortPinDirectionChangeable=1, PortPinId=15, PortPinInitialMode=G_DQ7_2, PortPinInputLevel=PortPinInputLevelCmosHysteresis, PortPinLevelValue=PORT_PIN_LEVEL_LOW, PortPinMode=G_DQ7_2, PortPinName=P015, PortPinNoiseFilterEnable=0, PortPinOutputDrive=PortPinOutputDrive10mA, PortPinPullUpDown=PortPinPullUpDownDisabled
          Hyper_FLASH_RWDS: PortPinDigitalInputEnable=1, PortPinDirection=PORT_PIN_IN, PortPinDirectionChangeable=0, PortPinId=10, PortPinInitialMode=G_RWDS_2, PortPinInputLevel=PortPinInputLevelCmosHysteresis, PortPinLevelValue=PORT_PIN_LEVEL_LOW, PortPinMode=G_RWDS_2, PortPinName=P010, PortPinNoiseFilterEnable=0, PortPinOutputDrive=PortPinOutputDrive5mA, PortPinPullUpDown=PortPinPullUpDownDisabled
          IGNSENSE_DIGAL_MCU_IN: PortPinDigitalInputEnable=1, PortPinDirection=PORT_PIN_IN, PortPinDirectionChangeable=0, PortPinId=102, PortPinInitialMode=GPIO, PortPinInputLevel=PortPinInputLevelCmosHysteresis, PortPinLevelValue=PORT_PIN_LEVEL_LOW, PortPinMode=GPIO, PortPinName=P306, PortPinNoiseFilterEnable=0, PortPinOutputDrive=PortPinOutputDrive1mA, PortPinPullUpDown=PortPinPullUpDownDisabled
          ILLUMOUT_PWM_MCU_OUT: PortPinDigitalInputEnable=0, PortPinDirection=PORT_PIN_OUT, PortPinDirectionChangeable=0, PortPinId=123, PortPinInitialMode=PPG9_TOUT2, PortPinInputLevel=PortPinInputLevelCmosHysteresis, PortPinLevelValue=PORT_PIN_LEVEL_LOW, PortPinMode=PPG9_TOUT2, PortPinName=P327, PortPinNoiseFilterEnable=0, PortPinOutputDrive=PortPinOutputDrive5mA, PortPinPullUpDown=PortPinPullUpDownDisabled
          IMMOBILIZER_IN_DIG_MCU_IN_PROTECTED: PortPinDigitalInputEnable=0, PortPinDirection=PORT_PIN_OUT, PortPinDirectionChangeable=0, PortPinId=35, PortPinInitialMode=GPIO, PortPinInputLevel=PortPinInputLevelCmosHysteresis, PortPinLevelValue=PORT_PIN_LEVEL_LOW, PortPinMode=GPIO, PortPinName=P103, PortPinNoiseFilterEnable=0, PortPinOutputDrive=PortPinOutputDrive5mA, PortPinPullUpDown=PortPinPullUpDownDisabled
          MCANENB_DIG_MCU_OUT: PortPinDigitalInputEnable=0, PortPinDirection=PORT_PIN_OUT, PortPinDirectionChangeable=0, PortPinId=101, PortPinInitialMode=GPIO, PortPinInputLevel=PortPinInputLevelCmosHysteresis, PortPinLevelValue=PORT_PIN_LEVEL_LOW, PortPinMode=GPIO, PortPinName=P305, PortPinNoiseFilterEnable=0, PortPinOutputDrive=PortPinOutputDrive5mA, PortPinPullUpDown=PortPinPullUpDownDisabled
          MCANERR_DIG_MCU_IN: PortPinDigitalInputEnable=1, PortPinDirection=PORT_PIN_IN, PortPinDirectionChangeable=0, PortPinId=114, PortPinInitialMode=GPIO, PortPinInputLevel=PortPinInputLevelCmosHysteresis, PortPinLevelValue=PORT_PIN_LEVEL_LOW, PortPinMode=GPIO, PortPinName=P318, PortPinNoiseFilterEnable=0, PortPinOutputDrive=PortPinOutputDrive5mA, PortPinPullUpDown=PortPinPullUpDownDisabled
          MCANRX_NETWRK_MCU_IN: PortPinDigitalInputEnable=1, PortPinDirection=PORT_PIN_IN, PortPinDirectionChangeable=0, PortPinId=112, PortPinInitialMode=GPIO, PortPinInputLevel=PortPinInputLevelCmosHysteresis, PortPinLevelValue=PORT_PIN_LEVEL_LOW, PortPinMode=GPIO, PortPinName=P316, PortPinNoiseFilterEnable=0, PortPinOutputDrive=PortPinOutputDrive1mA, PortPinPullUpDown=PortPinPullUpDownDisabled
          MCANSTBY_DIG_MCU_OUT: PortPinDigitalInputEnable=1, PortPinDirection=PORT_PIN_OUT, PortPinDirectionChangeable=0, PortPinId=111, PortPinInitialMode=GPIO, PortPinInputLevel=PortPinInputLevelCmosHysteresis, PortPinLevelValue=PORT_PIN_LEVEL_LOW, PortPinMode=GPIO, PortPinName=P315, PortPinNoiseFilterEnable=0, PortPinOutputDrive=PortPinOutputDrive5mA, PortPinPullUpDown=PortPinPullUpDownDisabled
          MCANTXNETWRK_MCU_OUT: PortPinDigitalInputEnable=0, PortPinDirection=PORT_PIN_OUT, PortPinDirectionChangeable=0, PortPinId=113, PortPinInitialMode=TX6, PortPinInputLevel=PortPinInputLevelCmosHysteresis, PortPinLevelValue=PORT_PIN_LEVEL_HIGH, PortPinMode=TX6, PortPinName=P317, PortPinNoiseFilterEnable=0, PortPinOutputDrive=PortPinOutputDrive5mA, PortPinPullUpDown=PortPinPullUpDownDisabled
          OILPRESSSW_AL_MCU_IN: PortPinDigitalInputEnable=1, PortPinDirection=PORT_PIN_IN, PortPinDirectionChangeable=0, PortPinId=136, PortPinInitialMode=GPIO, PortPinInputLevel=PortPinInputLevelAutomotive, PortPinLevelValue=PORT_PIN_LEVEL_LOW, PortPinMode=GPIO, PortPinName=P408, PortPinNoiseFilterEnable=0, PortPinOutputDrive=PortPinOutputDrive5mA, PortPinPullUpDown=PortPinPullUpDownDisabled
          POWER_FAULT: PortPinDigitalInputEnable=1, PortPinDirection=PORT_PIN_IN, PortPinDirectionChangeable=0, PortPinId=16, PortPinInitialMode=GPIO, PortPinInputLevel=PortPinInputLevelCmosHysteresis, PortPinLevelValue=PORT_PIN_LEVEL_LOW, PortPinMode=GPIO, PortPinName=P016, PortPinNoiseFilterEnable=0, PortPinOutputDrive=PortPinOutputDrive5mA, PortPinPullUpDown=PortPinPullUpDownDisabled
          RESET_CON: PortPinDigitalInputEnable=0, PortPinDirection=PORT_PIN_OUT, PortPinDirectionChangeable=0, PortPinId=31, PortPinInitialMode=GPIO, PortPinInputLevel=PortPinInputLevelCmosHysteresis, PortPinLevelValue=PORT_PIN_LEVEL_LOW, PortPinMode=GPIO, PortPinName=P031, PortPinNoiseFilterEnable=0, PortPinOutputDrive=PortPinOutputDrive5mA, PortPinPullUpDown=PortPinPullUpDownDisabled
          RHEDOWNSW_AL_MCU_IN: PortPinDigitalInputEnable=0, PortPinDirection=PORT_PIN_OUT, PortPinDirectionChangeable=0, PortPinId=157, PortPinInitialMode=GPIO, PortPinInputLevel=PortPinInputLevelAutomotive, PortPinLevelValue=PORT_PIN_LEVEL_LOW, PortPinMode=GPIO, PortPinName=P429, PortPinNoiseFilterEnable=0, PortPinOutputDrive=PortPinOutputDrive1mA, PortPinPullUpDown=PortPinPullUpDownDisabled
          RHEUPSW_AL_MCU_IN: PortPinDigitalInputEnable=0, PortPinDirection=PORT_PIN_OUT, PortPinDirectionChangeable=0, PortPinId=158, PortPinInitialMode=GPIO, PortPinInputLevel=PortPinInputLevelAutomotive, PortPinLevelValue=PORT_PIN_LEVEL_LOW, PortPinMode=GPIO, PortPinName=P430, PortPinNoiseFilterEnable=0, PortPinOutputDrive=PortPinOutputDrive1mA, PortPinPullUpDown=PortPinPullUpDownDisabled
          RT_CLK: PortPinDigitalInputEnable=0, PortPinDirection=PORT_PIN_OUT, PortPinDirectionChangeable=0, PortPinId=120, PortPinInitialMode=PPG8_TOUT0, PortPinInputLevel=PortPinInputLevelCmosHysteresis, PortPinLevelValue=PORT_PIN_LEVEL_LOW, PortPinMode=PPG8_TOUT0, PortPinName=P324, PortPinNoiseFilterEnable=0, PortPinOutputDrive=PortPinOutputDrive5mA, PortPinPullUpDown=PortPinPullUpDownDisabled
          RT_CLK_1V2SW: PortPinDigitalInputEnable=0, PortPinDirection=PORT_PIN_OUT, PortPinDirectionChangeable=0, PortPinId=190, PortPinInitialMode=PPG11_TOUT0, PortPinInputLevel=PortPinInputLevelCmosHysteresis, PortPinLevelValue=PORT_PIN_LEVEL_LOW, PortPinMode=PPG11_TOUT0, PortPinName=P530, PortPinNoiseFilterEnable=0, PortPinOutputDrive=PortPinOutputDrive2mA, PortPinPullUpDown=PortPinPullUpDownDisabled
          SBATT2ILLUMSPLY_MCU_OUT: PortPinDigitalInputEnable=0, PortPinDirection=PORT_PIN_OUT, PortPinDirectionChangeable=0, PortPinId=28, PortPinInitialMode=GPIO, PortPinInputLevel=PortPinInputLevelCmosHysteresis, PortPinLevelValue=PORT_PIN_LEVEL_LOW, PortPinMode=GPIO, PortPinName=P028, PortPinNoiseFilterEnable=0, PortPinOutputDrive=PortPinOutputDrive5mA, PortPinPullUpDown=PortPinPullUpDownDisabled
          SBATTFUEL_MCU_OUT: PortPinDigitalInputEnable=0, PortPinDirection=PORT_PIN_OUT, PortPinDirectionChangeable=0, PortPinId=0, PortPinInitialMode=GPIO, PortPinInputLevel=PortPinInputLevelCmosHysteresis, PortPinLevelValue=PORT_PIN_LEVEL_LOW, PortPinMode=GPIO, PortPinName=P000, PortPinNoiseFilterEnable=0, PortPinOutputDrive=PortPinOutputDrive5mA, PortPinPullUpDown=PortPinPullUpDownDisabled
          SBATTMON_ANG_MCU_IN: PortPinDigitalInputEnable=0, PortPinDirection=PORT_PIN_IN, PortPinDirectionChangeable=0, PortPinId=106, PortPinInitialMode=GPIO, PortPinInputLevel=PortPinInputLevelCmosHysteresis, PortPinLevelValue=PORT_PIN_LEVEL_LOW, PortPinMode=GPIO, PortPinName=P310, PortPinNoiseFilterEnable=1, PortPinOutputDrive=PortPinOutputDrive1mA, PortPinPullUpDown=PortPinPullUpDownDisabled
          SBATT_CHIME_MCU_OUT: PortPinDigitalInputEnable=0, PortPinDirection=PORT_PIN_OUT, PortPinDirectionChangeable=0, PortPinId=38, PortPinInitialMode=GPIO, PortPinInputLevel=PortPinInputLevelCmosHysteresis, PortPinLevelValue=PORT_PIN_LEVEL_LOW, PortPinMode=GPIO, PortPinName=P106, PortPinNoiseFilterEnable=0, PortPinOutputDrive=PortPinOutputDrive5mA, PortPinPullUpDown=PortPinPullUpDownDisabled
          SBATT_DIG_MCU_OUT: PortPinDigitalInputEnable=0, PortPinDirection=PORT_PIN_OUT, PortPinDirectionChangeable=0, PortPinId=18, PortPinInitialMode=GPIO, PortPinInputLevel=PortPinInputLevelCmosHysteresis, PortPinLevelValue=PORT_PIN_LEVEL_LOW, PortPinMode=GPIO, PortPinName=P018, PortPinNoiseFilterEnable=0, PortPinOutputDrive=PortPinOutputDrive5mA, PortPinPullUpDown=PortPinPullUpDownDisabled
          SFUELBATTMON_ANG_MCU_IN: PortPinDigitalInputEnable=0, PortPinDirection=PORT_PIN_IN, PortPinDirectionChangeable=0, PortPinId=109, PortPinInitialMode=GPIO, PortPinInputLevel=PortPinInputLevelCmosHysteresis, PortPinLevelValue=PORT_PIN_LEVEL_LOW, PortPinMode=GPIO, PortPinName=P313, PortPinNoiseFilterEnable=1, PortPinOutputDrive=PortPinOutputDrive1mA, PortPinPullUpDown=PortPinPullUpDownDisabled
          SPDSRGSEROUT_DIG_MCU_IN: PortPinDigitalInputEnable=0, PortPinDirection=PORT_PIN_OUT, PortPinDirectionChangeable=0, PortPinId=19, PortPinInitialMode=GPIO, PortPinInputLevel=PortPinInputLevelCmosHysteresis, PortPinLevelValue=PORT_PIN_LEVEL_LOW, PortPinMode=GPIO, PortPinName=P019, PortPinNoiseFilterEnable=0, PortPinOutputDrive=PortPinOutputDrive5mA, PortPinPullUpDown=PortPinPullDown
          SPEEDIN_DIGAL_MCU_IN_PROTECTED: PortPinDigitalInputEnable=0, PortPinDirection=PORT_PIN_OUT, PortPinDirectionChangeable=0, PortPinId=134, PortPinInitialMode=GPIO, PortPinInputLevel=PortPinInputLevelAutomotive, PortPinLevelValue=PORT_PIN_LEVEL_LOW, PortPinMode=GPIO, PortPinName=P406, PortPinNoiseFilterEnable=0, PortPinOutputDrive=PortPinOutputDrive5mA, PortPinPullUpDown=PortPinPullUpDownDisabled
          SPEEDOLED_PWM_MCU_OUT: PortPinDigitalInputEnable=0, PortPinDirection=PORT_PIN_OUT, PortPinDirectionChangeable=0, PortPinId=122, PortPinInitialMode=PPG9_TOUT0, PortPinInputLevel=PortPinInputLevelCmosHysteresis, PortPinLevelValue=PORT_PIN_LEVEL_LOW, PortPinMode=PPG9_TOUT0, PortPinName=P326, PortPinNoiseFilterEnable=0, PortPinOutputDrive=PortPinOutputDrive5mA, PortPinPullUpDown=PortPinPullUpDownDisabled
          SPEEDOUT_PULSE_MCU_OUT: PortPinDigitalInputEnable=0, PortPinDirection=PORT_PIN_OUT, PortPinDirectionChangeable=0, PortPinId=121, PortPinInitialMode=GPIO, PortPinInputLevel=PortPinInputLevelCmosHysteresis, PortPinLevelValue=PORT_PIN_LEVEL_LOW, PortPinMode=GPIO, PortPinName=P325, PortPinNoiseFilterEnable=0, PortPinOutputDrive=PortPinOutputDrive5mA, PortPinPullUpDown=PortPinPullUpDownDisabled
          SPKRCOMPSGN_PWM_MCU_OUT: PortPinDigitalInputEnable=0, PortPinDirection=PORT_PIN_OUT, PortPinDirectionChangeable=0, PortPinId=91, PortPinInitialMode=SGO1, PortPinInputLevel=PortPinInputLevelCmosHysteresis, PortPinLevelValue=PORT_PIN_LEVEL_LOW, PortPinMode=SGO1, PortPinName=P227, PortPinNoiseFilterEnable=0, PortPinOutputDrive=PortPinOutputDrive5mA, PortPinPullUpDown=PortPinPullUpDownDisabled
          SPKRTICTOC_PWM_MCU_OUT: PortPinDigitalInputEnable=0, PortPinDirection=PORT_PIN_OUT, PortPinDirectionChangeable=0, PortPinId=88, PortPinInitialMode=PPG4_TOUT0, PortPinInputLevel=PortPinInputLevelCmosHysteresis, PortPinLevelValue=PORT_PIN_LEVEL_LOW, PortPinMode=PPG4_TOUT0, PortPinName=P224, PortPinNoiseFilterEnable=0, PortPinOutputDrive=PortPinOutputDrive5mA, PortPinPullUpDown=PortPinPullUpDownDisabled
          SW5VEPRM_DIG_MCU_OUT_PROTECTED: PortPinDigitalInputEnable=0, PortPinDirection=PORT_PIN_OUT, PortPinDirectionChangeable=0, PortPinId=17, PortPinInitialMode=GPIO, PortPinInputLevel=PortPinInputLevelCmosHysteresis, PortPinLevelValue=PORT_PIN_LEVEL_LOW, PortPinMode=GPIO, PortPinName=P017, PortPinNoiseFilterEnable=0, PortPinOutputDrive=PortPinOutputDrive2mA, PortPinPullUpDown=PortPinPullUpDownDisabled
          SW5VEXT_DIG_MCU_OUT: PortPinDigitalInputEnable=0, PortPinDirection=PORT_PIN_OUT, PortPinDirectionChangeable=0, PortPinId=116, PortPinInitialMode=GPIO, PortPinInputLevel=PortPinInputLevelCmosHysteresis, PortPinLevelValue=PORT_PIN_LEVEL_LOW, PortPinMode=GPIO, PortPinName=P320, PortPinNoiseFilterEnable=0, PortPinOutputDrive=PortPinOutputDrive1mA, PortPinPullUpDown=PortPinPullUpDownDisabled
          SW_3V3_EN_DIG_MCU_OUT: PortPinDigitalInputEnable=0, PortPinDirection=PORT_PIN_OUT, PortPinDirectionChangeable=0, PortPinId=86, PortPinInitialMode=GPIO, PortPinInputLevel=PortPinInputLevelCmosHysteresis, PortPinLevelValue=PORT_PIN_LEVEL_LOW, PortPinMode=GPIO, PortPinName=P222, PortPinNoiseFilterEnable=0, PortPinOutputDrive=PortPinOutputDrive5mA, PortPinPullUpDown=PortPinPullUpDownDisabled
          SW_5V_EN_DIG_MCU_OUT: PortPinDigitalInputEnable=0, PortPinDirection=PORT_PIN_OUT, PortPinDirectionChangeable=0, PortPinId=115, PortPinInitialMode=GPIO, PortPinInputLevel=PortPinInputLevelCmosHysteresis, PortPinLevelValue=PORT_PIN_LEVEL_LOW, PortPinMode=GPIO, PortPinName=P319, PortPinNoiseFilterEnable=0, PortPinOutputDrive=PortPinOutputDrive5mA, PortPinPullUpDown=PortPinPullUpDownDisabled
          TACHO_1_M_PWM_MCU_OUT: PortPinDigitalInputEnable=1, PortPinDirection=PORT_PIN_OUT, PortPinDirectionChangeable=0, PortPinId=126, PortPinInitialMode=PWM1M2, PortPinInputLevel=PortPinInputLevelCmosHysteresis, PortPinLevelValue=PORT_PIN_LEVEL_LOW, PortPinMode=PWM1M2, PortPinName=P330, PortPinNoiseFilterEnable=0, PortPinOutputDrive=PortPinOutputDrive30mA, PortPinPullUpDown=PortPinPullUpDownDisabled
          TACHO_1_P_PWM_MCU_OUT: PortPinDigitalInputEnable=1, PortPinDirection=PORT_PIN_OUT, PortPinDirectionChangeable=0, PortPinId=125, PortPinInitialMode=PWM1P2, PortPinInputLevel=PortPinInputLevelCmosHysteresis, PortPinLevelValue=PORT_PIN_LEVEL_LOW, PortPinMode=PWM1P2, PortPinName=P329, PortPinNoiseFilterEnable=0, PortPinOutputDrive=PortPinOutputDrive30mA, PortPinPullUpDown=PortPinPullUpDownDisabled
          TACHO_2_M_PWM_MCU_OUT: PortPinDigitalInputEnable=1, PortPinDirection=PORT_PIN_OUT, PortPinDirectionChangeable=0, PortPinId=128, PortPinInitialMode=PWM2M2, PortPinInputLevel=PortPinInputLevelCmosHysteresis, PortPinLevelValue=PORT_PIN_LEVEL_LOW, PortPinMode=PWM2M2, PortPinName=P400, PortPinNoiseFilterEnable=0, PortPinOutputDrive=PortPinOutputDrive30mA, PortPinPullUpDown=PortPinPullUpDownDisabled
          TACHO_2_P_PWM_MCU_OUT: PortPinDigitalInputEnable=1, PortPinDirection=PORT_PIN_OUT, PortPinDirectionChangeable=0, PortPinId=127, PortPinInitialMode=PWM2P2, PortPinInputLevel=PortPinInputLevelCmosHysteresis, PortPinLevelValue=PORT_PIN_LEVEL_LOW, PortPinMode=PWM2P2, PortPinName=P331, PortPinNoiseFilterEnable=0, PortPinOutputDrive=PortPinOutputDrive30mA, PortPinPullUpDown=PortPinPullUpDownDisabled
          TEMP_1_M_PWM_MCU_OUT: PortPinDigitalInputEnable=1, PortPinDirection=PORT_PIN_OUT, PortPinDirectionChangeable=0, PortPinId=130, PortPinInitialMode=PWM1M3, PortPinInputLevel=PortPinInputLevelCmosHysteresis, PortPinLevelValue=PORT_PIN_LEVEL_LOW, PortPinMode=PWM1M3, PortPinName=P402, PortPinNoiseFilterEnable=0, PortPinOutputDrive=PortPinOutputDrive30mA, PortPinPullUpDown=PortPinPullUpDownDisabled
          TEMP_1_P_PWM_MCU_OUT: PortPinDigitalInputEnable=1, PortPinDirection=PORT_PIN_OUT, PortPinDirectionChangeable=0, PortPinId=129, PortPinInitialMode=PWM1P3, PortPinInputLevel=PortPinInputLevelCmosHysteresis, PortPinLevelValue=PORT_PIN_LEVEL_LOW, PortPinMode=PWM1P3, PortPinName=P401, PortPinNoiseFilterEnable=0, PortPinOutputDrive=PortPinOutputDrive30mA, PortPinPullUpDown=PortPinPullUpDownDisabled
          TEMP_2_M_PWM_MCU_OUT: PortPinDigitalInputEnable=1, PortPinDirection=PORT_PIN_OUT, PortPinDirectionChangeable=0, PortPinId=132, PortPinInitialMode=PWM2M3, PortPinInputLevel=PortPinInputLevelCmosHysteresis, PortPinLevelValue=PORT_PIN_LEVEL_LOW, PortPinMode=PWM2M3, PortPinName=P404, PortPinNoiseFilterEnable=0, PortPinOutputDrive=PortPinOutputDrive30mA, PortPinPullUpDown=PortPinPullUpDownDisabled
          TEMP_2_P_PWM_MCU_OUT: PortPinDigitalInputEnable=1, PortPinDirection=PORT_PIN_OUT, PortPinDirectionChangeable=0, PortPinId=131, PortPinInitialMode=PWM2P3, PortPinInputLevel=PortPinInputLevelCmosHysteresis, PortPinLevelValue=PORT_PIN_LEVEL_LOW, PortPinMode=PWM2P3, PortPinName=P403, PortPinNoiseFilterEnable=0, PortPinOutputDrive=PortPinOutputDrive30mA, PortPinPullUpDown=PortPinPullUpDownDisabled
          TFT_BLUE2: PortPinDigitalInputEnable=0, PortPinDirection=PORT_PIN_OUT, PortPinDirectionChangeable=0, PortPinId=159, PortPinInitialMode=DSP1_DATA1_10, PortPinInputLevel=PortPinInputLevelCmosHysteresis, PortPinLevelValue=PORT_PIN_LEVEL_LOW, PortPinMode=DSP1_DATA1_10, PortPinName=P431, PortPinNoiseFilterEnable=0, PortPinOutputDrive=PortPinOutputDrive1mA, PortPinPullUpDown=PortPinPullUpDownDisabled
          TFT_BLUE3: PortPinDigitalInputEnable=0, PortPinDirection=PORT_PIN_OUT, PortPinDirectionChangeable=0, PortPinId=160, PortPinInitialMode=DSP1_DATA0_10, PortPinInputLevel=PortPinInputLevelCmosHysteresis, PortPinLevelValue=PORT_PIN_LEVEL_LOW, PortPinMode=DSP1_DATA0_10, PortPinName=P500, PortPinNoiseFilterEnable=0, PortPinOutputDrive=PortPinOutputDrive1mA, PortPinPullUpDown=PortPinPullUpDownDisabled
          TFT_BLUE4: PortPinDigitalInputEnable=0, PortPinDirection=PORT_PIN_OUT, PortPinDirectionChangeable=0, PortPinId=161, PortPinInitialMode=DSP1_DATA1_9, PortPinInputLevel=PortPinInputLevelCmosHysteresis, PortPinLevelValue=PORT_PIN_LEVEL_LOW, PortPinMode=DSP1_DATA1_9, PortPinName=P501, PortPinNoiseFilterEnable=0, PortPinOutputDrive=PortPinOutputDrive1mA, PortPinPullUpDown=PortPinPullUpDownDisabled
          TFT_BLUE5: PortPinDigitalInputEnable=0, PortPinDirection=PORT_PIN_OUT, PortPinDirectionChangeable=0, PortPinId=162, PortPinInitialMode=DSP1_DATA0_9, PortPinInputLevel=PortPinInputLevelCmosHysteresis, PortPinLevelValue=PORT_PIN_LEVEL_LOW, PortPinMode=DSP1_DATA0_9, PortPinName=P502, PortPinNoiseFilterEnable=0, PortPinOutputDrive=PortPinOutputDrive1mA, PortPinPullUpDown=PortPinPullUpDownDisabled
          TFT_BLUE6: PortPinDigitalInputEnable=0, PortPinDirection=PORT_PIN_OUT, PortPinDirectionChangeable=0, PortPinId=163, PortPinInitialMode=DSP1_DATA1_8, PortPinInputLevel=PortPinInputLevelCmosHysteresis, PortPinLevelValue=PORT_PIN_LEVEL_LOW, PortPinMode=DSP1_DATA1_8, PortPinName=P503, PortPinNoiseFilterEnable=0, PortPinOutputDrive=PortPinOutputDrive1mA, PortPinPullUpDown=PortPinPullUpDownDisabled
          TFT_BLUE7: PortPinDigitalInputEnable=0, PortPinDirection=PORT_PIN_OUT, PortPinDirectionChangeable=0, PortPinId=164, PortPinInitialMode=DSP1_DATA0_8, PortPinInputLevel=PortPinInputLevelCmosHysteresis, PortPinLevelValue=PORT_PIN_LEVEL_LOW, PortPinMode=DSP1_DATA0_8, PortPinName=P504, PortPinNoiseFilterEnable=0, PortPinOutputDrive=PortPinOutputDrive1mA, PortPinPullUpDown=PortPinPullUpDownDisabled
          TFT_BL_PWM_OUT: PortPinDigitalInputEnable=0, PortPinDirection=PORT_PIN_OUT, PortPinDirectionChangeable=0, PortPinId=135, PortPinInitialMode=PPG3_TOUT2, PortPinInputLevel=PortPinInputLevelCmosHysteresis, PortPinLevelValue=PORT_PIN_LEVEL_LOW, PortPinMode=PPG3_TOUT2, PortPinName=P407, PortPinNoiseFilterEnable=0, PortPinOutputDrive=PortPinOutputDrive5mA, PortPinPullUpDown=PortPinPullUpDownDisabled
          TFT_CLK: PortPinDigitalInputEnable=0, PortPinDirection=PORT_PIN_OUT, PortPinDirectionChangeable=0, PortPinId=153, PortPinInitialMode=DSP1_CLK, PortPinInputLevel=PortPinInputLevelCmosHysteresis, PortPinLevelValue=PORT_PIN_LEVEL_LOW, PortPinMode=DSP1_CLK, PortPinName=P425, PortPinNoiseFilterEnable=0, PortPinOutputDrive=PortPinOutputDrive5mA, PortPinPullUpDown=PortPinPullUpDownDisabled
          TFT_CSB: PortPinDigitalInputEnable=1, PortPinDirection=PORT_PIN_OUT, PortPinDirectionChangeable=0, PortPinId=30, PortPinInitialMode=GPIO, PortPinInputLevel=PortPinInputLevelCmosHysteresis, PortPinLevelValue=PORT_PIN_LEVEL_HIGH, PortPinMode=GPIO, PortPinName=P030, PortPinNoiseFilterEnable=0, PortPinOutputDrive=PortPinOutputDrive5mA, PortPinPullUpDown=PortPinPullUpDownDisabled
          TFT_DE: PortPinDigitalInputEnable=0, PortPinDirection=PORT_PIN_OUT, PortPinDirectionChangeable=0, PortPinId=154, PortPinInitialMode=DSP1_CTRL2, PortPinInputLevel=PortPinInputLevelCmosHysteresis, PortPinLevelValue=PORT_PIN_LEVEL_LOW, PortPinMode=DSP1_CTRL2, PortPinName=P426, PortPinNoiseFilterEnable=0, PortPinOutputDrive=PortPinOutputDrive1mA, PortPinPullUpDown=PortPinPullUpDownDisabled
          TFT_ERR: PortPinDigitalInputEnable=1, PortPinDirection=PORT_PIN_IN, PortPinDirectionChangeable=0, PortPinId=166, PortPinInitialMode=GPIO, PortPinInputLevel=PortPinInputLevelAutomotive, PortPinLevelValue=PORT_PIN_LEVEL_LOW, PortPinMode=GPIO, PortPinName=P506, PortPinNoiseFilterEnable=0, PortPinOutputDrive=PortPinOutputDrive5mA, PortPinPullUpDown=PortPinPullUpDownDisabled
          TFT_GREEN2: PortPinDigitalInputEnable=0, PortPinDirection=PORT_PIN_OUT, PortPinDirectionChangeable=0, PortPinId=167, PortPinInitialMode=DSP1_DATA1_6, PortPinInputLevel=PortPinInputLevelAutomotive, PortPinLevelValue=PORT_PIN_LEVEL_LOW, PortPinMode=DSP1_DATA1_6, PortPinName=P507, PortPinNoiseFilterEnable=0, PortPinOutputDrive=PortPinOutputDrive1mA, PortPinPullUpDown=PortPinPullUpDownDisabled
          TFT_GREEN3: PortPinDigitalInputEnable=0, PortPinDirection=PORT_PIN_OUT, PortPinDirectionChangeable=0, PortPinId=168, PortPinInitialMode=DSP1_DATA0_6, PortPinInputLevel=PortPinInputLevelCmosHysteresis, PortPinLevelValue=PORT_PIN_LEVEL_LOW, PortPinMode=DSP1_DATA0_6, PortPinName=P508, PortPinNoiseFilterEnable=0, PortPinOutputDrive=PortPinOutputDrive1mA, PortPinPullUpDown=PortPinPullUpDownDisabled
          TFT_GREEN4: PortPinDigitalInputEnable=0, PortPinDirection=PORT_PIN_OUT, PortPinDirectionChangeable=0, PortPinId=169, PortPinInitialMode=DSP1_DATA1_5, PortPinInputLevel=PortPinInputLevelCmosHysteresis, PortPinLevelValue=PORT_PIN_LEVEL_LOW, PortPinMode=DSP1_DATA1_5, PortPinName=P509, PortPinNoiseFilterEnable=0, PortPinOutputDrive=PortPinOutputDrive1mA, PortPinPullUpDown=PortPinPullUpDownDisabled
          TFT_GREEN5: PortPinDigitalInputEnable=0, PortPinDirection=PORT_PIN_OUT, PortPinDirectionChangeable=0, PortPinId=170, PortPinInitialMode=DSP1_DATA0_5, PortPinInputLevel=PortPinInputLevelCmosHysteresis, PortPinLevelValue=PORT_PIN_LEVEL_LOW, PortPinMode=DSP1_DATA0_5, PortPinName=P510, PortPinNoiseFilterEnable=0, PortPinOutputDrive=PortPinOutputDrive1mA, PortPinPullUpDown=PortPinPullUpDownDisabled
          TFT_GREEN6: PortPinDigitalInputEnable=1, PortPinDirection=PORT_PIN_OUT, PortPinDirectionChangeable=0, PortPinId=171, PortPinInitialMode=DSP1_DATA1_4, PortPinInputLevel=PortPinInputLevelCmosHysteresis, PortPinLevelValue=PORT_PIN_LEVEL_LOW, PortPinMode=DSP1_DATA1_4, PortPinName=P511, PortPinNoiseFilterEnable=0, PortPinOutputDrive=PortPinOutputDrive1mA, PortPinPullUpDown=PortPinPullUpDownDisabled
          TFT_GREEN7: PortPinDigitalInputEnable=0, PortPinDirection=PORT_PIN_OUT, PortPinDirectionChangeable=0, PortPinId=172, PortPinInitialMode=DSP1_DATA0_4, PortPinInputLevel=PortPinInputLevelCmosHysteresis, PortPinLevelValue=PORT_PIN_LEVEL_LOW, PortPinMode=DSP1_DATA0_4, PortPinName=P512, PortPinNoiseFilterEnable=0, PortPinOutputDrive=PortPinOutputDrive1mA, PortPinPullUpDown=PortPinPullUpDownDisabled
          TFT_HSYNC: PortPinDigitalInputEnable=0, PortPinDirection=PORT_PIN_OUT, PortPinDirectionChangeable=0, PortPinId=156, PortPinInitialMode=DSP1_CTRL0, PortPinInputLevel=PortPinInputLevelCmosHysteresis, PortPinLevelValue=PORT_PIN_LEVEL_LOW, PortPinMode=DSP1_CTRL0, PortPinName=P428, PortPinNoiseFilterEnable=0, PortPinOutputDrive=PortPinOutputDrive1mA, PortPinPullUpDown=PortPinPullUpDownDisabled
          TFT_RED2: PortPinDigitalInputEnable=0, PortPinDirection=PORT_PIN_OUT, PortPinDirectionChangeable=0, PortPinId=175, PortPinInitialMode=DSP1_DATA1_2, PortPinInputLevel=PortPinInputLevelCmosHysteresis, PortPinLevelValue=PORT_PIN_LEVEL_LOW, PortPinMode=DSP1_DATA1_2, PortPinName=P515, PortPinNoiseFilterEnable=0, PortPinOutputDrive=PortPinOutputDrive1mA, PortPinPullUpDown=PortPinPullUpDownDisabled
          TFT_RED3: PortPinDigitalInputEnable=0, PortPinDirection=PORT_PIN_OUT, PortPinDirectionChangeable=0, PortPinId=176, PortPinInitialMode=DSP1_DATA0_2, PortPinInputLevel=PortPinInputLevelCmosHysteresis, PortPinLevelValue=PORT_PIN_LEVEL_LOW, PortPinMode=DSP1_DATA0_2, PortPinName=P516, PortPinNoiseFilterEnable=0, PortPinOutputDrive=PortPinOutputDrive1mA, PortPinPullUpDown=PortPinPullUpDownDisabled
          TFT_RED4: PortPinDigitalInputEnable=0, PortPinDirection=PORT_PIN_OUT, PortPinDirectionChangeable=0, PortPinId=177, PortPinInitialMode=DSP1_DATA1_1, PortPinInputLevel=PortPinInputLevelCmosHysteresis, PortPinLevelValue=PORT_PIN_LEVEL_LOW, PortPinMode=DSP1_DATA1_1, PortPinName=P517, PortPinNoiseFilterEnable=0, PortPinOutputDrive=PortPinOutputDrive1mA, PortPinPullUpDown=PortPinPullUpDownDisabled
          TFT_RED5: PortPinDigitalInputEnable=0, PortPinDirection=PORT_PIN_OUT, PortPinDirectionChangeable=0, PortPinId=178, PortPinInitialMode=DSP1_DATA0_1, PortPinInputLevel=PortPinInputLevelCmosHysteresis, PortPinLevelValue=PORT_PIN_LEVEL_LOW, PortPinMode=DSP1_DATA0_1, PortPinName=P518, PortPinNoiseFilterEnable=0, PortPinOutputDrive=PortPinOutputDrive1mA, PortPinPullUpDown=PortPinPullUpDownDisabled
          TFT_RED6: PortPinDigitalInputEnable=0, PortPinDirection=PORT_PIN_OUT, PortPinDirectionChangeable=0, PortPinId=179, PortPinInitialMode=DSP1_DATA1_0, PortPinInputLevel=PortPinInputLevelCmosHysteresis, PortPinLevelValue=PORT_PIN_LEVEL_LOW, PortPinMode=DSP1_DATA1_0, PortPinName=P519, PortPinNoiseFilterEnable=0, PortPinOutputDrive=PortPinOutputDrive1mA, PortPinPullUpDown=PortPinPullUpDownDisabled
          TFT_RED7: PortPinDigitalInputEnable=0, PortPinDirection=PORT_PIN_OUT, PortPinDirectionChangeable=0, PortPinId=180, PortPinInitialMode=DSP1_DATA0_0, PortPinInputLevel=PortPinInputLevelCmosHysteresis, PortPinLevelValue=PORT_PIN_LEVEL_LOW, PortPinMode=DSP1_DATA0_0, PortPinName=P520, PortPinNoiseFilterEnable=0, PortPinOutputDrive=PortPinOutputDrive1mA, PortPinPullUpDown=PortPinPullUpDownDisabled
          TFT_RESET: PortPinDigitalInputEnable=0, PortPinDirection=PORT_PIN_OUT, PortPinDirectionChangeable=0, PortPinId=174, PortPinInitialMode=GPIO, PortPinInputLevel=PortPinInputLevelCmosHysteresis, PortPinLevelValue=PORT_PIN_LEVEL_LOW, PortPinMode=GPIO, PortPinName=P514, PortPinNoiseFilterEnable=0, PortPinOutputDrive=PortPinOutputDrive5mA, PortPinPullUpDown=PortPinPullUpDownDisabled
          TFT_SCK: PortPinDigitalInputEnable=0, PortPinDirection=PORT_PIN_OUT, PortPinDirectionChangeable=0, PortPinId=27, PortPinInitialMode=SCK1, PortPinInputLevel=PortPinInputLevelCmosHysteresis, PortPinLevelValue=PORT_PIN_LEVEL_LOW, PortPinMode=SCK1, PortPinName=P027, PortPinNoiseFilterEnable=0, PortPinOutputDrive=PortPinOutputDrive5mA, PortPinPullUpDown=PortPinPullUpDownDisabled
          TFT_SOUT: PortPinDigitalInputEnable=0, PortPinDirection=PORT_PIN_OUT, PortPinDirectionChangeable=0, PortPinId=26, PortPinInitialMode=SOT1, PortPinInputLevel=PortPinInputLevelCmosHysteresis, PortPinLevelValue=PORT_PIN_LEVEL_LOW, PortPinMode=SOT1, PortPinName=P026, PortPinNoiseFilterEnable=0, PortPinOutputDrive=PortPinOutputDrive5mA, PortPinPullUpDown=PortPinPullUpDownDisabled
          TFT_VSYNC: PortPinDigitalInputEnable=0, PortPinDirection=PORT_PIN_OUT, PortPinDirectionChangeable=0, PortPinId=155, PortPinInitialMode=DSP1_CTRL1, PortPinInputLevel=PortPinInputLevelCmosHysteresis, PortPinLevelValue=PORT_PIN_LEVEL_LOW, PortPinMode=DSP1_CTRL1, PortPinName=P427, PortPinNoiseFilterEnable=0, PortPinOutputDrive=PortPinOutputDrive1mA, PortPinPullUpDown=PortPinPullUpDownDisabled
          THERM1_ANG_MCU_IN: PortPinDigitalInputEnable=0, PortPinDirection=PORT_PIN_IN, PortPinDirectionChangeable=0, PortPinId=93, PortPinInitialMode=GPIO, PortPinInputLevel=PortPinInputLevelCmosHysteresis, PortPinLevelValue=PORT_PIN_LEVEL_LOW, PortPinMode=GPIO, PortPinName=P229, PortPinNoiseFilterEnable=1, PortPinOutputDrive=PortPinOutputDrive5mA, PortPinPullUpDown=PortPinPullUpDownDisabled
          THERM2_ANG_MCU_IN: PortPinDigitalInputEnable=0, PortPinDirection=PORT_PIN_IN, PortPinDirectionChangeable=0, PortPinId=133, PortPinInitialMode=GPIO, PortPinInputLevel=PortPinInputLevelCmosHysteresis, PortPinLevelValue=PORT_PIN_LEVEL_LOW, PortPinMode=GPIO, PortPinName=P405, PortPinNoiseFilterEnable=1, PortPinOutputDrive=PortPinOutputDrive5mA, PortPinPullUpDown=PortPinPullUpDownDisabled
          TRIPSW1_ANG_MCU_IN: PortPinDigitalInputEnable=0, PortPinDirection=PORT_PIN_IN, PortPinDirectionChangeable=0, PortPinId=110, PortPinInitialMode=GPIO, PortPinInputLevel=PortPinInputLevelCmosHysteresis, PortPinLevelValue=PORT_PIN_LEVEL_LOW, PortPinMode=GPIO, PortPinName=P314, PortPinNoiseFilterEnable=1, PortPinOutputDrive=PortPinOutputDrive5mA, PortPinPullUpDown=PortPinPullUpDownDisabled
          TRIPSW2_ANG_MCU_IN: PortPinDigitalInputEnable=0, PortPinDirection=PORT_PIN_IN, PortPinDirectionChangeable=0, PortPinId=103, PortPinInitialMode=GPIO, PortPinInputLevel=PortPinInputLevelCmosHysteresis, PortPinLevelValue=PORT_PIN_LEVEL_LOW, PortPinMode=GPIO, PortPinName=P307, PortPinNoiseFilterEnable=1, PortPinOutputDrive=PortPinOutputDrive5mA, PortPinPullUpDown=PortPinPullUpDownDisabled
          TTABS_DIG_MCU_OUT: PortPinDigitalInputEnable=0, PortPinDirection=PORT_PIN_OUT, PortPinDirectionChangeable=0, PortPinId=191, PortPinInitialMode=GPIO, PortPinInputLevel=PortPinInputLevelCmosHysteresis, PortPinLevelValue=PORT_PIN_LEVEL_LOW, PortPinMode=GPIO, PortPinName=P531, PortPinNoiseFilterEnable=0, PortPinOutputDrive=PortPinOutputDrive5mA, PortPinPullUpDown=PortPinPullUpDownDisabled
          TTAIRBAG_DIG_MCU_OUT: PortPinDigitalInputEnable=0, PortPinDirection=PORT_PIN_OUT, PortPinDirectionChangeable=0, PortPinId=39, PortPinInitialMode=GPIO, PortPinInputLevel=PortPinInputLevelCmosHysteresis, PortPinLevelValue=PORT_PIN_LEVEL_LOW, PortPinMode=GPIO, PortPinName=P107, PortPinNoiseFilterEnable=0, PortPinOutputDrive=PortPinOutputDrive5mA, PortPinPullUpDown=PortPinPullUpDownDisabled
          TTBATTCHRG_DIG_MCU_OUT: PortPinDigitalInputEnable=0, PortPinDirection=PORT_PIN_OUT, PortPinDirectionChangeable=0, PortPinId=181, PortPinInitialMode=GPIO, PortPinInputLevel=PortPinInputLevelCmosHysteresis, PortPinLevelValue=PORT_PIN_LEVEL_LOW, PortPinMode=GPIO, PortPinName=P521, PortPinNoiseFilterEnable=0, PortPinOutputDrive=PortPinOutputDrive5mA, PortPinPullUpDown=PortPinPullUpDownDisabled
          TTESCOFF_DIG_MCU_OUT: PortPinDigitalInputEnable=0, PortPinDirection=PORT_PIN_OUT, PortPinDirectionChangeable=0, PortPinId=188, PortPinInitialMode=GPIO, PortPinInputLevel=PortPinInputLevelCmosHysteresis, PortPinLevelValue=PORT_PIN_LEVEL_LOW, PortPinMode=GPIO, PortPinName=P528, PortPinNoiseFilterEnable=0, PortPinOutputDrive=PortPinOutputDrive5mA, PortPinPullUpDown=PortPinPullUpDownDisabled
          TTESC_DIG_MCU_OUT: PortPinDigitalInputEnable=0, PortPinDirection=PORT_PIN_OUT, PortPinDirectionChangeable=0, PortPinId=1, PortPinInitialMode=GPIO, PortPinInputLevel=PortPinInputLevelCmosHysteresis, PortPinLevelValue=PORT_PIN_LEVEL_LOW, PortPinMode=GPIO, PortPinName=P001, PortPinNoiseFilterEnable=0, PortPinOutputDrive=PortPinOutputDrive5mA, PortPinPullUpDown=PortPinPullUpDownDisabled
          TTLEDLAMPFAIL_DIG_MCU_OUT: PortPinDigitalInputEnable=0, PortPinDirection=PORT_PIN_OUT, PortPinDirectionChangeable=0, PortPinId=41, PortPinInitialMode=GPIO, PortPinInputLevel=PortPinInputLevelCmosHysteresis, PortPinLevelValue=PORT_PIN_LEVEL_LOW, PortPinMode=GPIO, PortPinName=P109, PortPinNoiseFilterEnable=0, PortPinOutputDrive=PortPinOutputDrive5mA, PortPinPullUpDown=PortPinPullUpDownDisabled
          TTMDPS_DIG_MCU_OUT: PortPinDigitalInputEnable=0, PortPinDirection=PORT_PIN_OUT, PortPinDirectionChangeable=0, PortPinId=40, PortPinInitialMode=GPIO, PortPinInputLevel=PortPinInputLevelCmosHysteresis, PortPinLevelValue=PORT_PIN_LEVEL_LOW, PortPinMode=GPIO, PortPinName=P108, PortPinNoiseFilterEnable=0, PortPinOutputDrive=PortPinOutputDrive5mA, PortPinPullUpDown=PortPinPullUpDownDisabled
          TTMSTWRNG_DIG_MCU_OUT: PortPinDigitalInputEnable=0, PortPinDirection=PORT_PIN_OUT, PortPinDirectionChangeable=0, PortPinId=34, PortPinInitialMode=GPIO, PortPinInputLevel=PortPinInputLevelCmosHysteresis, PortPinLevelValue=PORT_PIN_LEVEL_LOW, PortPinMode=GPIO, PortPinName=P102, PortPinNoiseFilterEnable=0, PortPinOutputDrive=PortPinOutputDrive5mA, PortPinPullUpDown=PortPinPullUpDownDisabled
          TTPARKINGBRAKE_DIG_MCU_OUT: PortPinDigitalInputEnable=0, PortPinDirection=PORT_PIN_OUT, PortPinDirectionChangeable=0, PortPinId=33, PortPinInitialMode=GPIO, PortPinInputLevel=PortPinInputLevelCmosHysteresis, PortPinLevelValue=PORT_PIN_LEVEL_LOW, PortPinMode=GPIO, PortPinName=P101, PortPinNoiseFilterEnable=0, PortPinOutputDrive=PortPinOutputDrive5mA, PortPinPullUpDown=PortPinPullUpDownDisabled
          TTPWM_PWM_MCU_OUT: PortPinDigitalInputEnable=0, PortPinDirection=PORT_PIN_OUT, PortPinDirectionChangeable=0, PortPinId=124, PortPinInitialMode=PPG10_TOUT0, PortPinInputLevel=PortPinInputLevelCmosHysteresis, PortPinLevelValue=PORT_PIN_LEVEL_LOW, PortPinMode=PPG10_TOUT0, PortPinName=P328, PortPinNoiseFilterEnable=0, PortPinOutputDrive=PortPinOutputDrive5mA, PortPinPullUpDown=PortPinPullUpDownDisabled
          TTSPARE1_DIG_MCU_OUT: PortPinDigitalInputEnable=0, PortPinDirection=PORT_PIN_OUT, PortPinDirectionChangeable=0, PortPinId=37, PortPinInitialMode=GPIO, PortPinInputLevel=PortPinInputLevelCmosHysteresis, PortPinLevelValue=PORT_PIN_LEVEL_LOW, PortPinMode=GPIO, PortPinName=P105, PortPinNoiseFilterEnable=0, PortPinOutputDrive=PortPinOutputDrive5mA, PortPinPullUpDown=PortPinPullUpDownDisabled
          TTSPARE2_DIG_MCU_OUT: PortPinDigitalInputEnable=0, PortPinDirection=PORT_PIN_OUT, PortPinDirectionChangeable=0, PortPinId=2, PortPinInitialMode=GPIO, PortPinInputLevel=PortPinInputLevelCmosHysteresis, PortPinLevelValue=PORT_PIN_LEVEL_LOW, PortPinMode=GPIO, PortPinName=P002, PortPinNoiseFilterEnable=0, PortPinOutputDrive=PortPinOutputDrive5mA, PortPinPullUpDown=PortPinPullUpDownDisabled
          TTSPARE3_DIG_MCU_OUT: PortPinDigitalInputEnable=0, PortPinDirection=PORT_PIN_OUT, PortPinDirectionChangeable=0, PortPinId=36, PortPinInitialMode=GPIO, PortPinInputLevel=PortPinInputLevelCmosHysteresis, PortPinLevelValue=PORT_PIN_LEVEL_LOW, PortPinMode=GPIO, PortPinName=P104, PortPinNoiseFilterEnable=0, PortPinOutputDrive=PortPinOutputDrive5mA, PortPinPullUpDown=PortPinPullUpDownDisabled
          TTSPARE4_DIG_MCU_OUT: PortPinDigitalInputEnable=0, PortPinDirection=PORT_PIN_OUT, PortPinDirectionChangeable=0, PortPinId=189, PortPinInitialMode=GPIO, PortPinInputLevel=PortPinInputLevelCmosHysteresis, PortPinLevelValue=PORT_PIN_LEVEL_LOW, PortPinMode=GPIO, PortPinName=P529, PortPinNoiseFilterEnable=0, PortPinOutputDrive=PortPinOutputDrive5mA, PortPinPullUpDown=PortPinPullUpDownDisabled
          TTSPDSRGCLR_DIGAL_MCU_OUT: PortPinDigitalInputEnable=0, PortPinDirection=PORT_PIN_OUT, PortPinDirectionChangeable=0, PortPinId=105, PortPinInitialMode=GPIO, PortPinInputLevel=PortPinInputLevelCmosHysteresis, PortPinLevelValue=PORT_PIN_LEVEL_LOW, PortPinMode=GPIO, PortPinName=P309, PortPinNoiseFilterEnable=0, PortPinOutputDrive=PortPinOutputDrive2mA, PortPinPullUpDown=PortPinPullUpDownDisabled
          TTSPDSRGOE_DIGAL_MCU_OUT: PortPinDigitalInputEnable=0, PortPinDirection=PORT_PIN_OUT, PortPinDirectionChangeable=0, PortPinId=95, PortPinInitialMode=GPIO, PortPinInputLevel=PortPinInputLevelCmosHysteresis, PortPinLevelValue=PORT_PIN_LEVEL_HIGH, PortPinMode=GPIO, PortPinName=P231, PortPinNoiseFilterEnable=0, PortPinOutputDrive=PortPinOutputDrive5mA, PortPinPullUpDown=PortPinPullUpDownDisabled
          TTSRGRCK_DIG_MCU_OUT: PortPinDigitalInputEnable=0, PortPinDirection=PORT_PIN_OUT, PortPinDirectionChangeable=0, PortPinId=118, PortPinInitialMode=GPIO, PortPinInputLevel=PortPinInputLevelCmosHysteresis, PortPinLevelValue=PORT_PIN_LEVEL_LOW, PortPinMode=GPIO, PortPinName=P322, PortPinNoiseFilterEnable=0, PortPinOutputDrive=PortPinOutputDrive5mA, PortPinPullUpDown=PortPinPullUpDownDisabled
          TTSRGSERIN_DIG_MCU_OUT: PortPinDigitalInputEnable=0, PortPinDirection=PORT_PIN_OUT, PortPinDirectionChangeable=0, PortPinId=89, PortPinInitialMode=SOT0, PortPinInputLevel=PortPinInputLevelCmosHysteresis, PortPinLevelValue=PORT_PIN_LEVEL_LOW, PortPinMode=SOT0, PortPinName=P225, PortPinNoiseFilterEnable=0, PortPinOutputDrive=PortPinOutputDrive5mA, PortPinPullUpDown=PortPinPullUpDownDisabled
          TTSRGSEROUT_DIG_MCU_IN: PortPinDigitalInputEnable=1, PortPinDirection=PORT_PIN_IN, PortPinDirectionChangeable=0, PortPinId=192, PortPinInitialMode=GPIO, PortPinInputLevel=PortPinInputLevelCmosHysteresis, PortPinLevelValue=PORT_PIN_LEVEL_LOW, PortPinMode=GPIO, PortPinName=P600, PortPinNoiseFilterEnable=0, PortPinOutputDrive=PortPinOutputDrive2mA, PortPinPullUpDown=PortPinPullUpDownDisabled
          TTSRGSRCK_DIG_MCU_OUT: PortPinDigitalInputEnable=0, PortPinDirection=PORT_PIN_OUT, PortPinDirectionChangeable=0, PortPinId=90, PortPinInitialMode=SCK0, PortPinInputLevel=PortPinInputLevelCmosHysteresis, PortPinLevelValue=PORT_PIN_LEVEL_LOW, PortPinMode=SCK0, PortPinName=P226, PortPinNoiseFilterEnable=0, PortPinOutputDrive=PortPinOutputDrive5mA, PortPinPullUpDown=PortPinPullUpDownDisabled
          UNUSED_PORTPIN0_03: PortPinDigitalInputEnable=0, PortPinDirection=PORT_PIN_OUT, PortPinDirectionChangeable=0, PortPinId=3, PortPinInitialMode=GPIO, PortPinInputLevel=PortPinInputLevelCmosHysteresis, PortPinLevelValue=PORT_PIN_LEVEL_LOW, PortPinMode=GPIO, PortPinName=P003, PortPinNoiseFilterEnable=0, PortPinOutputDrive=PortPinOutputDrive5mA, PortPinPullUpDown=PortPinPullUpDownDisabled
          UNUSED_PORTPIN1_00: PortPinDigitalInputEnable=0, PortPinDirection=PORT_PIN_OUT, PortPinDirectionChangeable=0, PortPinId=32, PortPinInitialMode=GPIO, PortPinInputLevel=PortPinInputLevelCmosHysteresis, PortPinLevelValue=PORT_PIN_LEVEL_LOW, PortPinMode=GPIO, PortPinName=P100, PortPinNoiseFilterEnable=0, PortPinOutputDrive=PortPinOutputDrive2mA, PortPinPullUpDown=PortPinPullUpDownDisabled
          UNUSED_PORTPIN5_05: PortPinDigitalInputEnable=0, PortPinDirection=PORT_PIN_OUT, PortPinDirectionChangeable=0, PortPinId=165, PortPinInitialMode=GPIO, PortPinInputLevel=PortPinInputLevelCmosHysteresis, PortPinLevelValue=PORT_PIN_LEVEL_LOW, PortPinMode=GPIO, PortPinName=P505, PortPinNoiseFilterEnable=0, PortPinOutputDrive=PortPinOutputDrive5mA, PortPinPullUpDown=PortPinPullUpDownDisabled
          UNUSED_PORTPIN5_13: PortPinDigitalInputEnable=0, PortPinDirection=PORT_PIN_OUT, PortPinDirectionChangeable=0, PortPinId=173, PortPinInitialMode=GPIO, PortPinInputLevel=PortPinInputLevelCmosHysteresis, PortPinLevelValue=PORT_PIN_LEVEL_LOW, PortPinMode=GPIO, PortPinName=P513, PortPinNoiseFilterEnable=0, PortPinOutputDrive=PortPinOutputDrive5mA, PortPinPullUpDown=PortPinPullUpDownDisabled
          UNUSED_PORTPIN5_22: PortPinDigitalInputEnable=0, PortPinDirection=PORT_PIN_OUT, PortPinDirectionChangeable=0, PortPinId=182, PortPinInitialMode=GPIO, PortPinInputLevel=PortPinInputLevelCmosHysteresis, PortPinLevelValue=PORT_PIN_LEVEL_LOW, PortPinMode=GPIO, PortPinName=P522, PortPinNoiseFilterEnable=0, PortPinOutputDrive=PortPinOutputDrive2mA, PortPinPullUpDown=PortPinPullUpDownDisabled
          UNUSED_PORTPIN5_27: PortPinDigitalInputEnable=0, PortPinDirection=PORT_PIN_OUT, PortPinDirectionChangeable=0, PortPinId=187, PortPinInitialMode=GPIO, PortPinInputLevel=PortPinInputLevelCmosHysteresis, PortPinLevelValue=PORT_PIN_LEVEL_LOW, PortPinMode=GPIO, PortPinName=P527, PortPinNoiseFilterEnable=0, PortPinOutputDrive=PortPinOutputDrive5mA, PortPinPullUpDown=PortPinPullUpDownDisabled
          WATER_SEP_AH_MCU_IN: PortPinDigitalInputEnable=1, PortPinDirection=PORT_PIN_IN, PortPinDirectionChangeable=0, PortPinId=94, PortPinInitialMode=GPIO, PortPinInputLevel=PortPinInputLevelAutomotive, PortPinLevelValue=PORT_PIN_LEVEL_LOW, PortPinMode=GPIO, PortPinName=P230, PortPinNoiseFilterEnable=0, PortPinOutputDrive=PortPinOutputDrive5mA, PortPinPullUpDown=PortPinPullUpDownDisabled
    PortGeneral:
      PortDevErrorDetect = 0
      PortErrorCalloutFunction = ErrorCalloutHandler
      PortIncludeFile = ErrorCalloutHandler.h
      PortSafetyFunctionApi = 1
      PortSetAnalogInputEnableRegister = 1
      PortSetComverOutputEnableRegister = 1
      PortSetPinDirectionApi = 1
      PortSetPinModeApi = 1
      PortSetPortPinEnableRegister = 1
      PortSetResourceInputModeApi = 1
      PortSetSegerOutputEnableRegister = 1
      PortVersionInfoApi = 1
    PortResourceInputConfigSet_PSS (PortResourceInputConfigSet): PortResourceConfigSetId=1
      3 x PortResourceInput:
        PSS_CCANRX_NETWRK_MCU_IN: PortInputMode=P303, PortResource=EINT3
        PSS_IGNSENSE_DIGAL_MCU_IN: PortInputMode=P306, PortResource=EINT6
        PSS_MCANRX_NETWRK_MCU_IN: PortInputMode=P316, PortResource=EINT0
    PortResourceInputConfigSet_RUN (PortResourceInputConfigSet): PortResourceConfigSetId=0
      26 x PortResourceInput:
        AIRBAGDIAG_ANG_MCU_IN: PortInputMode=P228, PortResource=AN4
        CCANRX_NETWRK_MCU_IN: PortInputMode=PORT_PIN, PortResource=RX0
        FUELSENDER_ANG_MCU_IN: PortInputMode=P308, PortResource=AN16
        FUEL_1M_AN47_MCU_IN: PortInputMode=P410, PortResource=AN47
        FUEL_1P_AN46_MCU_IN: PortInputMode=P409, PortResource=AN46
        FUEL_2M_AN49_MCU_IN: PortInputMode=P412, PortResource=AN49
        FUEL_2P_AN48_MCU_IN: PortInputMode=P411, PortResource=AN48
        IGNSENSE_DIGAL_MCU_IN: PortInputMode=P306, PortResource=EINT6
        MCANERR_DIG_MCU_IN: PortInputMode=P318, PortResource=EINT2
        MCANRX_NETWRK_MCU_IN: PortInputMode=P316, PortResource=RX6
        POWER_FAULT: PortInputMode=P016, PortResource=EINT1
        SBATTMON_ANG_MCU_IN: PortInputMode=P310, PortResource=AN18
        SFUELBATTMON_ANG_MCU_IN: PortInputMode=P313, PortResource=AN21
        SPEEDIN_DIGAL_MCU_IN: PortInputMode=P406, PortResource=ICU3_IN0
        TACHO_1M_AN35_MCU_IN: PortInputMode=P330, PortResource=AN35
        TACHO_1P_AN34_MCU_IN: PortInputMode=P329, PortResource=AN34
        TACHO_2M_AN37_MCU_IN: PortInputMode=P400, PortResource=AN37
        TACHO_2P_AN36_MCU_IN: PortInputMode=P331, PortResource=AN36
        TEMP_1M_AN39_MCU_IN: PortInputMode=P402, PortResource=AN39
        TEMP_1P_AN38_MCU_IN: PortInputMode=P401, PortResource=AN38
        TEMP_2M_AN41_MCU_IN: PortInputMode=P404, PortResource=AN41
        TEMP_2P_AN40_MCU_IN: PortInputMode=P403, PortResource=AN40
        THERM1_ANG_MCU_IN: PortInputMode=P229, PortResource=AN5
        THERM2_ANG_MCU_IN: PortInputMode=P405, PortResource=AN42
        TRIPSW1_ANG_MCU_IN: PortInputMode=P314, PortResource=AN22
        TRIPSW2_ANG_MCU_IN: PortInputMode=P307, PortResource=AN15
