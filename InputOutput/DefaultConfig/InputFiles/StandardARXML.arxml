[part 2 of 2: packages /Gpt to /Spi]
AUTOSAR XML (schema 4-2-1)
package /Gpt
  module config Gpt: implementation-config-variant=VARIANT-PRE-COMPILE, module-description=Gpt_Impl
    GptChannelConfigSet_0 (GptChannelConfigSet)
      9 x GptChannelConfiguration, all with GptChannelPrescale=GPT_PRESCALE_1, GptChannelTickValueMax=4294967295, GptEnableWakeup=0:
        GptChCfg_60MHzFRT: GptChannelClkSrc=CLK_LCP0A, GptChannelId=0, GptChannelMode=GPT_CH_MODE_CONTINUOUS, GptChannelTickFrequency=6.0E7, GptTimer=FRT_0, GptChannelClkSrcRef=GptClockReferencePoint_0
        OsTickTimer: GptChannelClkSrc=CLK_LLPBM2, GptChannelId=5, GptChannelMode=GPT_CH_MODE_CONTINUOUS, GptChannelTickFrequency=1.2E8, GptEnableDebug=0, GptNotification=, GptTimer=RLT_34, GptChannelClkSrcRef=GptClockReferencePoint_1
        PIC_Tmr: GptChannelClkSrc=CLK_LCP0A, GptChannelId=7, GptChannelMode=GPT_CH_MODE_CONTINUOUS, GptChannelTickFrequency=6.0E7, GptTimer=FRT_7, GptChannelClkSrcRef=GptClockReferencePoint_0
        PulseOut_Timer: GptChannelClkSrc=CLK_LCP0A, GptChannelId=8, GptChannelMode=GPT_CH_MODE_ONESHOT, GptChannelTickFrequency=6.0E7, GptNotification=IoHwAb_PulseOut_Cbk_Notification, GptTimer=FRT_6, GptChannelClkSrcRef=GptClockReferencePoint_0
        Rtm_FRT: GptChannelClkSrc=CLK_LCP0A, GptChannelId=6, GptChannelMode=GPT_CH_MODE_CONTINUOUS, GptChannelTickFrequency=6.0E7, GptTimer=FRT_1, GptChannelClkSrcRef=GptClockReferencePoint_0
        StpCdd: GptChannelClkSrc=CLK_LCP0A, GptChannelId=4, GptChannelMode=GPT_CH_MODE_CONTINUOUS, GptChannelTickFrequency=6.0E7, GptNotification=StpIf_TimerISR, GptTimer=FRT_5, GptChannelClkSrcRef=GptClockReferencePoint_0
        TmExt: GptChannelClkSrc=CLK_LCP0A, GptChannelId=3, GptChannelMode=GPT_CH_MODE_CONTINUOUS, GptChannelTickFrequency=6.0E7, GptNotification=TmExt_UpdateFreeRunningCounter, GptTimer=FRT_4, GptChannelClkSrcRef=GptClockReferencePoint_0
        Wdg_TO: GptChannelClkSrc=CLK_LLPBM2, GptChannelId=1, GptChannelMode=GPT_CH_MODE_ONESHOT, GptChannelTickFrequency=6.0E7, GptEnableDebug=1, GptNotification=Wdg_66_IA_Cbk_GptNotificationTimeout, GptTimer=RLT_32, GptChannelClkSrcRef=GptClockReferencePoint_1
        Wdg_Trg: GptChannelClkSrc=CLK_LLPBM2, GptChannelId=2, GptChannelMode=GPT_CH_MODE_CONTINUOUS, GptChannelTickFrequency=6.0E7, GptEnableDebug=1, GptNotification=Wdg_66_IA_Cbk_GptNotificationTrigger, GptTimer=RLT_33, GptChannelClkSrcRef=GptClockReferencePoint_1
    GptConfigurationOfOptApiServices:
      GptDeinitApi = 1
      GptEnableDisableNotificationApi = 1
      GptSafetyFunctionApi = 1
      GptTimeElapsedApi = 1
      GptTimeRemainingApi = 1
      GptVersionInfoApi = 1
      GptWakeupFunctionalityApi = 0
    GptDriverConfiguration:
      GptDevErrorDetect = 1
      GptErrorCalloutFunction = ErrorCalloutHandler
      GptIncludeFile = ErrorCalloutHandler.h
      GptIncludeFile = Wdg_Cbk.h
      GptIncludeFile = TmExt_Cfg.h
      GptIncludeFile = StpIfCdd.h
      GptIncludeFile = IoHwAb_Cbk.h
      GptReportWakeupSource = 0
      GptClockReferencePoint_0 (GptClockReferencePoint): GptClockReference=McuClockSettingConfig_RUN/McuClockReferencePoint_LCP0A
      GptClockReferencePoint_1 (GptClockReferencePoint): GptClockReference=McuClockSettingConfig_RUN/McuClockReferencePoint_LLPBM2
package /EcuM
  module config EcuM: implementation-config-variant=VARIANT-POST-BUILD
    CommonPublishedInformation: ArMajorVersion=0, ArMinorVersion=0, ArPatchVersion=0, ModuleId=10, Release=, SwMajorVersion=4, SwMinorVersion=3, SwPatchVersion=0, VendorId=1
    EcuMConfiguration
      EcuMCommonConfiguration: EcuMConfigConsistencyHash=0, EcuMDefaultAppMode=OsAppMode_0, EcuMNormalMcuModeRef=McuModeSettingConf_PSS, EcuMOSResource=OsResource_0
        EcuMDefaultShutdownTarget: EcuMDefaultState=EcuMStateOff
        EcuMSleepMode_0 (EcuMSleepMode): EcuMSleepModeId=0, EcuMSleepModeSuspend=1, EcuMSleepModeMcuModeRef=McuModeSettingConf_RUN, EcuMWakeupSourceMask=CAN_f26020e5
        CAN_f26020e5 (EcuMWakeupSource): EcuMWakeupSourceId=5, EcuMWakeupSourcePolling=0, EcuMResetReasonRef=CAN_f26020e5
    EcuMGeneral: EcuMDevErrorDetect=1, EcuMIncludeDem=1, EcuMIncludeDet=1, EcuMMainFunctionPeriod=0.0, EcuMVersionInfoApi=1
package /Can
  module config Can: implementation-config-variant=VARIANT-PRE-COMPILE
    CanConfigSet_0 (CanConfigSet)
      CanController_0 (CanController):
        CanBusoffProcessing = INTERRUPT
        CanControllerActivation = 1
        CanControllerBaseAddress = 2959933440
        CanControllerId = 0
        CanControllerPhysicalChannel = CAN6
        CanMessageRamBaseAddress = 2959966208
        CanMessageRamOffset = 0
        CanMessageRamSize = 16380
        CanRxProcessing = INTERRUPT
        CanTxProcessing = INTERRUPT
        CanWakeupFunctionalityAPI = 1
        CanWakeupProcessing = INTERRUPT
        CanWakeupSupport = 1
        CanControllerDefaultBaudrate = CanControllerBaudrateConfig_0
        CanCpuClockRef = McuClockSettingConfig_RUN/McuClockReferencePoint_COMH
        CanWakeupSourceRef = CAN_f26020e5
        CanControllerBaudrateConfig_0 (CanControllerBaudrateConfig):
          CanControllerBaudRate = 500
          CanControllerBaudRateConfigID = 0
          CanControllerPropSeg = 0
          CanControllerSeg1 = 12
          CanControllerSeg2 = 3
          CanControllerSyncJumpWidth = 2
        Rx_NM (CanFilterMask): CanFilterMaskValue=1920
      44 x CanHardwareObject, all with CanHandleType=FULL, CanHwObjectCount=1, CanIdType=STANDARD, CanControllerRef=CanController_0:
        HRH_ABS11: CanObjectId=3, CanObjectType=RECEIVE, CanRxBufferSelection=CAN_RX_DEDICATED
          CanHwFilter_0 (CanHwFilter): CanHwFilterCode=906, CanHwFilterMask=2047
        HRH_ACU14: CanObjectId=0, CanObjectType=RECEIVE, CanRxBufferSelection=CAN_RX_DEDICATED
          CanHwFilter_0 (CanHwFilter): CanHwFilterCode=1280, CanHwFilterMask=2047
        HRH_AFS11: CanObjectId=1, CanObjectType=RECEIVE, CanRxBufferSelection=CAN_RX_DEDICATED
          CanHwFilter_0 (CanHwFilter): CanHwFilterCode=1425, CanHwFilterMask=2047
        HRH_BCW11: CanObjectId=2, CanObjectType=RECEIVE, CanRxBufferSelection=CAN_RX_DEDICATED
          CanHwFilter_0 (CanHwFilter): CanHwFilterCode=1419, CanHwFilterMask=2047
        HRH_CGW1: CanObjectId=4, CanObjectType=RECEIVE, CanRxBufferSelection=CAN_RX_DEDICATED
          CanHwFilter_0 (CanHwFilter): CanHwFilterCode=1345, CanHwFilterMask=2047
        HRH_CGW2: CanObjectId=5, CanObjectType=RECEIVE, CanRxBufferSelection=CAN_RX_DEDICATED
          CanHwFilter_0 (CanHwFilter): CanHwFilterCode=1363, CanHwFilterMask=2047
        HRH_CGW4: CanObjectId=6, CanObjectType=RECEIVE, CanRxBufferSelection=CAN_RX_DEDICATED
          CanHwFilter_0 (CanHwFilter): CanHwFilterCode=1369, CanHwFilterMask=2047
        HRH_CGW5: CanObjectId=7, CanObjectType=RECEIVE, CanRxBufferSelection=CAN_RX_DEDICATED
          CanHwFilter_0 (CanHwFilter): CanHwFilterCode=127, CanHwFilterMask=2047
        HRH_CGW6: CanObjectId=8, CanObjectType=RECEIVE, CanRxBufferSelection=CAN_RX_DEDICATED
          CanHwFilter_0 (CanHwFilter): CanHwFilterCode=1294, CanHwFilterMask=2047
        HRH_CGW_PC1: CanObjectId=9, CanObjectType=RECEIVE, CanRxBufferSelection=CAN_RX_DEDICATED
          CanHwFilter_0 (CanHwFilter): CanHwFilterCode=1107, CanHwFilterMask=2047
        HRH_CGW_PC2: CanObjectId=10, CanObjectType=RECEIVE, CanRxBufferSelection=CAN_RX_DEDICATED
          CanHwFilter_0 (CanHwFilter): CanHwFilterCode=1384, CanHwFilterMask=2047
        HRH_CGW_PC3: CanObjectId=11, CanObjectType=RECEIVE, CanRxBufferSelection=CAN_RX_DEDICATED
          CanHwFilter_0 (CanHwFilter): CanHwFilterCode=1394, CanHwFilterMask=2047
        HRH_CGW_PC4: CanObjectId=12, CanObjectType=RECEIVE, CanRxBufferSelection=CAN_RX_DEDICATED
          CanHwFilter_0 (CanHwFilter): CanHwFilterCode=870, CanHwFilterMask=2047
        HRH_CGW_PC5: CanObjectId=13, CanObjectType=RECEIVE, CanRxBufferSelection=CAN_RX_DEDICATED
          CanHwFilter_0 (CanHwFilter): CanHwFilterCode=871, CanHwFilterMask=2047
        HRH_CGW_PC6: CanObjectId=14, CanObjectType=RECEIVE, CanRxBufferSelection=CAN_RX_DEDICATED
          CanHwFilter_0 (CanHwFilter): CanHwFilterCode=872, CanHwFilterMask=2047
        HRH_CGW_PC8: CanObjectId=15, CanObjectType=RECEIVE, CanRxBufferSelection=CAN_RX_DEDICATED
          CanHwFilter_0 (CanHwFilter): CanHwFilterCode=854, CanHwFilterMask=2047
        HRH_CGW_USM1: CanObjectId=16, CanObjectType=RECEIVE, CanRxBufferSelection=CAN_RX_DEDICATED
          CanHwFilter_0 (CanHwFilter): CanHwFilterCode=1040, CanHwFilterMask=2047
        HRH_CGW_USM2: CanObjectId=17, CanObjectType=RECEIVE, CanRxBufferSelection=CAN_RX_DEDICATED
          CanHwFilter_0 (CanHwFilter): CanHwFilterCode=1042, CanHwFilterMask=2047
        HRH_DATC13: CanObjectId=18, CanObjectType=RECEIVE, CanRxBufferSelection=CAN_RX_DEDICATED
          CanHwFilter_0 (CanHwFilter): CanHwFilterCode=67, CanHwFilterMask=2047
        HRH_EMS12: CanObjectId=19, CanObjectType=RECEIVE, CanRxBufferSelection=CAN_RX_DEDICATED
          CanHwFilter_0 (CanHwFilter): CanHwFilterCode=809, CanHwFilterMask=2047
        HRH_EMS16: CanObjectId=20, CanObjectType=RECEIVE, CanRxBufferSelection=CAN_RX_DEDICATED
          CanHwFilter_0 (CanHwFilter): CanHwFilterCode=608, CanHwFilterMask=2047
        HRH_EMS19: CanObjectId=21, CanObjectType=RECEIVE, CanRxBufferSelection=CAN_RX_DEDICATED
          CanHwFilter_0 (CanHwFilter): CanHwFilterCode=1170, CanHwFilterMask=2047
        HRH_EMS21: CanObjectId=22, CanObjectType=RECEIVE, CanRxBufferSelection=CAN_RX_DEDICATED
          CanHwFilter_0 (CanHwFilter): CanHwFilterCode=1479, CanHwFilterMask=2047
        HRH_EVP11: CanObjectId=23, CanObjectType=RECEIVE, CanRxBufferSelection=CAN_RX_DEDICATED
          CanHwFilter_0 (CanHwFilter): CanHwFilterCode=1414, CanHwFilterMask=2047
        HRH_FCA11: CanObjectId=29, CanObjectType=RECEIVE, CanRxBufferSelection=CAN_RX_DEDICATED
          CanHwFilter_0 (CanHwFilter): CanHwFilterCode=909, CanHwFilterMask=2047
        HRH_LKA11: CanObjectId=30, CanObjectType=RECEIVE, CanRxBufferSelection=CAN_RX_DEDICATED
          CanHwFilter_0 (CanHwFilter): CanHwFilterCode=832, CanHwFilterMask=2047
        HRH_LKA12: CanObjectId=31, CanObjectType=RECEIVE, CanRxBufferSelection=CAN_RX_DEDICATED
          CanHwFilter_0 (CanHwFilter): CanHwFilterCode=1342, CanHwFilterMask=2047
        HRH_MDPS11: CanObjectId=32, CanObjectType=RECEIVE, CanRxBufferSelection=CAN_RX_DEDICATED
          CanHwFilter_0 (CanHwFilter): CanHwFilterCode=897, CanHwFilterMask=2047
        HRH_PAS11: CanObjectId=24, CanObjectType=RECEIVE, CanRxBufferSelection=CAN_RX_DEDICATED
          CanHwFilter_0 (CanHwFilter): CanHwFilterCode=1078, CanHwFilterMask=2047
        HRH_SCC11: CanObjectId=33, CanObjectType=RECEIVE, CanRxBufferSelection=CAN_RX_DEDICATED
          CanHwFilter_0 (CanHwFilter): CanHwFilterCode=1056, CanHwFilterMask=2047
        HRH_SCC12: CanObjectId=34, CanObjectType=RECEIVE, CanRxBufferSelection=CAN_RX_DEDICATED
          CanHwFilter_0 (CanHwFilter): CanHwFilterCode=1057, CanHwFilterMask=2047
        HRH_SCC13: CanObjectId=35, CanObjectType=RECEIVE, CanRxBufferSelection=CAN_RX_DEDICATED
          CanHwFilter_0 (CanHwFilter): CanHwFilterCode=1290, CanHwFilterMask=2047
        HRH_SCC14: CanObjectId=36, CanObjectType=RECEIVE, CanRxBufferSelection=CAN_RX_DEDICATED
          CanHwFilter_0 (CanHwFilter): CanHwFilterCode=905, CanHwFilterMask=2047
        HRH_TCS15: CanObjectId=28, CanObjectType=RECEIVE, CanRxBufferSelection=CAN_RX_DEDICATED
          CanHwFilter_0 (CanHwFilter): CanHwFilterCode=1287, CanHwFilterMask=2047
        HRH_TCU_DCT13: CanObjectId=25, CanObjectType=RECEIVE, CanRxBufferSelection=CAN_RX_DEDICATED
          CanHwFilter_0 (CanHwFilter): CanHwFilterCode=354, CanHwFilterMask=2047
        HRH_TPMS11: CanObjectId=26, CanObjectType=RECEIVE, CanRxBufferSelection=CAN_RX_DEDICATED
          CanHwFilter_0 (CanHwFilter): CanHwFilterCode=1427, CanHwFilterMask=2047
        HRH_WHL_SPD11: CanObjectId=27, CanObjectType=RECEIVE, CanRxBufferSelection=CAN_RX_DEDICATED
          CanHwFilter_0 (CanHwFilter): CanHwFilterCode=902, CanHwFilterMask=2047
        HTH_CLU11: CanFdPaddingValue=255, CanObjectId=37, CanObjectType=TRANSMIT, CanTriggerTransmitEnable=0
        HTH_CLU12: CanFdPaddingValue=255, CanObjectId=38, CanObjectType=TRANSMIT, CanTriggerTransmitEnable=0
        HTH_CLU13: CanFdPaddingValue=255, CanObjectId=39, CanObjectType=TRANSMIT, CanTriggerTransmitEnable=0
        HTH_CLU14: CanFdPaddingValue=255, CanObjectId=40, CanObjectType=TRANSMIT, CanTriggerTransmitEnable=0
        HTH_CLU15: CanFdPaddingValue=255, CanObjectId=41, CanObjectType=TRANSMIT, CanTriggerTransmitEnable=0
        HTH_CLU16: CanFdPaddingValue=255, CanObjectId=42, CanObjectType=TRANSMIT, CanTriggerTransmitEnable=0
        HTH_CLU18: CanFdPaddingValue=255, CanObjectId=43, CanObjectType=TRANSMIT, CanTriggerTransmitEnable=0
    CanGeneral:
      CanChangeBaudrateApi = 0
      CanDevErrorDetection = 1
      CanErrorCalloutFunction = ErrorCalloutHandler
      CanGetStatusApi = 1
      CanHardwareCancellation = 0
      CanIdenticalIdCancellation = 0
      CanIncludeFile = ErrorCalloutHandler.h
      CanIndex = 0
      CanMainFunctionModePeriod = 1.0
      CanMultiplexedTransmission = 1
      CanPrescalerValue = 1
      CanPublicIcomSupport = 0
      CanRxIndicationCompatibility = CAN_ASR_403_COMPATIBILITY
      CanTimeoutDuration = 2.0
      CanVersionInfoApi = 1
      CanBaudRateClockRef = McuClockSettingConfig_RUN/McuClockReferencePoint_MAIN
      CanCounterRef = OsCounter_0
      CanMainFunctionRWPeriods
package /Wdg
  module config Wdg: implementation-config-variant=VARIANT-PRE-COMPILE, module-description=Wdg_Impl
    WdgGeneral:
      WdgDemEventDisableRejected = 0
      WdgDemEventModeFailed = 0
      WdgDemEventTimeout = 0
      WdgDevErrorDetect = 1
      WdgDisableAllowed = 0
      WdgErrorCalloutFunction = ErrorCalloutHandler
      WdgIndex = 0
      WdgInitialTimeout = 0.5
      WdgMaxTimeout = 0.5
      WdgRunArea = ROM
      WdgTriggerAddress = 130816
      WdgTriggerLocation = Wdg_66_IA_ActivateTrigger
      WdgVendorApiInfixEnabled = 0
      WdgVersionInfoApi = 1
    WdgGptChannelParameterRefs_K2 (WdgGptChannelParameterRefs): WdgTimeoutTimer=Wdg_TO, WdgTriggerTimer=Wdg_Trg
    WdgPublishedInformation: WdgTriggerMode=WDG_BOTH
    Hw_WdgCfg (WdgSettingsConfig):
      WdgClockSelection = SlowCRClock
      WdgDefaultMode = WDGIF_SLOW_MODE
      WdgDefaultModePss = WDGIF_OFF_MODE
      WdgEnablePrewarnIrq = 0
      WdgEnableWDGCounterMonitor = 0
      WdgHwUnit = WDG_HWDG_UNIT
      WdgNmiNotification = Wdg_66_IA_NmiNotification
      WdgPrewarnNotification = Wdg_66_IA_PrewarnNotification
      WdgResetDelay = 0
      WdgResetNMIConfig = WDG_SOFTRESET
      WdgSettingsFast
      WdgSettingsOff
      WdgSettingsSlow: WdgSlowTrgValue=6000000, WdgSlowValuePss=2147483648, WdgSlowValueRun=50000, WdgSlowWindowPss=50, WdgSlowWindowRun=100
    Sw_WdgCfg (WdgSettingsConfig):
      WdgClockSelection = SlowCRClock
      WdgDefaultMode = WDGIF_SLOW_MODE
      WdgDefaultModePss = WDGIF_SLOW_MODE
      WdgEnablePrewarnIrq = 0
      WdgEnableWDGCounterMonitor = 0
      WdgHwUnit = WDG_SWDG_UNIT_0
      WdgNmiNotification = Wdg_66_IA_NmiNotification
      WdgPrewarnNotification = Wdg_66_IA_PrewarnNotification
      WdgResetDelay = 0
      WdgResetNMIConfig = WDG_SOFTRESET
      WdgSettingsFast
      WdgSettingsOff
      WdgSettingsSlow: WdgSlowTrgValue=6000000, WdgSlowValuePss=2147483648, WdgSlowValueRun=50000, WdgSlowWindowPss=50, WdgSlowWindowRun=100
package /Resource
  module config Resource
    ResourceGeneral: ResourceSubDerivative=S6J328CL
package /Base
  module config Base
package /Os
  module config Os: implementation-config-variant=VARIANT-PRE-COMPILE
    CommonPublishedInformation: ArMajorVersion=4, ArMinorVersion=1, ArPatchVersion=0, ModuleId=1, Release=, SwMajorVersion=4, SwMinorVersion=3, SwPatchVersion=0, VendorId=1
    OsAppMode_0 (OsAppMode)
    OsCounter_0 (OsCounter): OsCounterMaxAllowedValue=4294967295, OsCounterMinCycle=1, OsCounterTicksPerBase=1, OsCounterType=HARDWARE, OsSecondsPerTick=1.0E-6
    OsOS: OsStackMonitoring=1, OsStatus=STANDARD, OsUseGetServiceId=1, OsUseParameterAccess=1, OsUseResScheduler=1
      OsHooks: OsErrorHook=1, OsPostTaskHook=1, OsPreTaskHook=1, OsShutdownHook=1, OsStartupHook=1
    OsResource_0 (OsResource): OsResourceProperty=INTERNAL
package /Pwm
  module config Pwm: implementation-config-variant=VARIANT-PRE-COMPILE, module-description=Pwm_Impl
    PwmChannelConfigSet_0 (PwmChannelConfigSet)
      7 x PwmChannel, all with PwmAdcTriggerDefault=0.0, PwmIdleState=PWM_LOW, PwmNotification=NULL, PwmPeriodDefault=0.0050, PwmPolarity=PWM_HIGH, PwmStartAtInit=1:
        GAUGEDIAL_PWM_MCU_OUT: PwmChannelClass=PWM_FIXED_PERIOD, PwmChannelId=0, PwmDutycycleDefault=0, PwmTimer=BTimer16bit_13, PwmChannelClkSrcRef=McuClockSettingConfig_RUN/McuClockReferencePoint_LCP1A
        GAUGEPNTR_PWM_MCU_OUT: PwmChannelClass=PWM_FIXED_PERIOD, PwmChannelId=1, PwmDutycycleDefault=0, PwmTimer=BTimer16bit_15, PwmChannelClkSrcRef=McuClockSettingConfig_RUN/McuClockReferencePoint_LCP1A
        ILLUMOUT_PWM_MCU_OUT: PwmChannelClass=PWM_FIXED_PERIOD, PwmChannelId=4, PwmDutycycleDefault=0, PwmTimer=BTimer16bit_19, PwmChannelClkSrcRef=McuClockSettingConfig_RUN_RTC/McuClockReferencePoint_LCP1A
        SPEEDOLED_PWM_MCU_OUT: PwmChannelClass=PWM_FIXED_PERIOD, PwmChannelId=6, PwmDutycycleDefault=16384, PwmTimer=BTimer16bit_18, PwmChannelClkSrcRef=McuClockSettingConfig_RUN/McuClockReferencePoint_LCP1A
        SPKRTICTOC_PWM_MCU_OUT: PwmChannelClass=PWM_VARIABLE_PERIOD, PwmChannelId=5, PwmDutycycleDefault=0, PwmTimer=BTimer16bit_8, PwmChannelClkSrcRef=McuClockSettingConfig_RUN/McuClockReferencePoint_LCP0A
        TFT_BL_PWM_OUT: PwmChannelClass=PWM_FIXED_PERIOD, PwmChannelId=3, PwmDutycycleDefault=0, PwmTimer=BTimer16bit_7, PwmChannelClkSrcRef=McuClockSettingConfig_RUN/McuClockReferencePoint_LCP0A
        TTPWM_PWM_MCU_OUT: PwmChannelClass=PWM_FIXED_PERIOD, PwmChannelId=2, PwmDutycycleDefault=0, PwmTimer=BTimer16bit_20, PwmChannelClkSrcRef=McuClockSettingConfig_RUN/McuClockReferencePoint_LCP1A
    PwmConfigurationOfOptApiServices: PwmDeInitApi=1, PwmGetOutputState=1, PwmSetDutyCycle=1, PwmSetOutputToIdle=1, PwmSetPeriodAndDuty=1, PwmVersionInfoApi=1
    PwmGeneral:
      PwmDevErorDetect = 1
      PwmDutycycleUpdatedEndperiod = 1
      PwmErrorCalloutFunction = ErrorCalloutHandler
      PwmIncludeFile = ErrorCalloutHandler.h
      PwmIndex = 0
      PwmNotificationSupported = 1
      PwmPeriodUpdatedEndperiod = 1
package /Fls
  module config Fls: module-description=Fls_Impl
package /Dem
  module config Dem: implementation-config-variant=VARIANT-POST-BUILD
    CommonPublishedInformation: ArMajorVersion=0, ArMinorVersion=0, ArPatchVersion=0, ModuleId=54, Release=, SwMajorVersion=4, SwMinorVersion=3, SwPatchVersion=0, VendorId=1
    DemConfigSet_0 (DemConfigSet)
      DemDTCClass: DemDTCFunctionalUnit=0, DemImmediateNvStorage=1
        DemCallbackInitMForF_0 (DemCallbackInitMForF)
      MCU_E_CLOCK_FAILURE (DemEventParameter): DemEventId=14, DemEventKind=DEM_EVENT_KIND_BSW, DemMaxNumberFreezeFrameRecords=0, DemFreezeFrameRecNumClassRef=(unset)
        DemEventClass:
          DemAgingAllowed = 0
          DemAgingCycleCounterThreshold = 1
          DemConsiderPtoStatus = 0
          DemEventDestination = DEM_DTC_ORIGIN_PRIMARY_MEMORY
          DemEventOBDReadinessGroup = DEM_OBD_RDY_AC
          DemEventPriority = 1
          DemFFPrestorageSupported = 1
          DemOperationCycleRef = DemOperationCycle_0
          DemDebounceAlgorithmClass
            DemDebounceAlgorithmClass (DemDebounceCounterBased):
              DemDebounceCounterDecrementStepSize = 1
              DemDebounceCounterFailedThreshold = 127
              DemDebounceCounterIncrementStepSize = 1
              DemDebounceCounterJumpDown = 1
              DemDebounceCounterJumpDownValue = 0
              DemDebounceCounterJumpUp = 1
              DemDebounceCounterJumpUpValue = 0
              DemDebounceCounterPassedThreshold = -128
    DemGeneral:
      DemAgingCycleCounterProcessing = DEM_PROCESS_AGINGCTR_EXTERN
      DemBswErrorBufferSize = 0
      DemClearDTCBehavior = DEM_CLRRESP_NONVOLATILE_FINISH
      DemDTCSuppressionSupport = 1
      DemDebounceCounterBasedSupport = 1
      DemDebounceTimeBasedSupport = 1
      DemDevErrorDetect = 1
      DemDtcStatusAvailabilityMask = 0
      DemEnableConditionSupport = 1
      DemEventCombinationSupport = DEM_EVCOMB_DISABLED
      DemEventDisplacementSupport = 1
      DemMaxNumberEventEntryMirror = 0
      DemMaxNumberEventEntryPermanent = 0
      DemMaxNumberEventEntryPrimary = 1
      DemMaxNumberEventEntrySecondary = 0
      DemMaxNumberPrestoredFF = 0
      DemOBDSupport = 1
      DemOccurrenceCounterProcessing = DEM_PROCESS_OCCCTR_CDTC
      DemOperationCycleProcessing = DEM_PROCESS_OPCYC_STATE
      DemOperationCycleStatusStorage = 1
      DemPTOSupport = 1
      DemStatusBitHandlingTestFailedSinceLastClear = DEM_STATUS_BIT_NORMAL
      DemStatusBitStorageTestFailed = 1
      DemStorageConditionSupport = 1
      DemTaskTime = 0.0
      DemTriggerDcmReports = 1
      DemTriggerDltReports = 1
      DemTriggerFiMReports = 1
      DemTriggerMonitorInitBeforeClearOk = 1
      DemTypeOfDTCSupported = DEM_DTC_TRANSLATION_ISO11992_4
      DemTypeOfFreezeFrameRecordNumeration = DEM_FF_RECNUM_CALCULATED
      DemVersionInfoApi = 1
      DemOperationCycle_0 (DemOperationCycle): DemOperationCycleType=DEM_OPCYC_IGNITION
package /Mcu
  module config Mcu: implementation-config-variant=VARIANT-PRE-COMPILE, module-description=Mcu_Impl
    McuGeneralConfiguration:
      McuClearResetReasonRegister = 1
      McuClockGearApi = 1
      McuDevErrorDetect = 1
      McuEnableClockShutdown = 1
      McuEnableClockSwitchPss = 1
      McuEnableDefaultClock = 0
      McuEnableOutputHoldControl = 1
      McuEnableRecoverRegister = 1
      McuErrorCalloutFunction = ErrorCalloutHandler
      McuGetRamStateApi = 0
      McuIncludeFile = ErrorCalloutHandler.h
      McuInitClock = 1
      McuInitIoResetControl = 0
      McuIoResetControlApi = 0
      McuNoPll = 0
      McuPerformResetApi = 1
      McuSafetyFunctionApi = 1
      McuVersionInfoApi = 1
    McuModuleConfiguration_0 (McuModuleConfiguration):
      McuClockSrcFailureNotification = DISABLED
      McuEnableClockGearWait = 0
      McuEnableRunUpdateWait = 0
      McuNumberOfMcuModes = 3
      McuRamSectors = 1
      McuResetSelect = MCU_SW_TRIGGER_HW_RESET
      McuResetSetting = 1
      3 x McuClockSettingConfig:
        McuClockSettingConfig_PSS: McuClockSettingId=2
          4 x McuClockReferencePoint:
            McuClockReferencePoint_PSS_HPM: McuClock=MCU_RUN_CLK_HPM, McuClockReferencePointFrequency=4000000.0
            McuClockReferencePoint_PSS_LCP0A: McuClock=MCU_RUN_CLK_LCP0A, McuClockReferencePointFrequency=4000000.0
            McuClockReferencePoint_PSS_MAIN: McuClock=MCU_CLK_MAIN, McuClockReferencePointFrequency=8000000.0
            McuClockReferencePoint_PSS_PLL0: McuClock=MCU_RUN_CLK_PLL0, McuClockReferencePointFrequency=0.0
          McuClockSettings
            8 x McuClockGearSettings, all with McuClockGearEnable=0, McuClockGearLoop=256, McuClockGearStartStep=0, McuClockGearStep=1:
              McuClockGearSettings_PLL{0..3}: McuClockGearClock=MCU_SOURCE_CLOCK_PLL{0..3}
              McuClockGearSettings_SSCG{0..3}: McuClockGearClock=MCU_SOURCE_CLOCK_SSCG{0..3}
            McuClockOutputFunctionSettings:
              McuClockOutputClockDivision = MCU_CLK_DIV_128
              McuClockOutputClockSelection = MCU_SOURCE_CLOCK_FAST_CR
              McuClockOutputFunctionEnable = 0
              McuClockOutputPssProfileFrequency = 0.0
              McuClockOutputRunProfileFrequency = 0.0
            11 x McuClockSupervisorSettings:
              McuClockSupervisorSettings_FAST_CR: McuCsvMonitorClock=MCU_SOURCE_CLOCK_FAST_CR, McuCsvReferenceClockDivision=MCU_CLK_DIV_16
              McuClockSupervisorSettings_MAIN: McuCsvLowerThresholdValue=106, McuCsvMonitorClock=MCU_SOURCE_CLOCK_MAIN, McuCsvReferenceClockSelect=MCU_SOURCE_CLOCK_SLOW_CR, McuCsvReferenceClockWindow=2, McuCsvResetModeSelect=0, McuCsvUpperThresholdValue=320
              McuClockSupervisorSettings_PLL0: McuCsvLowerThresholdValue=988, McuCsvMonitorClock=MCU_SOURCE_CLOCK_PLL0, McuCsvReferenceClockWindow=33, McuCsvResetModeSelect=0, McuCsvUpperThresholdValue=992
              McuClockSupervisorSettings_PLL1: McuCsvLowerThresholdValue=988, McuCsvMonitorClock=MCU_SOURCE_CLOCK_PLL1, McuCsvReferenceClockWindow=22, McuCsvResetModeSelect=0, McuCsvUpperThresholdValue=992
              McuClockSupervisorSettings_PLL2: McuCsvLowerThresholdValue=997, McuCsvMonitorClock=MCU_SOURCE_CLOCK_PLL2, McuCsvReferenceClockWindow=65, McuCsvResetModeSelect=0, McuCsvUpperThresholdValue=1002
              McuClockSupervisorSettings_PLL3: McuCsvLowerThresholdValue=988, McuCsvMonitorClock=MCU_SOURCE_CLOCK_PLL3, McuCsvReferenceClockWindow=33, McuCsvResetModeSelect=0, McuCsvUpperThresholdValue=992
              McuClockSupervisorSettings_SLOW_CR: McuCsvMonitorClock=MCU_SOURCE_CLOCK_SLOW_CR, McuCsvReferenceClockDivision=MCU_CLK_DIV_16
              McuClockSupervisorSettings_SSCG0: McuCsvLowerThresholdValue=879, McuCsvMonitorClock=MCU_SOURCE_CLOCK_SSCG0, McuCsvReferenceClockWindow=32, McuCsvResetModeSelect=0, McuCsvUpperThresholdValue=977
              McuClockSupervisorSettings_SSCG1: McuCsvLowerThresholdValue=900, McuCsvMonitorClock=MCU_SOURCE_CLOCK_SSCG1, McuCsvReferenceClockWindow=38, McuCsvResetModeSelect=0, McuCsvUpperThresholdValue=1000
              McuClockSupervisorSettings_SSCG2: McuCsvLowerThresholdValue=829, McuCsvMonitorClock=MCU_SOURCE_CLOCK_SSCG2, McuCsvReferenceClockWindow=35, McuCsvResetModeSelect=0, McuCsvUpperThresholdValue=921
              McuClockSupervisorSettings_SSCG3: McuCsvLowerThresholdValue=900, McuCsvMonitorClock=MCU_SOURCE_CLOCK_SSCG3, McuCsvReferenceClockWindow=19, McuCsvResetModeSelect=0, McuCsvUpperThresholdValue=1000
            McuFastCrClockSettings:
              McuFastCrClockStabTime = 4.8E-4
              McuFastCrClockStabTimeCompareValue = 30
              McuFastCrClockStabTimePrescaleValue = MCU_CLK_DIV_64
              McuFastCrCoarseTrimmingValue = 15
              McuFastCrFineTrimmingValue = 18
            McuMainClockSettings:
              McuMainClockAmpMode = MCU_MCLK_AMP_MODE_NORMAL
              McuMainClockDivisionValue = MCU_MCLK_DIV_1
              McuMainClockGainValue = MCU_MCLK_GAIN_8MHz
              McuMainClockStabTime = 0.008192
              McuMainClockStabTimeCompareValue = 512
              McuMainClockStabTimePrescaleValue = MCU_CLK_DIV_64
            McuPllSettings: McuPllStabilizationTime=MCU_STABTIME_2_EXP_11
            McuSlowCrClockSettings: McuSlowCrClockStabTime=6.4E-4, McuSlowCrClockStabTimeCompareValue=1, McuSlowCrClockStabTimePrescaleValue=MCU_CLK_DIV_64
            McuSscgPllSettings: McuSscgPllStabilizationTime=MCU_STABTIME_2_EXP_11
            McuSubClockSettings: McuSubClockInputEnable=0, McuSubClockStabTime=32000.0, McuSubClockStabTimeCompareValue=4, McuSubClockStabTimePrescaleValue=MCU_CLK_DIV_64
          McuClocksIn: McuFastCrOscillator=4000000.0, McuMainOscillator=8000000.0, McuSlowCrOscillator=100000.0, McuSubOscillator=32768.0
          McuProfileSettings_PSS_PSS (McuProfileSettings): McuProfile=MCU_PROFILE_PSS
            McuClockProfileSettings
              McuClockDomain0Settings: McuClockDomain0ClockSelect=MCU_SOURCE_CLOCK_SLOW_CR, McuSysClockDivision=1
                McuAtbClockGroupSettings: McuAtbClockDivision=MCU_CLK_DIV_1, McuAtbClockEnable=0, McuAtbClockFrequency=0.0
                  McuDbgClockSettings: McuDbgClockDivision=MCU_CLK_DIV_1, McuDbgClockEnable=0, McuDbgClockFrequency=0.0
                McuCpu0ClockSettings: McuCpu0ClockEnable=0, McuCpu0ClockFrequency=0.0
                McuHpmClockGroupSettings: McuHpmClockDivision=1, McuHpmClockEnable=0, McuHpmClockFrequency=0.0
                  McuDmaClockSettings: McuDmaClockEnable=0, McuDmaClockFrequency=0.0
                  McuExtBusClockSettings: McuExtBusClockDivision=MCU_CLK_DIV_128, McuExtBusClockEnable=0, McuExtBusClockFrequency=0.0
                  McuHapp0A0ClockGroupSettings: McuHapp0A0ClockDivision=1, McuHapp0A0ClockEnable=0, McuHapp0A0ClockFrequency=0.0
                    McuHapp0A1ClockSettings: McuHapp0A1ClockDivision=1, McuHapp0A1ClockEnable=0, McuHapp0A1ClockFrequency=0.0
                  McuHapp1B0ClockGroupSettings: McuHapp1B0ClockDivision=1, McuHapp1B0ClockEnable=0, McuHapp1B0ClockFrequency=0.0
                    McuHapp1B1ClockSettings: McuHapp1B1ClockDivision=1, McuHapp1B1ClockEnable=0, McuHapp1B1ClockFrequency=0.0
                  McuHpm2ClockSettings: McuHpm2ClockEnable=0, McuHpm2ClockFrequency=0.0
                  McuMemcClockSettings: McuMemcClockEnable=0, McuMemcClockFrequency=0.0
                  McuSysc1ClockSettings: McuSysc1ClockDivision=1, McuSysc1ClockEnable=0, McuSysc1ClockFrequency=0.0
                McuLapp0AClockSettings: McuLapp0AClockDivision=1, McuLapp0AClockEnable=0, McuLapp0AClockFrequency=0.0, McuLapp0AClockSelect=MCU_SOURCE_CLOCK_CD0
                McuLapp0ClockSettings: McuLapp0ClockDivision=1, McuLapp0ClockEnable=0, McuLapp0ClockFrequency=0.0
                McuLapp1AClockSettings: McuLapp1AClockDivision=1, McuLapp1AClockEnable=0, McuLapp1AClockFrequency=0.0, McuLapp1AClockSelect=MCU_SOURCE_CLOCK_CD0
                McuLapp1ClockSettings: McuLapp1ClockDivision=1, McuLapp1ClockEnable=0, McuLapp1ClockFrequency=0.0
                McuLcp0AClockSettings: McuLcp0AClockDivision=1, McuLcp0AClockEnable=0, McuLcp0AClockFrequency=0.0, McuLcp0AClockSelect=MCU_SOURCE_CLOCK_CD0
                McuLcp0ClockSettings: McuLcp0ClockDivision=1, McuLcp0ClockEnable=0, McuLcp0ClockFrequency=0.0
                McuLcp1AClockSettings: McuLcp1AClockDivision=1, McuLcp1AClockEnable=0, McuLcp1AClockFrequency=0.0, McuLcp1AClockSelect=MCU_SOURCE_CLOCK_CD0
                McuLcp1ClockSettings: McuLcp1ClockDivision=1, McuLcp1ClockEnable=0, McuLcp1ClockFrequency=0.0
                McuLcpClockSettings: McuLcpClockDivision=MCU_CLK_DIV_1, McuLcpClockEnable=0, McuLcpClockFrequency=0.0
                McuLlpbmClockSettings: McuLlpbm2ClockEnable=0, McuLlpbm2ClockFrequency=0.0, McuLlpbmClockEnable=0, McuLlpbmClockFrequency=0.0
              McuClockDomainHsspiSettings: McuHsspiClockDivision=32, McuHsspiClockEnable=0, McuHsspiClockFrequency=0.0, McuHsspiClockSelect=MCU_SOURCE_CLOCK_SLOW_CR
              McuClockDomainMcucSettings:
                McuMcucClockSelect = MCU_SOURCE_CLOCK_SLOW_CR
                McuMcucHClockDivision = 1
                McuMcucHClockEnable = 0
                McuMcucHClockFrequency = 0.0
                McuMcucPClockDivision = 1
                McuMcucPClockEnable = 0
                McuMcucPClockFrequency = 0.0
              5 x McuClockDomainSettings, all with McuClockDomainClockDivision=32, McuClockDomainClockEnable=0, McuClockDomainClockFrequency=0.0, McuClockDomainClockSelect=MCU_SOURCE_CLOCK_SLOW_CR:
                McuClockDomainSettings_PSS_CD1: McuClockDomain=MCU_CD_1
                  McuClockDomainA0ClockSettings: McuClockDomainA0ClockDivision=16, McuClockDomainA0ClockEnable=0, McuClockDomainA0ClockFrequency=0.0
                  McuClockDomainA1ClockSettings: McuClockDomainA1ClockDivision=16, McuClockDomainA1ClockEnable=0, McuClockDomainA1ClockFrequency=0.0
                  McuClockDomainB0ClockSettings: McuClockDomainB0ClockDivision=16, McuClockDomainB0ClockEnable=0, McuClockDomainB0ClockFrequency=0.0
                  McuClockDomainB1ClockSettings: McuClockDomainB1ClockDivision=16, McuClockDomainB1ClockEnable=0, McuClockDomainB1ClockFrequency=0.0
                McuClockDomainSettings_PSS_CD2: McuClockDomain=MCU_CD_2
                  McuClockDomainA0ClockSettings: McuClockDomainA0ClockDivision=16, McuClockDomainA0ClockEnable=0, McuClockDomainA0ClockFrequency=0.0
                  McuClockDomainA1ClockSettings: McuClockDomainA1ClockDivision=16, McuClockDomainA1ClockEnable=0, McuClockDomainA1ClockFrequency=0.0
                  McuClockDomainB0ClockSettings: McuClockDomainB0ClockDivision=16, McuClockDomainB0ClockEnable=0, McuClockDomainB0ClockFrequency=0.0
                  McuClockDomainB1ClockSettings: McuClockDomainB1ClockDivision=16, McuClockDomainB1ClockEnable=0, McuClockDomainB1ClockFrequency=0.0
                McuClockDomainSettings_PSS_CD3: McuClockDomain=MCU_CD_3
                  McuClockDomainA0ClockSettings: McuClockDomainA0ClockDivision=16, McuClockDomainA0ClockEnable=0, McuClockDomainA0ClockFrequency=0.0
                  McuClockDomainA1ClockSettings: McuClockDomainA1ClockDivision=16, McuClockDomainA1ClockEnable=0, McuClockDomainA1ClockFrequency=0.0
                  McuClockDomainB0ClockSettings: McuClockDomainB0ClockDivision=16, McuClockDomainB0ClockEnable=0, McuClockDomainB0ClockFrequency=0.0
                  McuClockDomainB1ClockSettings: McuClockDomainB1ClockDivision=16, McuClockDomainB1ClockEnable=0, McuClockDomainB1ClockFrequency=0.0
                McuClockDomainSettings_PSS_CD4: McuClockDomain=MCU_CD_4
                  McuClockDomainA0ClockSettings: McuClockDomainA0ClockDivision=16, McuClockDomainA0ClockEnable=0, McuClockDomainA0ClockFrequency=0.0
                  McuClockDomainA1ClockSettings: McuClockDomainA1ClockDivision=16, McuClockDomainA1ClockEnable=0, McuClockDomainA1ClockFrequency=0.0
                  McuClockDomainB0ClockSettings: McuClockDomainB0ClockDivision=16, McuClockDomainB0ClockEnable=0, McuClockDomainB0ClockFrequency=0.0
                  McuClockDomainB1ClockSettings: McuClockDomainB1ClockDivision=16, McuClockDomainB1ClockEnable=0, McuClockDomainB1ClockFrequency=0.0
                McuClockDomainSettings_PSS_CD5: McuClockDomain=MCU_CD_5
                  McuClockDomainA0ClockSettings: McuClockDomainA0ClockDivision=16, McuClockDomainA0ClockEnable=0, McuClockDomainA0ClockFrequency=0.0
                  McuClockDomainA1ClockSettings: McuClockDomainA1ClockDivision=16, McuClockDomainA1ClockEnable=0, McuClockDomainA1ClockFrequency=0.0
                  McuClockDomainB0ClockSettings: McuClockDomainB0ClockDivision=16, McuClockDomainB0ClockEnable=0, McuClockDomainB0ClockFrequency=0.0
                  McuClockDomainB1ClockSettings: McuClockDomainB1ClockDivision=16, McuClockDomainB1ClockEnable=0, McuClockDomainB1ClockFrequency=0.0
              McuClockDomainTrcSettings: McuTrcClockDivision=1, McuTrcClockEnable=0, McuTrcClockFrequency=0.0, McuTrcClockSelect=MCU_SOURCE_CLOCK_SLOW_CR
              McuFlashClockSettings: McuFlashAccessWaitCycle=1, McuFlashClockFrequency=50000.0, McuWorkFlashAccessWaitCycle=9, McuWorkFlashClockFrequency=5000.0
              4 x McuPllClockSettings, all with McuPllClockFrequency=0.0, McuPllClockSelect=MCU_SOURCE_CLOCK_MAIN, McuPllClockSupervisorEnable=0, McuPllEnable=0, McuPllInputDivisionLValue=MCU_CLK_DIV_2, McuPllOutputFrequency=0.0:
                McuPllClockSettings_PSS_PLL0: McuPllDivisionMValue=MCU_CLK_DIV_2, McuPllMultiplicationNValue=120, McuPllType=MCU_SOURCE_CLOCK_PLL0
                McuPllClockSettings_PSS_PLL1: McuPllDivisionMValue=MCU_CLK_DIV_2, McuPllMultiplicationNValue=180, McuPllType=MCU_SOURCE_CLOCK_PLL1
                McuPllClockSettings_PSS_PLL2: McuPllDivisionMValue=MCU_CLK_DIV_4, McuPllMultiplicationNValue=123, McuPllType=MCU_SOURCE_CLOCK_PLL2
                McuPllClockSettings_PSS_PLL3: McuPllDivisionMValue=MCU_CLK_DIV_2, McuPllMultiplicationNValue=120, McuPllType=MCU_SOURCE_CLOCK_PLL3
              McuSourceClockSettings:
                McuFastCrClockSupervisorEnable = 0
                McuFastCrOscillatorEnable = 0
                McuMainClockSupervisorEnable = 0
                McuMainOscillatorEnable = 0
                McuSlowCrClockSupervisorEnable = 0
                McuSlowCrOscillatorEnable = 1
                McuSubClockSupervisorEnable = 0
                McuSubOscillatorEnable = 0
              4 x McuSscgPllClockSettings, all with McuSscgPllClockFrequency=0.0, McuSscgPllClockSelect=MCU_SOURCE_CLOCK_MAIN, McuSscgPllClockSupervisorEnable=0, McuSscgPllDivisionMValue=MCU_CLK_DIV_2, McuSscgPllEnable=0, McuSscgPllInputDivisionLValue=MCU_CLK_DIV_2, McuSscgPllModulationEnable=0, McuSscgPllModulationFrequency=MCU_FIN_BY_1024, McuSscgPllModulationRate=MCU_RATE_0_5, McuSscgPllModulatorMode=MCU_MODE_DOWN_SPREAD, McuSscgPllOutputFrequency=0.0:
                McuSscgPllClockSettings_PSS_SSCG0: McuSscgPllMultiplicationNValue=116, McuSscgPllType=MCU_SOURCE_CLOCK_SSCG0
                McuSscgPllClockSettings_PSS_SSCG1: McuSscgPllMultiplicationNValue=100, McuSscgPllType=MCU_SOURCE_CLOCK_SSCG1
                McuSscgPllClockSettings_PSS_SSCG2: McuSscgPllMultiplicationNValue=100, McuSscgPllType=MCU_SOURCE_CLOCK_SSCG2
                McuSscgPllClockSettings_PSS_SSCG3: McuSscgPllMultiplicationNValue=200, McuSscgPllType=MCU_SOURCE_CLOCK_SSCG3
            McuModeProfileSettings
              McuPowerDomainSettings:
                McuPowerDomain2Enable = 0
                McuPowerDomain3Enable = 0
                McuPowerDomain4_0Enable = 1
                McuPowerDomain4_1Enable = 1
                McuPowerDomain5_{0..3}Enable = 0
                McuPowerDomain6_0Enable = 0
                McuPowerDomain6_1Enable = 0
              McuRegulatorSettings: McuRegulatorMode=MCU_REG_MODE_STANDBY, McuRegulatorVoltage=MCU_REG_VOLTAGE_1_20V
          McuProfileSettings_PSS_RUN (McuProfileSettings): McuProfile=MCU_PROFILE_RUN
            McuClockProfileSettings
              McuClockDomain0Settings: McuClockDomain0ClockSelect=MCU_SOURCE_CLOCK_FAST_CR, McuSysClockDivision=1
                McuAtbClockGroupSettings: McuAtbClockDivision=MCU_CLK_DIV_1, McuAtbClockEnable=1, McuAtbClockFrequency=4000000.0
                  McuDbgClockSettings: McuDbgClockDivision=MCU_CLK_DIV_1, McuDbgClockEnable=1, McuDbgClockFrequency=4000000.0
                McuCpu0ClockSettings: McuCpu0ClockEnable=1, McuCpu0ClockFrequency=4000000.0
                McuHpmClockGroupSettings: McuHpmClockDivision=1, McuHpmClockEnable=1, McuHpmClockFrequency=4000000.0
                  McuDmaClockSettings: McuDmaClockEnable=1, McuDmaClockFrequency=4000000.0
                  McuExtBusClockSettings: McuExtBusClockDivision=MCU_CLK_DIV_1, McuExtBusClockEnable=1, McuExtBusClockFrequency=4000000.0
                  McuHapp0A0ClockGroupSettings: McuHapp0A0ClockDivision=1, McuHapp0A0ClockEnable=1, McuHapp0A0ClockFrequency=4000000.0
                    McuHapp0A1ClockSettings: McuHapp0A1ClockDivision=1, McuHapp0A1ClockEnable=1, McuHapp0A1ClockFrequency=4000000.0
                  McuHapp1B0ClockGroupSettings: McuHapp1B0ClockDivision=1, McuHapp1B0ClockEnable=1, McuHapp1B0ClockFrequency=4000000.0
                    McuHapp1B1ClockSettings: McuHapp1B1ClockDivision=1, McuHapp1B1ClockEnable=1, McuHapp1B1ClockFrequency=4000000.0
                  McuHpm2ClockSettings: McuHpm2ClockEnable=1, McuHpm2ClockFrequency=2000000.0
                  McuMemcClockSettings: McuMemcClockEnable=1, McuMemcClockFrequency=4000000.0
                  McuSysc1ClockSettings: McuSysc1ClockDivision=1, McuSysc1ClockEnable=1, McuSysc1ClockFrequency=4000000.0
                McuLapp0AClockSettings: McuLapp0AClockDivision=1, McuLapp0AClockEnable=1, McuLapp0AClockFrequency=4000000.0, McuLapp0AClockSelect=MCU_SOURCE_CLOCK_CD0
                McuLapp0ClockSettings: McuLapp0ClockDivision=1, McuLapp0ClockEnable=1, McuLapp0ClockFrequency=4000000.0
                McuLapp1AClockSettings: McuLapp1AClockDivision=1, McuLapp1AClockEnable=1, McuLapp1AClockFrequency=4000000.0, McuLapp1AClockSelect=MCU_SOURCE_CLOCK_CD0
                McuLapp1ClockSettings: McuLapp1ClockDivision=1, McuLapp1ClockEnable=1, McuLapp1ClockFrequency=4000000.0
                McuLcp0AClockSettings: McuLcp0AClockDivision=1, McuLcp0AClockEnable=1, McuLcp0AClockFrequency=4000000.0, McuLcp0AClockSelect=MCU_SOURCE_CLOCK_CD0
                McuLcp0ClockSettings: McuLcp0ClockDivision=1, McuLcp0ClockEnable=1, McuLcp0ClockFrequency=4000000.0
                McuLcp1AClockSettings: McuLcp1AClockDivision=1, McuLcp1AClockEnable=1, McuLcp1AClockFrequency=4000000.0, McuLcp1AClockSelect=MCU_SOURCE_CLOCK_CD0
                McuLcp1ClockSettings: McuLcp1ClockDivision=1, McuLcp1ClockEnable=1, McuLcp1ClockFrequency=4000000.0
                McuLcpClockSettings: McuLcpClockDivision=MCU_CLK_DIV_1, McuLcpClockEnable=1, McuLcpClockFrequency=4000000.0
                McuLlpbmClockSettings: McuLlpbm2ClockEnable=1, McuLlpbm2ClockFrequency=2000000.0, McuLlpbmClockEnable=1, McuLlpbmClockFrequency=4000000.0
              McuClockDomainHsspiSettings: McuHsspiClockDivision=1, McuHsspiClockEnable=1, McuHsspiClockFrequency=4000000.0, McuHsspiClockSelect=MCU_SOURCE_CLOCK_FAST_CR
              McuClockDomainMcucSettings:
                McuMcucClockSelect = MCU_SOURCE_CLOCK_FAST_CR
                McuMcucHClockDivision = 1
                McuMcucHClockEnable = 1
                McuMcucHClockFrequency = 4000000.0
                McuMcucPClockDivision = 1
                McuMcucPClockEnable = 1
                McuMcucPClockFrequency = 4000000.0
              5 x McuClockDomainSettings, all with McuClockDomainClockDivision=1, McuClockDomainClockEnable=1:
                McuClockDomainSettings_CD1: McuClockDomain=MCU_CD_1, McuClockDomainClockFrequency=4000000.0, McuClockDomainClockSelect=MCU_SOURCE_CLOCK_FAST_CR
                  McuClockDomainA0ClockSettings: McuClockDomainA0ClockDivision=1, McuClockDomainA0ClockEnable=1, McuClockDomainA0ClockFrequency=4000000.0
                  McuClockDomainA1ClockSettings: McuClockDomainA1ClockDivision=1, McuClockDomainA1ClockEnable=1, McuClockDomainA1ClockFrequency=4000000.0
                  McuClockDomainB0ClockSettings: McuClockDomainB0ClockDivision=1, McuClockDomainB0ClockEnable=1, McuClockDomainB0ClockFrequency=4000000.0
                  McuClockDomainB1ClockSettings: McuClockDomainB1ClockDivision=1, McuClockDomainB1ClockEnable=1, McuClockDomainB1ClockFrequency=4000000.0
                McuClockDomainSettings_CD2: McuClockDomain=MCU_CD_2, McuClockDomainClockFrequency=4000000.0, McuClockDomainClockSelect=MCU_SOURCE_CLOCK_FAST_CR
                  McuClockDomainA0ClockSettings: McuClockDomainA0ClockDivision=1, McuClockDomainA0ClockEnable=1, McuClockDomainA0ClockFrequency=4000000.0
                  McuClockDomainA1ClockSettings: McuClockDomainA1ClockDivision=1, McuClockDomainA1ClockEnable=1, McuClockDomainA1ClockFrequency=4000000.0
                  McuClockDomainB0ClockSettings: McuClockDomainB0ClockDivision=1, McuClockDomainB0ClockEnable=1, McuClockDomainB0ClockFrequency=4000000.0
                  McuClockDomainB1ClockSettings: McuClockDomainB1ClockDivision=1, McuClockDomainB1ClockEnable=1, McuClockDomainB1ClockFrequency=4000000.0
                McuClockDomainSettings_CD3: McuClockDomain=MCU_CD_3, McuClockDomainClockFrequency=4000000.0, McuClockDomainClockSelect=MCU_SOURCE_CLOCK_FAST_CR
                  McuClockDomainA0ClockSettings: McuClockDomainA0ClockDivision=1, McuClockDomainA0ClockEnable=1, McuClockDomainA0ClockFrequency=4000000.0
                  McuClockDomainA1ClockSettings: McuClockDomainA1ClockDivision=1, McuClockDomainA1ClockEnable=1, McuClockDomainA1ClockFrequency=4000000.0
                  McuClockDomainB0ClockSettings: McuClockDomainB0ClockDivision=1, McuClockDomainB0ClockEnable=1, McuClockDomainB0ClockFrequency=4000000.0
                  McuClockDomainB1ClockSettings: McuClockDomainB1ClockDivision=1, McuClockDomainB1ClockEnable=1, McuClockDomainB1ClockFrequency=4000000.0
                McuClockDomainSettings_CD4: McuClockDomain=MCU_CD_4, McuClockDomainClockFrequency=4000000.0, McuClockDomainClockSelect=MCU_SOURCE_CLOCK_FAST_CR
                  McuClockDomainA0ClockSettings: McuClockDomainA0ClockDivision=1, McuClockDomainA0ClockEnable=1, McuClockDomainA0ClockFrequency=4000000.0
                  McuClockDomainA1ClockSettings: McuClockDomainA1ClockDivision=1, McuClockDomainA1ClockEnable=1, McuClockDomainA1ClockFrequency=4000000.0
                  McuClockDomainB0ClockSettings: McuClockDomainB0ClockDivision=1, McuClockDomainB0ClockEnable=1, McuClockDomainB0ClockFrequency=4000000.0
                  McuClockDomainB1ClockSettings: McuClockDomainB1ClockDivision=1, McuClockDomainB1ClockEnable=1, McuClockDomainB1ClockFrequency=4000000.0
                McuClockDomainSettings_CD5: McuClockDomain=MCU_CD_5, McuClockDomainClockFrequency=0.0, McuClockDomainClockSelect=MCU_SOURCE_CLOCK_LOW
                  McuClockDomainA0ClockSettings: McuClockDomainA0ClockDivision=1, McuClockDomainA0ClockEnable=1, McuClockDomainA0ClockFrequency=0.0
                  McuClockDomainA1ClockSettings: McuClockDomainA1ClockDivision=1, McuClockDomainA1ClockEnable=1, McuClockDomainA1ClockFrequency=0.0
                  McuClockDomainB0ClockSettings: McuClockDomainB0ClockDivision=1, McuClockDomainB0ClockEnable=1, McuClockDomainB0ClockFrequency=0.0
                  McuClockDomainB1ClockSettings: McuClockDomainB1ClockDivision=1, McuClockDomainB1ClockEnable=1, McuClockDomainB1ClockFrequency=0.0
              McuClockDomainTrcSettings: McuTrcClockDivision=1, McuTrcClockEnable=1, McuTrcClockFrequency=4000000.0, McuTrcClockSelect=MCU_SOURCE_CLOCK_FAST_CR
              McuFlashClockSettings: McuFlashAccessWaitCycle=1, McuFlashClockFrequency=2000000.0, McuWorkFlashAccessWaitCycle=9, McuWorkFlashClockFrequency=200000.0
              4 x McuPllClockSettings, all with McuPllClockFrequency=0.0, McuPllClockSelect=MCU_SOURCE_CLOCK_MAIN, McuPllClockSupervisorEnable=0, McuPllEnable=0, McuPllInputDivisionLValue=MCU_CLK_DIV_2, McuPllOutputFrequency=0.0:
                McuPllClockSettings_PLL0: McuPllDivisionMValue=MCU_CLK_DIV_2, McuPllMultiplicationNValue=120, McuPllType=MCU_SOURCE_CLOCK_PLL0
                McuPllClockSettings_PLL1: McuPllDivisionMValue=MCU_CLK_DIV_2, McuPllMultiplicationNValue=180, McuPllType=MCU_SOURCE_CLOCK_PLL1
                McuPllClockSettings_PLL2: McuPllDivisionMValue=MCU_CLK_DIV_4, McuPllMultiplicationNValue=123, McuPllType=MCU_SOURCE_CLOCK_PLL2
                McuPllClockSettings_PLL3: McuPllDivisionMValue=MCU_CLK_DIV_2, McuPllMultiplicationNValue=120, McuPllType=MCU_SOURCE_CLOCK_PLL3
              McuSourceClockSettings:
                McuFastCrClockSupervisorEnable = 1
                McuFastCrOscillatorEnable = 1
                McuMainClockSupervisorEnable = 1
                McuMainOscillatorEnable = 1
                McuSlowCrClockSupervisorEnable = 0
                McuSlowCrOscillatorEnable = 1
                McuSubClockSupervisorEnable = 0
                McuSubOscillatorEnable = 0
              4 x McuSscgPllClockSettings, all with McuSscgPllClockFrequency=0.0, McuSscgPllClockSelect=MCU_SOURCE_CLOCK_MAIN, McuSscgPllClockSupervisorEnable=0, McuSscgPllDivisionMValue=MCU_CLK_DIV_2, McuSscgPllEnable=0, McuSscgPllInputDivisionLValue=MCU_CLK_DIV_2, McuSscgPllModulationEnable=0, McuSscgPllModulationFrequency=MCU_FIN_BY_1024, McuSscgPllModulationRate=MCU_RATE_0_5, McuSscgPllModulatorMode=MCU_MODE_DOWN_SPREAD, McuSscgPllOutputFrequency=0.0:
                McuSscgPllClockSettings_SSCG0: McuSscgPllMultiplicationNValue=116, McuSscgPllType=MCU_SOURCE_CLOCK_SSCG0
                McuSscgPllClockSettings_SSCG1: McuSscgPllMultiplicationNValue=100, McuSscgPllType=MCU_SOURCE_CLOCK_SSCG1
                McuSscgPllClockSettings_SSCG2: McuSscgPllMultiplicationNValue=100, McuSscgPllType=MCU_SOURCE_CLOCK_SSCG2
                McuSscgPllClockSettings_SSCG3: McuSscgPllMultiplicationNValue=200, McuSscgPllType=MCU_SOURCE_CLOCK_SSCG3
            McuModeProfileSettings
              McuLowVoltageDetectionSettings_0 (McuLowVoltageDetectionSettings):
                McuLowVoltageDetectionEnable = 0
                McuLowVoltageDetectionResetEnable = 0
                McuLowVoltageDetectionResource = MCU_LVD_INTERNAL
                McuLowVoltageDetectionVoltage = MCU_LVD_VOLTAGE_0_97V
              McuLowVoltageDetectionSettings_1 (McuLowVoltageDetectionSettings):
                McuLowVoltageDetectionEnable = 0
                McuLowVoltageDetectionResetEnable = 0
                McuLowVoltageDetectionResource = MCU_LVD_EXTERNAL
                McuLowVoltageDetectionVoltage = MCU_LVD_VOLTAGE_4_2V
              McuPowerDomainSettings:
                McuPowerDomain2Enable = 1
                McuPowerDomain3Enable = 1
                McuPowerDomain4_0Enable = 1
                McuPowerDomain4_1Enable = 1
                McuPowerDomain5_{0..3}Enable = 1
                McuPowerDomain6_0Enable = 1
                McuPowerDomain6_1Enable = 1
              McuRegulatorSettings: McuRegulatorMode=MCU_REG_MODE_MAIN, McuRegulatorVoltage=MCU_REG_VOLTAGE_1_20V
        McuClockSettingConfig_RUN: McuClockSettingId=1
          8 x McuClockReferencePoint:
            McuClockReferencePoint_COMH: McuClock=MCU_RUN_CLK_COMH, McuClockReferencePointFrequency=5.8E7
            McuClockReferencePoint_HPM: McuClock=MCU_RUN_CLK_HPM, McuClockReferencePointFrequency=1.2E8
            McuClockReferencePoint_LCP: McuClock=MCU_RUN_CLK_LCP, McuClockReferencePointFrequency=6.0E7
            McuClockReferencePoint_LCP0A: McuClock=MCU_RUN_CLK_LCP0A, McuClockReferencePointFrequency=6.0E7
            McuClockReferencePoint_LCP1A: McuClock=MCU_RUN_CLK_LCP1A, McuClockReferencePointFrequency=6.0E7
            McuClockReferencePoint_LLPBM2: McuClock=MCU_RUN_CLK_LLPBM2, McuClockReferencePointFrequency=1.2E8
            McuClockReferencePoint_MAIN: McuClock=MCU_CLK_MAIN, McuClockReferencePointFrequency=8000000.0
            McuClockReferencePoint_PLL0: McuClock=MCU_RUN_CLK_PLL0, McuClockReferencePointFrequency=2.4E8
          McuClockSettings
            8 x McuClockGearSettings, all with McuClockGearEnable=1, McuClockGearLoop=256, McuClockGearStartStep=0, McuClockGearStep=1:
              McuClockGearSettings_RUN_PLL{0..3}: McuClockGearClock=MCU_SOURCE_CLOCK_PLL{0..3}
              McuClockGearSettings_RUN_SSCG{0..3}: McuClockGearClock=MCU_SOURCE_CLOCK_SSCG{0..3}
            McuClockOutputFunctionSettings:
              McuClockOutputClockDivision = MCU_CLK_DIV_128
              McuClockOutputClockSelection = MCU_SOURCE_CLOCK_FAST_CR
              McuClockOutputFunctionEnable = 0
              McuClockOutputPssProfileFrequency = 0.0
              McuClockOutputRunProfileFrequency = 0.0
            11 x McuClockSupervisorSettings:
              McuClockSupervisorSettings_FAST_CR: McuCsvMonitorClock=MCU_SOURCE_CLOCK_FAST_CR, McuCsvReferenceClockDivision=MCU_CLK_DIV_16
              McuClockSupervisorSettings_MAIN: McuCsvLowerThresholdValue=106, McuCsvMonitorClock=MCU_SOURCE_CLOCK_MAIN, McuCsvReferenceClockSelect=MCU_SOURCE_CLOCK_SLOW_CR, McuCsvReferenceClockWindow=2, McuCsvResetModeSelect=0, McuCsvUpperThresholdValue=320
              McuClockSupervisorSettings_PLL0: McuCsvLowerThresholdValue=988, McuCsvMonitorClock=MCU_SOURCE_CLOCK_PLL0, McuCsvReferenceClockWindow=33, McuCsvResetModeSelect=0, McuCsvUpperThresholdValue=992
              McuClockSupervisorSettings_PLL1: McuCsvLowerThresholdValue=988, McuCsvMonitorClock=MCU_SOURCE_CLOCK_PLL1, McuCsvReferenceClockWindow=22, McuCsvResetModeSelect=0, McuCsvUpperThresholdValue=992
              McuClockSupervisorSettings_PLL2: McuCsvLowerThresholdValue=997, McuCsvMonitorClock=MCU_SOURCE_CLOCK_PLL2, McuCsvReferenceClockWindow=65, McuCsvResetModeSelect=0, McuCsvUpperThresholdValue=1002
              McuClockSupervisorSettings_PLL3: McuCsvLowerThresholdValue=988, McuCsvMonitorClock=MCU_SOURCE_CLOCK_PLL3, McuCsvReferenceClockWindow=33, McuCsvResetModeSelect=0, McuCsvUpperThresholdValue=992
              McuClockSupervisorSettings_SLOW_CR: McuCsvMonitorClock=MCU_SOURCE_CLOCK_SLOW_CR, McuCsvReferenceClockDivision=MCU_CLK_DIV_16
              McuClockSupervisorSettings_SSCG0: McuCsvLowerThresholdValue=879, McuCsvMonitorClock=MCU_SOURCE_CLOCK_SSCG0, McuCsvReferenceClockWindow=32, McuCsvResetModeSelect=0, McuCsvUpperThresholdValue=977
              McuClockSupervisorSettings_SSCG1: McuCsvLowerThresholdValue=900, McuCsvMonitorClock=MCU_SOURCE_CLOCK_SSCG1, McuCsvReferenceClockWindow=38, McuCsvResetModeSelect=0, McuCsvUpperThresholdValue=1000
              McuClockSupervisorSettings_SSCG2: McuCsvLowerThresholdValue=829, McuCsvMonitorClock=MCU_SOURCE_CLOCK_SSCG2, McuCsvReferenceClockWindow=35, McuCsvResetModeSelect=0, McuCsvUpperThresholdValue=921
              McuClockSupervisorSettings_SSCG3: McuCsvLowerThresholdValue=900, McuCsvMonitorClock=MCU_SOURCE_CLOCK_SSCG3, McuCsvReferenceClockWindow=19, McuCsvResetModeSelect=0, McuCsvUpperThresholdValue=1000
            McuFastCrClockSettings:
              McuFastCrClockStabTime = 4.8E-4
              McuFastCrClockStabTimeCompareValue = 30
              McuFastCrClockStabTimePrescaleValue = MCU_CLK_DIV_64
              McuFastCrCoarseTrimmingValue = 15
              McuFastCrFineTrimmingValue = 18
            McuMainClockSettings:
              McuMainClockAmpMode = MCU_MCLK_AMP_MODE_NORMAL
              McuMainClockDivisionValue = MCU_MCLK_DIV_2
              McuMainClockGainValue = MCU_MCLK_GAIN_8MHz
              McuMainClockStabTime = 0.008192
              McuMainClockStabTimeCompareValue = 512
              McuMainClockStabTimePrescaleValue = MCU_CLK_DIV_64
            McuPllSettings: McuPllStabilizationTime=MCU_STABTIME_2_EXP_11
            McuSlowCrClockSettings: McuSlowCrClockStabTime=6.4E-4, McuSlowCrClockStabTimeCompareValue=1, McuSlowCrClockStabTimePrescaleValue=MCU_CLK_DIV_64
            McuSscgPllSettings: McuSscgPllStabilizationTime=MCU_STABTIME_2_EXP_11
            McuSubClockSettings: McuSubClockInputEnable=0, McuSubClockStabTime=32000.0, McuSubClockStabTimeCompareValue=4, McuSubClockStabTimePrescaleValue=MCU_CLK_DIV_64
          McuClocksIn: McuFastCrOscillator=4000000.0, McuMainOscillator=8000000.0, McuSlowCrOscillator=100000.0, McuSubOscillator=32768.0
          McuProfileSettings_RUN (McuProfileSettings): McuProfile=MCU_PROFILE_RUN
            McuClockProfileSettings
              McuClockDomain0Settings_RUN (McuClockDomain0Settings): McuClockDomain0ClockSelect=MCU_SOURCE_CLOCK_PLL0, McuSysClockDivision=1
                McuAtbClockGroupSettings_RUN (McuAtbClockGroupSettings): McuAtbClockDivision=MCU_CLK_DIV_2, McuAtbClockEnable=1, McuAtbClockFrequency=1.2E8
                  McuDbgClockSettings_RUN (McuDbgClockSettings): McuDbgClockDivision=MCU_CLK_DIV_1, McuDbgClockEnable=1, McuDbgClockFrequency=1.2E8
                McuCpu0ClockSettings_RUN (McuCpu0ClockSettings): McuCpu0ClockEnable=1, McuCpu0ClockFrequency=2.4E8
                McuHpmClockGroupSettings_RUN (McuHpmClockGroupSettings): McuHpmClockDivision=2, McuHpmClockEnable=1, McuHpmClockFrequency=1.2E8
                  McuDmaClockSettings_RUN (McuDmaClockSettings): McuDmaClockEnable=1, McuDmaClockFrequency=1.2E8
                  McuExtBusClockSettings_RUN (McuExtBusClockSettings): McuExtBusClockDivision=MCU_CLK_DIV_4, McuExtBusClockEnable=1, McuExtBusClockFrequency=3.0E7
                  McuHapp0A0ClockGroupSettings_RUN (McuHapp0A0ClockGroupSettings): McuHapp0A0ClockDivision=3, McuHapp0A0ClockEnable=1, McuHapp0A0ClockFrequency=4.0E7
                    McuHapp0A1ClockSettings_RUN (McuHapp0A1ClockSettings): McuHapp0A1ClockDivision=1, McuHapp0A1ClockEnable=1, McuHapp0A1ClockFrequency=4.0E7
                  McuHapp1B0ClockGroupSettings_RUN (McuHapp1B0ClockGroupSettings): McuHapp1B0ClockDivision=2, McuHapp1B0ClockEnable=1, McuHapp1B0ClockFrequency=6.0E7
                    McuHapp1B1ClockSettings_RUN (McuHapp1B1ClockSettings): McuHapp1B1ClockDivision=2, McuHapp1B1ClockEnable=1, McuHapp1B1ClockFrequency=3.0E7
                  McuHpm2ClockSettings_RUN (McuHpm2ClockSettings): McuHpm2ClockEnable=1, McuHpm2ClockFrequency=6.0E7
                  McuMemcClockSettings_RUN (McuMemcClockSettings): McuMemcClockEnable=1, McuMemcClockFrequency=1.2E8
                  McuSysc1ClockSettings_RUN (McuSysc1ClockSettings): McuSysc1ClockDivision=3, McuSysc1ClockEnable=1, McuSysc1ClockFrequency=4.0E7
                McuLapp0AClockSettings_RUN (McuLapp0AClockSettings): McuLapp0AClockDivision=6, McuLapp0AClockEnable=1, McuLapp0AClockFrequency=4.0E7, McuLapp0AClockSelect=MCU_SOURCE_CLOCK_PLL0
                McuLapp0ClockSettings_RUN (McuLapp0ClockSettings): McuLapp0ClockDivision=6, McuLapp0ClockEnable=1, McuLapp0ClockFrequency=4.0E7
                McuLapp1AClockSettings_RUN (McuLapp1AClockSettings): McuLapp1AClockDivision=6, McuLapp1AClockEnable=1, McuLapp1AClockFrequency=4.0E7, McuLapp1AClockSelect=MCU_SOURCE_CLOCK_PLL0
                McuLapp1ClockSettings_RUN (McuLapp1ClockSettings): McuLapp1ClockDivision=6, McuLapp1ClockEnable=1, McuLapp1ClockFrequency=4.0E7
                McuLcp0AClockSettings_RUN (McuLcp0AClockSettings): McuLcp0AClockDivision=4, McuLcp0AClockEnable=1, McuLcp0AClockFrequency=6.0E7, McuLcp0AClockSelect=MCU_SOURCE_CLOCK_CD0
                McuLcp0ClockSettings_RUN (McuLcp0ClockSettings): McuLcp0ClockDivision=6, McuLcp0ClockEnable=1, McuLcp0ClockFrequency=4.0E7
                McuLcp1AClockSettings_RUN (McuLcp1AClockSettings): McuLcp1AClockDivision=4, McuLcp1AClockEnable=1, McuLcp1AClockFrequency=6.0E7, McuLcp1AClockSelect=MCU_SOURCE_CLOCK_CD0
                McuLcp1ClockSettings_RUN (McuLcp1ClockSettings): McuLcp1ClockDivision=6, McuLcp1ClockEnable=1, McuLcp1ClockFrequency=4.0E7
                McuLcpClockSettings_RUN (McuLcpClockSettings): McuLcpClockDivision=MCU_CLK_DIV_4, McuLcpClockEnable=1, McuLcpClockFrequency=6.0E7
                McuLlpbmClockSettings_RUN (McuLlpbmClockSettings): McuLlpbm2ClockEnable=1, McuLlpbm2ClockFrequency=1.2E8, McuLlpbmClockEnable=1, McuLlpbmClockFrequency=2.4E8
              McuClockDomainHsspiSettings: McuHsspiClockDivision=1, McuHsspiClockEnable=1, McuHsspiClockFrequency=2.0E8, McuHsspiClockSelect=MCU_SOURCE_CLOCK_SSCG1
              McuClockDomainMcucSettings:
                McuMcucClockSelect = MCU_SOURCE_CLOCK_SSCG0
                McuMcucHClockDivision = 4
                McuMcucHClockEnable = 1
                McuMcucHClockFrequency = 5.8E7
                McuMcucPClockDivision = 1
                McuMcucPClockEnable = 1
                McuMcucPClockFrequency = 5.8E7
              5 x McuClockDomainSettings, all with McuClockDomainClockDivision=1, McuClockDomainClockEnable=1:
                McuClockDomainSettings_RUN_CD1: McuClockDomain=MCU_CD_1, McuClockDomainClockFrequency=4.0E8, McuClockDomainClockSelect=MCU_SOURCE_CLOCK_SSCG3
                  McuClockDomainA0ClockSettings: McuClockDomainA0ClockDivision=4, McuClockDomainA0ClockEnable=1, McuClockDomainA0ClockFrequency=1.0E8
                  McuClockDomainA1ClockSettings: McuClockDomainA1ClockDivision=1, McuClockDomainA1ClockEnable=1, McuClockDomainA1ClockFrequency=1.0E8
                  McuClockDomainB0ClockSettings: McuClockDomainB0ClockDivision=4, McuClockDomainB0ClockEnable=1, McuClockDomainB0ClockFrequency=1.0E8
                  McuClockDomainB1ClockSettings: McuClockDomainB1ClockDivision=1, McuClockDomainB1ClockEnable=1, McuClockDomainB1ClockFrequency=1.0E8
                McuClockDomainSettings_RUN_CD2: McuClockDomain=MCU_CD_2, McuClockDomainClockFrequency=3.6E8, McuClockDomainClockSelect=MCU_SOURCE_CLOCK_PLL1
                  McuClockDomainA0ClockSettings: McuClockDomainA0ClockDivision=1, McuClockDomainA0ClockEnable=1, McuClockDomainA0ClockFrequency=3.6E8
                  McuClockDomainA1ClockSettings: McuClockDomainA1ClockDivision=1, McuClockDomainA1ClockEnable=1, McuClockDomainA1ClockFrequency=3.6E8
                  McuClockDomainB0ClockSettings: McuClockDomainB0ClockDivision=1, McuClockDomainB0ClockEnable=1, McuClockDomainB0ClockFrequency=3.6E8
                  McuClockDomainB1ClockSettings: McuClockDomainB1ClockDivision=1, McuClockDomainB1ClockEnable=1, McuClockDomainB1ClockFrequency=3.6E8
                McuClockDomainSettings_RUN_CD3: McuClockDomain=MCU_CD_3, McuClockDomainClockFrequency=2.0E8, McuClockDomainClockSelect=MCU_SOURCE_CLOCK_SSCG2
                  McuClockDomainA0ClockSettings: McuClockDomainA0ClockDivision=1, McuClockDomainA0ClockEnable=1, McuClockDomainA0ClockFrequency=2.0E8
                  McuClockDomainA1ClockSettings: McuClockDomainA1ClockDivision=1, McuClockDomainA1ClockEnable=1, McuClockDomainA1ClockFrequency=2.0E8
                  McuClockDomainB0ClockSettings: McuClockDomainB0ClockDivision=1, McuClockDomainB0ClockEnable=1, McuClockDomainB0ClockFrequency=2.0E8
                  McuClockDomainB1ClockSettings: McuClockDomainB1ClockDivision=1, McuClockDomainB1ClockEnable=1, McuClockDomainB1ClockFrequency=2.0E8
                McuClockDomainSettings_RUN_CD4: McuClockDomain=MCU_CD_4, McuClockDomainClockFrequency=1.23E8, McuClockDomainClockSelect=MCU_SOURCE_CLOCK_PLL2
                  McuClockDomainA0ClockSettings: McuClockDomainA0ClockDivision=1, McuClockDomainA0ClockEnable=1, McuClockDomainA0ClockFrequency=1.23E8
                  McuClockDomainA1ClockSettings: McuClockDomainA1ClockDivision=1, McuClockDomainA1ClockEnable=1, McuClockDomainA1ClockFrequency=1.23E8
                  McuClockDomainB0ClockSettings: McuClockDomainB0ClockDivision=1, McuClockDomainB0ClockEnable=1, McuClockDomainB0ClockFrequency=1.23E8
                  McuClockDomainB1ClockSettings: McuClockDomainB1ClockDivision=1, McuClockDomainB1ClockEnable=1, McuClockDomainB1ClockFrequency=1.23E8
                McuClockDomainSettings_RUN_CD5: McuClockDomain=MCU_CD_5, McuClockDomainClockFrequency=2.4E8, McuClockDomainClockSelect=MCU_SOURCE_CLOCK_PLL3
                  McuClockDomainA0ClockSettings: McuClockDomainA0ClockDivision=2, McuClockDomainA0ClockEnable=1, McuClockDomainA0ClockFrequency=1.2E8
                  McuClockDomainA1ClockSettings: McuClockDomainA1ClockDivision=1, McuClockDomainA1ClockEnable=1, McuClockDomainA1ClockFrequency=1.2E8
                  McuClockDomainB0ClockSettings: McuClockDomainB0ClockDivision=4, McuClockDomainB0ClockEnable=1, McuClockDomainB0ClockFrequency=6.0E7
                  McuClockDomainB1ClockSettings: McuClockDomainB1ClockDivision=1, McuClockDomainB1ClockEnable=1, McuClockDomainB1ClockFrequency=6.0E7
              McuClockDomainTrcSettings: McuTrcClockDivision=5, McuTrcClockEnable=1, McuTrcClockFrequency=7.2E7, McuTrcClockSelect=MCU_SOURCE_CLOCK_PLL1
              McuFlashClockSettings: McuFlashAccessWaitCycle=2, McuFlashClockFrequency=8.0E7, McuWorkFlashAccessWaitCycle=9, McuWorkFlashClockFrequency=8000000.0
              4 x McuPllClockSettings, all with McuPllClockSelect=MCU_SOURCE_CLOCK_MAIN, McuPllClockSupervisorEnable=1, McuPllEnable=1, McuPllInputDivisionLValue=MCU_CLK_DIV_2:
                McuPllClockSettings_RUN_PLL0: McuPllClockFrequency=2.4E8, McuPllDivisionMValue=MCU_CLK_DIV_2, McuPllMultiplicationNValue=120, McuPllOutputFrequency=4.8E8, McuPllType=MCU_SOURCE_CLOCK_PLL0
                McuPllClockSettings_RUN_PLL1: McuPllClockFrequency=3.6E8, McuPllDivisionMValue=MCU_CLK_DIV_2, McuPllMultiplicationNValue=180, McuPllOutputFrequency=7.2E8, McuPllType=MCU_SOURCE_CLOCK_PLL1
                McuPllClockSettings_RUN_PLL2: McuPllClockFrequency=1.23E8, McuPllDivisionMValue=MCU_CLK_DIV_4, McuPllMultiplicationNValue=123, McuPllOutputFrequency=4.92E8, McuPllType=MCU_SOURCE_CLOCK_PLL2
                McuPllClockSettings_RUN_PLL3: McuPllClockFrequency=2.4E8, McuPllDivisionMValue=MCU_CLK_DIV_2, McuPllMultiplicationNValue=120, McuPllOutputFrequency=4.8E8, McuPllType=MCU_SOURCE_CLOCK_PLL3
              McuSourceClockSettings:
                McuFastCrClockSupervisorEnable = 1
                McuFastCrOscillatorEnable = 1
                McuMainClockSupervisorEnable = 1
                McuMainOscillatorEnable = 1
                McuSlowCrClockSupervisorEnable = 0
                McuSlowCrOscillatorEnable = 1
                McuSubClockSupervisorEnable = 0
                McuSubOscillatorEnable = 0
              4 x McuSscgPllClockSettings, all with McuSscgPllClockSelect=MCU_SOURCE_CLOCK_MAIN, McuSscgPllClockSupervisorEnable=1, McuSscgPllDivisionMValue=MCU_CLK_DIV_2, McuSscgPllEnable=1, McuSscgPllInputDivisionLValue=MCU_CLK_DIV_2, McuSscgPllModulationFrequency=MCU_FIN_BY_1024, McuSscgPllModulationRate=MCU_RATE_0_5, McuSscgPllModulatorMode=MCU_MODE_DOWN_SPREAD:
                McuSscgPllClockSettings_RUN_SSCG0: McuSscgPllClockFrequency=2.32E8, McuSscgPllModulationEnable=0, McuSscgPllMultiplicationNValue=116, McuSscgPllOutputFrequency=4.64E8, McuSscgPllType=MCU_SOURCE_CLOCK_SSCG0
                McuSscgPllClockSettings_RUN_SSCG1: McuSscgPllClockFrequency=2.0E8, McuSscgPllModulationEnable=0, McuSscgPllMultiplicationNValue=100, McuSscgPllOutputFrequency=4.0E8, McuSscgPllType=MCU_SOURCE_CLOCK_SSCG1
                McuSscgPllClockSettings_RUN_SSCG2: McuSscgPllClockFrequency=2.0E8, McuSscgPllModulationEnable=0, McuSscgPllMultiplicationNValue=100, McuSscgPllOutputFrequency=4.0E8, McuSscgPllType=MCU_SOURCE_CLOCK_SSCG2
                McuSscgPllClockSettings_RUN_SSCG3: McuSscgPllClockFrequency=4.0E8, McuSscgPllModulationEnable=1, McuSscgPllMultiplicationNValue=200, McuSscgPllOutputFrequency=8.0E8, McuSscgPllType=MCU_SOURCE_CLOCK_SSCG3
            McuModeProfileSettings
              McuLowVoltageDetectionSettings_RUN_Ext (McuLowVoltageDetectionSettings):
                McuLowVoltageDetectionEnable = 1
                McuLowVoltageDetectionResetEnable = 1
                McuLowVoltageDetectionResource = MCU_LVD_EXTERNAL
                McuLowVoltageDetectionVoltage = MCU_LVD_VOLTAGE_4_2V
              McuLowVoltageDetectionSettings_RUN_Int (McuLowVoltageDetectionSettings):
                McuLowVoltageDetectionEnable = 1
                McuLowVoltageDetectionResetEnable = 1
                McuLowVoltageDetectionResource = MCU_LVD_INTERNAL
                McuLowVoltageDetectionVoltage = MCU_LVD_VOLTAGE_0_97V
              McuPowerDomainSettings:
                McuPowerDomain2Enable = 1
                McuPowerDomain3Enable = 1
                McuPowerDomain4_0Enable = 1
                McuPowerDomain4_1Enable = 1
                McuPowerDomain5_{0..3}Enable = 1
                McuPowerDomain6_0Enable = 1
                McuPowerDomain6_1Enable = 1
              McuRegulatorSettings: McuRegulatorMode=MCU_REG_MODE_MAIN, McuRegulatorVoltage=MCU_REG_VOLTAGE_1_20V
        McuClockSettingConfig_RUN_RTC: McuClockSettingId=3
          8 x McuClockReferencePoint:
            McuClockReferencePoint_COMH: McuClock=MCU_RUN_CLK_COMH, McuClockReferencePointFrequency=5.8E7
            McuClockReferencePoint_HPM: McuClock=MCU_RUN_CLK_HPM, McuClockReferencePointFrequency=1.2E8
            McuClockReferencePoint_LCP: McuClock=MCU_RUN_CLK_LCP, McuClockReferencePointFrequency=6.0E7
            McuClockReferencePoint_LCP0A: McuClock=MCU_RUN_CLK_LCP0A, McuClockReferencePointFrequency=6.0E7
            McuClockReferencePoint_LCP1A: McuClock=MCU_RUN_CLK_LCP1A, McuClockReferencePointFrequency=6.0E7
            McuClockReferencePoint_LLPBM2: McuClock=MCU_RUN_CLK_LLPBM2, McuClockReferencePointFrequency=1.2E8
            McuClockReferencePoint_MAIN: McuClock=MCU_CLK_MAIN, McuClockReferencePointFrequency=8000000.0
            McuClockReferencePoint_PLL0: McuClock=MCU_RUN_CLK_PLL0, McuClockReferencePointFrequency=2.4E8
          McuClockSettings
            8 x McuClockGearSettings, all with McuClockGearEnable=1, McuClockGearLoop=256, McuClockGearStartStep=0, McuClockGearStep=1:
              McuClockGearSettings_RUN_PLL{0..3}: McuClockGearClock=MCU_SOURCE_CLOCK_PLL{0..3}
              McuClockGearSettings_RUN_SSCG{0..3}: McuClockGearClock=MCU_SOURCE_CLOCK_SSCG{0..3}
            McuClockOutputFunctionSettings:
              McuClockOutputClockDivision = MCU_CLK_DIV_128
              McuClockOutputClockSelection = MCU_SOURCE_CLOCK_FAST_CR
              McuClockOutputFunctionEnable = 0
              McuClockOutputPssProfileFrequency = 0.0
              McuClockOutputRunProfileFrequency = 0.0
            11 x McuClockSupervisorSettings:
              McuClockSupervisorSettings_FAST_CR: McuCsvMonitorClock=MCU_SOURCE_CLOCK_FAST_CR, McuCsvReferenceClockDivision=MCU_CLK_DIV_16
              McuClockSupervisorSettings_MAIN: McuCsvLowerThresholdValue=106, McuCsvMonitorClock=MCU_SOURCE_CLOCK_MAIN, McuCsvReferenceClockSelect=MCU_SOURCE_CLOCK_SLOW_CR, McuCsvReferenceClockWindow=2, McuCsvResetModeSelect=0, McuCsvUpperThresholdValue=320
              McuClockSupervisorSettings_PLL0: McuCsvLowerThresholdValue=988, McuCsvMonitorClock=MCU_SOURCE_CLOCK_PLL0, McuCsvReferenceClockWindow=33, McuCsvResetModeSelect=0, McuCsvUpperThresholdValue=992
              McuClockSupervisorSettings_PLL1: McuCsvLowerThresholdValue=988, McuCsvMonitorClock=MCU_SOURCE_CLOCK_PLL1, McuCsvReferenceClockWindow=22, McuCsvResetModeSelect=0, McuCsvUpperThresholdValue=992
              McuClockSupervisorSettings_PLL2: McuCsvLowerThresholdValue=997, McuCsvMonitorClock=MCU_SOURCE_CLOCK_PLL2, McuCsvReferenceClockWindow=65, McuCsvResetModeSelect=0, McuCsvUpperThresholdValue=1002
              McuClockSupervisorSettings_PLL3: McuCsvLowerThresholdValue=988, McuCsvMonitorClock=MCU_SOURCE_CLOCK_PLL3, McuCsvReferenceClockWindow=33, McuCsvResetModeSelect=0, McuCsvUpperThresholdValue=992
              McuClockSupervisorSettings_SLOW_CR: McuCsvMonitorClock=MCU_SOURCE_CLOCK_SLOW_CR, McuCsvReferenceClockDivision=MCU_CLK_DIV_16
              McuClockSupervisorSettings_SSCG0: McuCsvLowerThresholdValue=879, McuCsvMonitorClock=MCU_SOURCE_CLOCK_SSCG0, McuCsvReferenceClockWindow=32, McuCsvResetModeSelect=0, McuCsvUpperThresholdValue=977
              McuClockSupervisorSettings_SSCG1: McuCsvLowerThresholdValue=900, McuCsvMonitorClock=MCU_SOURCE_CLOCK_SSCG1, McuCsvReferenceClockWindow=38, McuCsvResetModeSelect=0, McuCsvUpperThresholdValue=1000
              McuClockSupervisorSettings_SSCG2: McuCsvLowerThresholdValue=829, McuCsvMonitorClock=MCU_SOURCE_CLOCK_SSCG2, McuCsvReferenceClockWindow=35, McuCsvResetModeSelect=0, McuCsvUpperThresholdValue=921
              McuClockSupervisorSettings_SSCG3: McuCsvLowerThresholdValue=900, McuCsvMonitorClock=MCU_SOURCE_CLOCK_SSCG3, McuCsvReferenceClockWindow=19, McuCsvResetModeSelect=0, McuCsvUpperThresholdValue=1000
            McuFastCrClockSettings:
              McuFastCrClockStabTime = 4.8E-4
              McuFastCrClockStabTimeCompareValue = 30
              McuFastCrClockStabTimePrescaleValue = MCU_CLK_DIV_64
              McuFastCrCoarseTrimmingValue = 15
              McuFastCrFineTrimmingValue = 18
            McuMainClockSettings:
              McuMainClockAmpMode = MCU_MCLK_AMP_MODE_NORMAL
              McuMainClockDivisionValue = MCU_MCLK_DIV_2
              McuMainClockGainValue = MCU_MCLK_GAIN_8MHz
              McuMainClockStabTime = 0.008192
              McuMainClockStabTimeCompareValue = 512
              McuMainClockStabTimePrescaleValue = MCU_CLK_DIV_64
            McuPllSettings: McuPllStabilizationTime=MCU_STABTIME_2_EXP_11
            McuSlowCrClockSettings: McuSlowCrClockStabTime=6.4E-4, McuSlowCrClockStabTimeCompareValue=1, McuSlowCrClockStabTimePrescaleValue=MCU_CLK_DIV_64
            McuSscgPllSettings: McuSscgPllStabilizationTime=MCU_STABTIME_2_EXP_11
            McuSubClockSettings: McuSubClockInputEnable=0, McuSubClockStabTime=32000.0, McuSubClockStabTimeCompareValue=4, McuSubClockStabTimePrescaleValue=MCU_CLK_DIV_64
          McuClocksIn: McuFastCrOscillator=4000000.0, McuMainOscillator=8000000.0, McuSlowCrOscillator=100000.0, McuSubOscillator=32768.0
          McuProfileSettings_RUN (McuProfileSettings): McuProfile=MCU_PROFILE_RUN
            McuClockProfileSettings
              McuClockDomain0Settings_RUN (McuClockDomain0Settings): McuClockDomain0ClockSelect=MCU_SOURCE_CLOCK_PLL0, McuSysClockDivision=1
                McuAtbClockGroupSettings_RUN (McuAtbClockGroupSettings): McuAtbClockDivision=MCU_CLK_DIV_2, McuAtbClockEnable=1, McuAtbClockFrequency=1.2E8
                  McuDbgClockSettings_RUN (McuDbgClockSettings): McuDbgClockDivision=MCU_CLK_DIV_1, McuDbgClockEnable=1, McuDbgClockFrequency=1.2E8
                McuCpu0ClockSettings_RUN (McuCpu0ClockSettings): McuCpu0ClockEnable=1, McuCpu0ClockFrequency=2.4E8
                McuHpmClockGroupSettings_RUN (McuHpmClockGroupSettings): McuHpmClockDivision=2, McuHpmClockEnable=1, McuHpmClockFrequency=1.2E8
                  McuDmaClockSettings_RUN (McuDmaClockSettings): McuDmaClockEnable=1, McuDmaClockFrequency=1.2E8
                  McuExtBusClockSettings_RUN (McuExtBusClockSettings): McuExtBusClockDivision=MCU_CLK_DIV_4, McuExtBusClockEnable=1, McuExtBusClockFrequency=3.0E7
                  McuHapp0A0ClockGroupSettings_RUN (McuHapp0A0ClockGroupSettings): McuHapp0A0ClockDivision=3, McuHapp0A0ClockEnable=1, McuHapp0A0ClockFrequency=4.0E7
                    McuHapp0A1ClockSettings_RUN (McuHapp0A1ClockSettings): McuHapp0A1ClockDivision=1, McuHapp0A1ClockEnable=1, McuHapp0A1ClockFrequency=4.0E7
                  McuHapp1B0ClockGroupSettings_RUN (McuHapp1B0ClockGroupSettings): McuHapp1B0ClockDivision=2, McuHapp1B0ClockEnable=1, McuHapp1B0ClockFrequency=6.0E7
                    McuHapp1B1ClockSettings_RUN (McuHapp1B1ClockSettings): McuHapp1B1ClockDivision=2, McuHapp1B1ClockEnable=1, McuHapp1B1ClockFrequency=3.0E7
                  McuHpm2ClockSettings_RUN (McuHpm2ClockSettings): McuHpm2ClockEnable=1, McuHpm2ClockFrequency=6.0E7
                  McuMemcClockSettings_RUN (McuMemcClockSettings): McuMemcClockEnable=1, McuMemcClockFrequency=1.2E8
                  McuSysc1ClockSettings_RUN (McuSysc1ClockSettings): McuSysc1ClockDivision=3, McuSysc1ClockEnable=1, McuSysc1ClockFrequency=4.0E7
                McuLapp0AClockSettings_RUN (McuLapp0AClockSettings): McuLapp0AClockDivision=6, McuLapp0AClockEnable=1, McuLapp0AClockFrequency=4.0E7, McuLapp0AClockSelect=MCU_SOURCE_CLOCK_PLL0
                McuLapp0ClockSettings_RUN (McuLapp0ClockSettings): McuLapp0ClockDivision=6, McuLapp0ClockEnable=1, McuLapp0ClockFrequency=4.0E7
                McuLapp1AClockSettings_RUN (McuLapp1AClockSettings): McuLapp1AClockDivision=6, McuLapp1AClockEnable=1, McuLapp1AClockFrequency=4.0E7, McuLapp1AClockSelect=MCU_SOURCE_CLOCK_PLL0
                McuLapp1ClockSettings_RUN (McuLapp1ClockSettings): McuLapp1ClockDivision=6, McuLapp1ClockEnable=1, McuLapp1ClockFrequency=4.0E7
                McuLcp0AClockSettings_RUN (McuLcp0AClockSettings): McuLcp0AClockDivision=4, McuLcp0AClockEnable=1, McuLcp0AClockFrequency=6.0E7, McuLcp0AClockSelect=MCU_SOURCE_CLOCK_CD0
                McuLcp0ClockSettings_RUN (McuLcp0ClockSettings): McuLcp0ClockDivision=6, McuLcp0ClockEnable=1, McuLcp0ClockFrequency=4.0E7
                McuLcp1AClockSettings_RUN (McuLcp1AClockSettings): McuLcp1AClockDivision=4, McuLcp1AClockEnable=1, McuLcp1AClockFrequency=6.0E7, McuLcp1AClockSelect=MCU_SOURCE_CLOCK_CD0
                McuLcp1ClockSettings_RUN (McuLcp1ClockSettings): McuLcp1ClockDivision=6, McuLcp1ClockEnable=1, McuLcp1ClockFrequency=4.0E7
                McuLcpClockSettings_RUN (McuLcpClockSettings): McuLcpClockDivision=MCU_CLK_DIV_4, McuLcpClockEnable=1, McuLcpClockFrequency=6.0E7
                McuLlpbmClockSettings_RUN (McuLlpbmClockSettings): McuLlpbm2ClockEnable=1, McuLlpbm2ClockFrequency=1.2E8, McuLlpbmClockEnable=1, McuLlpbmClockFrequency=2.4E8
              McuClockDomainHsspiSettings: McuHsspiClockDivision=1, McuHsspiClockEnable=1, McuHsspiClockFrequency=2.0E8, McuHsspiClockSelect=MCU_SOURCE_CLOCK_SSCG1
              McuClockDomainMcucSettings:
                McuMcucClockSelect = MCU_SOURCE_CLOCK_SSCG0
                McuMcucHClockDivision = 4
                McuMcucHClockEnable = 1
                McuMcucHClockFrequency = 5.8E7
                McuMcucPClockDivision = 1
                McuMcucPClockEnable = 1
                McuMcucPClockFrequency = 5.8E7
              5 x McuClockDomainSettings, all with McuClockDomainClockDivision=1, McuClockDomainClockEnable=1:
                McuClockDomainSettings_RUN_CD1: McuClockDomain=MCU_CD_1, McuClockDomainClockFrequency=4.0E8, McuClockDomainClockSelect=MCU_SOURCE_CLOCK_SSCG3
                  McuClockDomainA0ClockSettings: McuClockDomainA0ClockDivision=4, McuClockDomainA0ClockEnable=1, McuClockDomainA0ClockFrequency=1.0E8
                  McuClockDomainA1ClockSettings: McuClockDomainA1ClockDivision=1, McuClockDomainA1ClockEnable=1, McuClockDomainA1ClockFrequency=1.0E8
                  McuClockDomainB0ClockSettings: McuClockDomainB0ClockDivision=4, McuClockDomainB0ClockEnable=1, McuClockDomainB0ClockFrequency=1.0E8
                  McuClockDomainB1ClockSettings: McuClockDomainB1ClockDivision=1, McuClockDomainB1ClockEnable=1, McuClockDomainB1ClockFrequency=1.0E8
                McuClockDomainSettings_RUN_CD2: McuClockDomain=MCU_CD_2, McuClockDomainClockFrequency=3.6E8, McuClockDomainClockSelect=MCU_SOURCE_CLOCK_PLL1
                  McuClockDomainA0ClockSettings: McuClockDomainA0ClockDivision=1, McuClockDomainA0ClockEnable=1, McuClockDomainA0ClockFrequency=3.6E8
                  McuClockDomainA1ClockSettings: McuClockDomainA1ClockDivision=1, McuClockDomainA1ClockEnable=1, McuClockDomainA1ClockFrequency=3.6E8
                  McuClockDomainB0ClockSettings: McuClockDomainB0ClockDivision=1, McuClockDomainB0ClockEnable=1, McuClockDomainB0ClockFrequency=3.6E8
                  McuClockDomainB1ClockSettings: McuClockDomainB1ClockDivision=1, McuClockDomainB1ClockEnable=1, McuClockDomainB1ClockFrequency=3.6E8
                McuClockDomainSettings_RUN_CD3: McuClockDomain=MCU_CD_3, McuClockDomainClockFrequency=2.0E8, McuClockDomainClockSelect=MCU_SOURCE_CLOCK_SSCG2
                  McuClockDomainA0ClockSettings: McuClockDomainA0ClockDivision=1, McuClockDomainA0ClockEnable=1, McuClockDomainA0ClockFrequency=2.0E8
                  McuClockDomainA1ClockSettings: McuClockDomainA1ClockDivision=1, McuClockDomainA1ClockEnable=1, McuClockDomainA1ClockFrequency=2.0E8
                  McuClockDomainB0ClockSettings: McuClockDomainB0ClockDivision=1, McuClockDomainB0ClockEnable=1, McuClockDomainB0ClockFrequency=2.0E8
                  McuClockDomainB1ClockSettings: McuClockDomainB1ClockDivision=1, McuClockDomainB1ClockEnable=1, McuClockDomainB1ClockFrequency=2.0E8
                McuClockDomainSettings_RUN_CD4: McuClockDomain=MCU_CD_4, McuClockDomainClockFrequency=1.23E8, McuClockDomainClockSelect=MCU_SOURCE_CLOCK_PLL2
                  McuClockDomainA0ClockSettings: McuClockDomainA0ClockDivision=1, McuClockDomainA0ClockEnable=1, McuClockDomainA0ClockFrequency=1.23E8
                  McuClockDomainA1ClockSettings: McuClockDomainA1ClockDivision=1, McuClockDomainA1ClockEnable=1, McuClockDomainA1ClockFrequency=1.23E8
                  McuClockDomainB0ClockSettings: McuClockDomainB0ClockDivision=1, McuClockDomainB0ClockEnable=1, McuClockDomainB0ClockFrequency=1.23E8
                  McuClockDomainB1ClockSettings: McuClockDomainB1ClockDivision=1, McuClockDomainB1ClockEnable=1, McuClockDomainB1ClockFrequency=1.23E8
                McuClockDomainSettings_RUN_CD5: McuClockDomain=MCU_CD_5, McuClockDomainClockFrequency=2.4E8, McuClockDomainClockSelect=MCU_SOURCE_CLOCK_PLL3
                  McuClockDomainA0ClockSettings: McuClockDomainA0ClockDivision=2, McuClockDomainA0ClockEnable=1, McuClockDomainA0ClockFrequency=1.2E8
                  McuClockDomainA1ClockSettings: McuClockDomainA1ClockDivision=1, McuClockDomainA1ClockEnable=1, McuClockDomainA1ClockFrequency=1.2E8
                  McuClockDomainB0ClockSettings: McuClockDomainB0ClockDivision=4, McuClockDomainB0ClockEnable=1, McuClockDomainB0ClockFrequency=6.0E7
                  McuClockDomainB1ClockSettings: McuClockDomainB1ClockDivision=1, McuClockDomainB1ClockEnable=1, McuClockDomainB1ClockFrequency=6.0E7
              McuClockDomainTrcSettings: McuTrcClockDivision=5, McuTrcClockEnable=1, McuTrcClockFrequency=7.2E7, McuTrcClockSelect=MCU_SOURCE_CLOCK_PLL1
              McuFlashClockSettings: McuFlashAccessWaitCycle=2, McuFlashClockFrequency=8.0E7, McuWorkFlashAccessWaitCycle=9, McuWorkFlashClockFrequency=8000000.0
              4 x McuPllClockSettings, all with McuPllClockSelect=MCU_SOURCE_CLOCK_MAIN, McuPllClockSupervisorEnable=1, McuPllEnable=1, McuPllInputDivisionLValue=MCU_CLK_DIV_2:
                McuPllClockSettings_RUN_PLL0: McuPllClockFrequency=2.4E8, McuPllDivisionMValue=MCU_CLK_DIV_2, McuPllMultiplicationNValue=120, McuPllOutputFrequency=4.8E8, McuPllType=MCU_SOURCE_CLOCK_PLL0
                McuPllClockSettings_RUN_PLL1: McuPllClockFrequency=3.6E8, McuPllDivisionMValue=MCU_CLK_DIV_2, McuPllMultiplicationNValue=180, McuPllOutputFrequency=7.2E8, McuPllType=MCU_SOURCE_CLOCK_PLL1
                McuPllClockSettings_RUN_PLL2: McuPllClockFrequency=1.23E8, McuPllDivisionMValue=MCU_CLK_DIV_4, McuPllMultiplicationNValue=123, McuPllOutputFrequency=4.92E8, McuPllType=MCU_SOURCE_CLOCK_PLL2
                McuPllClockSettings_RUN_PLL3: McuPllClockFrequency=2.4E8, McuPllDivisionMValue=MCU_CLK_DIV_2, McuPllMultiplicationNValue=120, McuPllOutputFrequency=4.8E8, McuPllType=MCU_SOURCE_CLOCK_PLL3
              McuSourceClockSettings:
                McuFastCrClockSupervisorEnable = 1
                McuFastCrOscillatorEnable = 1
                McuMainClockSupervisorEnable = 1
                McuMainOscillatorEnable = 1
                McuSlowCrClockSupervisorEnable = 0
                McuSlowCrOscillatorEnable = 1
                McuSubClockSupervisorEnable = 0
                McuSubOscillatorEnable = 0
              4 x McuSscgPllClockSettings, all with McuSscgPllClockSelect=MCU_SOURCE_CLOCK_MAIN, McuSscgPllClockSupervisorEnable=1, McuSscgPllDivisionMValue=MCU_CLK_DIV_2, McuSscgPllEnable=1, McuSscgPllInputDivisionLValue=MCU_CLK_DIV_2, McuSscgPllModulationFrequency=MCU_FIN_BY_1024, McuSscgPllModulationRate=MCU_RATE_0_5, McuSscgPllModulatorMode=MCU_MODE_DOWN_SPREAD:
                McuSscgPllClockSettings_RUN_SSCG0: McuSscgPllClockFrequency=2.32E8, McuSscgPllModulationEnable=0, McuSscgPllMultiplicationNValue=116, McuSscgPllOutputFrequency=4.64E8, McuSscgPllType=MCU_SOURCE_CLOCK_SSCG0
                McuSscgPllClockSettings_RUN_SSCG1: McuSscgPllClockFrequency=2.0E8, McuSscgPllModulationEnable=0, McuSscgPllMultiplicationNValue=100, McuSscgPllOutputFrequency=4.0E8, McuSscgPllType=MCU_SOURCE_CLOCK_SSCG1
                McuSscgPllClockSettings_RUN_SSCG2: McuSscgPllClockFrequency=2.0E8, McuSscgPllModulationEnable=0, McuSscgPllMultiplicationNValue=100, McuSscgPllOutputFrequency=4.0E8, McuSscgPllType=MCU_SOURCE_CLOCK_SSCG2
                McuSscgPllClockSettings_RUN_SSCG3: McuSscgPllClockFrequency=4.0E8, McuSscgPllModulationEnable=1, McuSscgPllMultiplicationNValue=200, McuSscgPllOutputFrequency=8.0E8, McuSscgPllType=MCU_SOURCE_CLOCK_SSCG3
            McuModeProfileSettings
              McuLowVoltageDetectionSettings_RUN_Ext (McuLowVoltageDetectionSettings):
                McuLowVoltageDetectionEnable = 1
                McuLowVoltageDetectionResetEnable = 1
                McuLowVoltageDetectionResource = MCU_LVD_EXTERNAL
                McuLowVoltageDetectionVoltage = MCU_LVD_VOLTAGE_4_2V
              McuLowVoltageDetectionSettings_RUN_Int (McuLowVoltageDetectionSettings):
                McuLowVoltageDetectionEnable = 1
                McuLowVoltageDetectionResetEnable = 1
                McuLowVoltageDetectionResource = MCU_LVD_INTERNAL
                McuLowVoltageDetectionVoltage = MCU_LVD_VOLTAGE_0_97V
              McuPowerDomainSettings:
                McuPowerDomain2Enable = 1
                McuPowerDomain3Enable = 1
                McuPowerDomain4_0Enable = 1
                McuPowerDomain4_1Enable = 1
                McuPowerDomain5_{0..3}Enable = 1
                McuPowerDomain6_0Enable = 1
                McuPowerDomain6_1Enable = 1
              McuRegulatorSettings: McuRegulatorMode=MCU_REG_MODE_MAIN, McuRegulatorVoltage=MCU_REG_VOLTAGE_1_20V
      McuClockSupervisorCallbackFunctions
      McuDemEventParameterRefs: MCU_E_CLOCK_FAILURE=MCU_E_CLOCK_FAILURE
      McuLowVoltageDetectionCallbackFunctions
      3 x McuModeSettingConf, all with McuCacheFlushBeforePss=1:
        McuModeSettingConf_PSS: McuMode=2, McuStopCpu=1, McuReferenceClockSetting=McuClockSettingConfig_PSS
          McuPssStateSettings:
            McuBackupRamStandbyEnable = 0
            McuExternal5VPowerStabilizationTime = MCU_FAST_CR_CYCLE_BY_80000
            McuExternalPowerStabilizationTime = MCU_FAST_CR_CYCLE_BY_80000
            McuIo35vResetEnable = 0
            McuIo3vResetEnable = 1
            McuPssStateHoldIoIsolationLatchPd2Enable = 1
            McuPssStateHoldIoIsolationLatchPd5_{0..3}Enable = 0
            McuPssStateHoldIoIsolationLatchPd6_0Enable = 0
            McuPssStateHoldIoIsolationLatchPd6_1Enable = 1
            McuPssStateIoHizControlEnable = 0
            McuResetLevelConfigEnable = 0
        McuModeSettingConf_RUN: McuMode=1, McuStopCpu=0, McuReferenceClockSetting=McuClockSettingConfig_RUN
          McuPssStateSettings:
            McuBackupRamStandbyEnable = 0
            McuExternal5VPowerStabilizationTime = MCU_FAST_CR_CYCLE_BY_80000
            McuExternalPowerStabilizationTime = MCU_FAST_CR_CYCLE_BY_80000
            McuIo35vResetEnable = 0
            McuIo3vResetEnable = 0
            McuPssStateHoldIoIsolationLatchPd2Enable = 0
            McuPssStateHoldIoIsolationLatchPd5_{0..3}Enable = 0
            McuPssStateHoldIoIsolationLatchPd6_0Enable = 0
            McuPssStateHoldIoIsolationLatchPd6_1Enable = 0
            McuPssStateIoHizControlEnable = 0
            McuResetLevelConfigEnable = 0
        McuModeSettingConf_RUN_RTC: McuMode=3, McuStopCpu=0, McuReferenceClockSetting=McuClockSettingConfig_RUN_RTC
          McuPssStateSettings:
            McuBackupRamStandbyEnable = 0
            McuExternal5VPowerStabilizationTime = MCU_FAST_CR_CYCLE_BY_80000
            McuExternalPowerStabilizationTime = MCU_FAST_CR_CYCLE_BY_80000
            McuIo35vResetEnable = 0
            McuIo3vResetEnable = 0
            McuPssStateHoldIoIsolationLatchPd2Enable = 0
            McuPssStateHoldIoIsolationLatchPd5_{0..3}Enable = 0
            McuPssStateHoldIoIsolationLatchPd6_0Enable = 0
            McuPssStateHoldIoIsolationLatchPd6_1Enable = 0
            McuPssStateIoHizControlEnable = 0
            McuResetLevelConfigEnable = 0
      McuRamSectorSettingConf_RUN (McuRamSectorSettingConf): McuRamDefaultValue=255, McuRamSectionBaseAddress=0, McuRamSectionSize=128
    McuPublishedInformation
      30 x McuResetReasonConf:
        MCU_CLOCK_STOP_WAIT_RESET: McuResetReason=10
        MCU_EXTERNAL_RESET: McuResetReason=5
        MCU_FAST_CR_CLOCK_STOP_RESET: McuResetReason=18
        MCU_ILLEGAL_MODE_RESET: McuResetReason=4
        MCU_INITX_RESET: McuResetReason=3
        MCU_LOW_VOLTAGE_EXTERNAL_EXTRA_RESET: McuResetReason=9
        MCU_LOW_VOLTAGE_EXTERNAL_RESET: McuResetReason=8
        MCU_LOW_VOLTAGE_INTERNAL_EXTRA_RESET: McuResetReason=7
        MCU_LOW_VOLTAGE_INTERNAL_RESET: McuResetReason=6
        MCU_LOW_VOLTAGE_RAM_RETAIN_RESET: McuResetReason=2
        MCU_MAIN_CLOCK_STOP_RESET: McuResetReason=19
        MCU_PLL0_STOP_RESET: McuResetReason=21
        MCU_PLL1_STOP_RESET: McuResetReason=22
        MCU_PLL2_STOP_RESET: McuResetReason=23
        MCU_PLL3_STOP_RESET: McuResetReason=24
        MCU_POWER_ON_RESET: McuResetReason=1
        MCU_PROFILE_ERROR_RESET: McuResetReason=12
        MCU_RESET_UNDEFINED: McuResetReason=0
        MCU_SLOW_CR_CLOCK_STOP_RESET: McuResetReason=17
        MCU_SRSTX_RESET: McuResetReason=11
        MCU_SSCG0_STOP_RESET: McuResetReason=25
        MCU_SSCG1_STOP_RESET: McuResetReason=26
        MCU_SSCG2_STOP_RESET: McuResetReason=27
        MCU_SSCG3_STOP_RESET: McuResetReason=28
        MCU_SUB_CLOCK_STOP_RESET: McuResetReason=20
        MCU_SW_RESET: McuResetReason=15
        MCU_SW_TRIGGER_HW_RESET: McuResetReason=16
        MCU_WAKEUP_RESET: McuResetReason=29
        MCU_WATCHDOG_RESET: McuResetReason=13
        MCU_WATCHDOG_SW_RESET: McuResetReason=14
package /Dio
  module config Dio: implementation-config-variant=VARIANT-PRE-COMPILE, module-description=Dio_Impl
    DioConfig_0 (DioConfig)
      7 x DioPort:
        DIO0: DioPortId=0
          7 x DioChannel:
            DIO_POWER_FAULT: DioChannelId=16, DioChannelPin=P016
            DIO_RESET_CON: DioChannelId=31, DioChannelPin=P031
            DIO_SBATT2ILLUMSPLY_MCU_OUT: DioChannelId=28, DioChannelPin=P028
            DIO_SBATTFUEL_MCU_OUT: DioChannelId=0, DioChannelPin=P000
            DIO_SBATT_DIG_MCU_OUT: DioChannelId=18, DioChannelPin=P018
            DIO_TFT_CSB: DioChannelId=30, DioChannelPin=P030
            DIO_TTESC_DIG_MCU_OUT: DioChannelId=1, DioChannelPin=P001
        DIO1: DioPortId=1
          6 x DioChannel:
            DIO_SBATT_CHIME_MCU_OUT: DioChannelId=38, DioChannelPin=P106
            DIO_TTAIRBAG_DIG_MCU_OUT: DioChannelId=39, DioChannelPin=P107
            DIO_TTLEDLAMPFAIL_DIG_MCU_OUT: DioChannelId=41, DioChannelPin=P109
            DIO_TTMDPS_DIG_MCU_OUT: DioChannelId=40, DioChannelPin=P108
            DIO_TTMSTWRNG_DIG_MCU_OUT: DioChannelId=34, DioChannelPin=P102
            DIO_TTPARKINGBRAKE_DIG_MCU_OUT: DioChannelId=33, DioChannelPin=P101
        DIO2: DioPortId=2
          4 x DioChannel:
            DIO_ALTL_AL_MCU_IN: DioChannelId=83, DioChannelPin=P219
            DIO_SW_3V3_EN_DIG_MCU_OUT: DioChannelId=86, DioChannelPin=P222
            DIO_TTSPDSRGOE_DIGAL_MCU_OUT: DioChannelId=95, DioChannelPin=P231
            DIO_WATER_SEP_AH_MCU_IN: DioChannelId=94, DioChannelPin=P230
        DIO3: DioPortId=3
          15 x DioChannel:
            DIO_CCANRX_NETWRK_MCU_IN: DioChannelId=99, DioChannelPin=P303
            DIO_CCANSTANDBY_DIG_MCU_OUT: DioChannelId=98, DioChannelPin=P302
            DIO_DRIVE_MODE_SW_AL_MCU_IN: DioChannelId=107, DioChannelPin=P311
            DIO_EE_SCL: DioChannelId=97, DioChannelPin=P301
            DIO_EE_SDA: DioChannelId=96, DioChannelPin=P300
            DIO_IGNSENSE_DIGAL_MCU_IN: DioChannelId=102, DioChannelPin=P306
            DIO_MCANENB_DIG_MCU_OUT: DioChannelId=101, DioChannelPin=P305
            DIO_MCANERR_DIG_MCU_IN: DioChannelId=114, DioChannelPin=P318
            DIO_MCANRX_NETWRK_MCU_IN: DioChannelId=112, DioChannelPin=P316
            DIO_MCANSTBY_DIG_MCU_OUT: DioChannelId=111, DioChannelPin=P315
            DIO_SPEEDOUT_PULSE_MCU_OUT: DioChannelId=121, DioChannelPin=P325
            DIO_SW_5V_EN_DIG_MCU_OUT: DioChannelId=115, DioChannelPin=P319
            DIO_SW_5V_EXT_DIG_MCU_OUT: DioChannelId=116, DioChannelPin=P320
            DIO_TTSPDSRGCLR_DIGAL_MCU_OUT: DioChannelId=105, DioChannelPin=P309
            DIO_TTSRGRCK_DIG_MCU_OUT: DioChannelId=118, DioChannelPin=P322
        DIO4: DioPortId=4
          DIO_OILPRESSSW_AL_MCU_IN (DioChannel): DioChannelId=136, DioChannelPin=P408
        DIO5: DioPortId=5
          5 x DioChannel:
            DIO_TFT_ERR: DioChannelId=166, DioChannelPin=P506
            DIO_TFT_RESET: DioChannelId=174, DioChannelPin=P514
            DIO_TTABS_DIG_MCU_OUT: DioChannelId=191, DioChannelPin=P531
            DIO_TTBATTCHRG_DIG_MCU_OUT: DioChannelId=181, DioChannelPin=P521
            DIO_TTESCOFF_DIG_MCU_OUT: DioChannelId=188, DioChannelPin=P528
        DIO6: DioPortId=6
          DIO_TTSRGSEROUT_DIG_MCU_IN (DioChannel): DioChannelId=192, DioChannelPin=P600
    DioGeneral: DioDevErrorDetect=1, DioErrorCalloutFunction=ErrorCalloutHandler, DioFlipChannelApi=1, DioIncludeFile=ErrorCalloutHandler.h, DioVersionInfoApi=1
package /Spi
  module config Spi: implementation-config-variant=VARIANT-PRE-COMPILE
    SpiDriver_0 (SpiDriver)
      SpiChannel_0 (SpiChannel): SpiAlignedBuffer=0, SpiChannelId=0, SpiChannelType=EB, SpiDataWidth=8, SpiDefaultData=255, SpiEbMaxLength=8, SpiIbNBuffers=1, SpiTransferStart=MSB
      SpiChannel_1 (SpiChannel): SpiAlignedBuffer=0, SpiChannelId=1, SpiChannelType=EB, SpiDataWidth=9, SpiDefaultData=511, SpiEbMaxLength=150, SpiIbNBuffers=1, SpiTransferStart=MSB
      SpiExternalDevice_0 (SpiExternalDevice):
        SpiBaudrate = 1000000.0
        SpiCsIdentifier = DIO_LED_SPI_OE
        SpiCsPolarity = LOW
        SpiCsSelection = CS_VIA_GPIO
        SpiCsWaitTiming = WAIT0
        SpiDataShiftEdge = TRAILING
        SpiEnableCs = 0
        SpiHwUnit = MFS00
        SpiShiftClockIdleLevel = HIGH
        SpiTimeClk2Cs = 0.0
        SpiUseDma = 0
        SpiUseFifo = 0
        SpiClockRef = McuClockSettingConfig_RUN/McuClockReferencePoint_LCP0A
      SpiExternalDevice_1 (SpiExternalDevice):
        SpiBaudrate = 1000000.0
        SpiCsIdentifier = DIO_TFT_CSB
        SpiCsPolarity = LOW
        SpiCsSelection = CS_VIA_GPIO
        SpiCsWaitTiming = WAIT0
        SpiDataShiftEdge = TRAILING
        SpiEnableCs = 0
        SpiHwUnit = MFS01
        SpiShiftClockIdleLevel = HIGH
        SpiTimeClk2Cs = 0.0
        SpiUseDma = 0
        SpiUseFifo = 0
        SpiClockRef = McuClockSettingConfig_RUN/McuClockReferencePoint_LCP0A
      SpiJob_0 (SpiJob): SpiHwUnitSynchronous=SYNCHRONOUS, SpiJobEndNotification=, SpiJobId=0, SpiJobPriority=0, SpiDeviceAssignment=SpiExternalDevice_0
        SpiChannelList_0 (SpiChannelList): SpiChannelIndex=0, SpiChannelAssignment=SpiChannel_0
      SpiJob_1 (SpiJob):
        SpiHwUnitSynchronous = ASYNCHRONOUS
        SpiJobEndNotification = Tft_Tm042ndkp08_Job_End_Notification
        SpiJobId = 1
        SpiJobPriority = 2
        SpiDeviceAssignment = SpiExternalDevice_1
        SpiChannelList_0 (SpiChannelList): SpiChannelIndex=0, SpiChannelAssignment=SpiChannel_1
      SpiSequence_0 (SpiSequence): SpiInterruptibleSequence=0, SpiSeqEndNotification=, SpiSequenceId=0, SpiJobAssignment=SpiJob_0
      SpiSequence_1 (SpiSequence): SpiInterruptibleSequence=0, SpiSeqEndNotification=, SpiSequenceId=1, SpiJobAssignment=SpiJob_1
    SpiGeneral:
      SpiCancelApi = 1
      SpiChannelBuffersAllowed = 2
      SpiDevErrorDetect = 1
      SpiErrorCalloutFunction = ErrorCalloutHandler
      SpiHwStatusApi = 1
      SpiIncludeFile = ErrorCalloutHandler.h
      SpiIncludeFile = Tft_Tm042ndkp08.h
      SpiInterruptibleSeqAllowed = 0
      SpiLevelDelivered = 2
      SpiSupportConcurrentSyncTransmit = 0
      SpiVersionInfoApi = 1
    SpiPublishedInformation: SpiMaxHwUnit=22
